## CMakeLists.txt
```
cmake_minimum_required(VERSION 3.20.0)

if(NOT ZEPHYR_MODULES)
  execute_process(
    COMMAND west list --format={abspath}
    WORKING_DIRECTORY ${CMAKE_CURRENT_LIST_DIR}
    OUTPUT_VARIABLE WEST_MODULES_RAW
    OUTPUT_STRIP_TRAILING_WHITESPACE
    RESULT_VARIABLE WEST_LIST_RESULT
  )
  if(WEST_LIST_RESULT EQUAL 0 AND WEST_MODULES_RAW)
    string(REPLACE "\n" ";" ZEPHYR_MODULES "${WEST_MODULES_RAW}")
  endif()
endif()

find_package(Zephyr REQUIRED HINTS $ENV{ZEPHYR_BASE})

project(BioSpur_UWB_tag)

if(DEFINED ENV{APP_TAG_PRELOAD_FILE} AND EXISTS $ENV{APP_TAG_PRELOAD_FILE})
    include($ENV{APP_TAG_PRELOAD_FILE})
endif()

set(APP_ROOT ${CMAKE_CURRENT_LIST_DIR}/../..)
if(NOT DEFINED APP_TAG_ID OR APP_TAG_ID STREQUAL "")
set(APP_TAG_ID "0" CACHE STRING "Tag node ID")
endif()
set(APP_TAG_USB_DIAG_TRACE "0" CACHE STRING "Enable low-level console trace for bringup debugging")
set(APP_TAG_ANCHOR_COUNT "8" CACHE STRING "Number of anchors to range against")
set(APP_TAG_ANCHOR_0_ID "0" CACHE STRING "Anchor slot 0 ID")
set(APP_TAG_ANCHOR_1_ID "1" CACHE STRING "Anchor slot 1 ID")
set(APP_TAG_ANCHOR_2_ID "2" CACHE STRING "Anchor slot 2 ID")
set(APP_TAG_ANCHOR_3_ID "3" CACHE STRING "Anchor slot 3 ID")
set(APP_TAG_ANCHOR_4_ID "4" CACHE STRING "Anchor slot 4 ID")
set(APP_TAG_ANCHOR_5_ID "5" CACHE STRING "Anchor slot 5 ID")
set(APP_TAG_ANCHOR_6_ID "6" CACHE STRING "Anchor slot 6 ID")
set(APP_TAG_ANCHOR_7_ID "7" CACHE STRING "Anchor slot 7 ID")
set(APP_TAG_RNG_DELAY_MS "0" CACHE STRING "Delay between anchor polls in milliseconds")
set(APP_TAG_CAL_RNG_SETTLE_US "0" CACHE STRING "Optional settle time between anchor polls in microseconds")
set(APP_TAG_TX_TO_RX_DLY_UUS "140" CACHE STRING "Initiator RX enable delay after poll TX in UWB usec")
set(APP_TAG_RESP_RX_TIMEOUT_UUS "1800" CACHE STRING "Initiator response RX timeout in UWB usec")
set(APP_TAG_NORMAL_OUTPUT_ENABLE "1" CACHE STRING "Emit normal Tag range output such as TR/CM")
set(APP_TAG_CIR_FEATURE_OUTPUT_ENABLE "0" CACHE STRING "Emit lightweight DW1000 CIR/first-path features for received response frames")
set(APP_TAG_CIR_FEATURE_OUTPUT_BLE_ENABLE "1" CACHE STRING "Forward lightweight CIR feature lines over BLE/NUS when enabled")
set(APP_TAG_CIR_FULL_OUTPUT_ENABLE "0" CACHE STRING "Emit full DW1000 accumulator bytes for received response frames")
set(APP_TAG_CIR_FULL_OUTPUT_CDC_ENABLE "1" CACHE STRING "Emit full CIR accumulator chunks to console/CDC")
set(APP_TAG_CIR_FULL_CHUNK_BYTES "48" CACHE STRING "Payload bytes per full-CIR text chunk")
set(APP_TAG_CIR_FULL_PRIORITY_MASK "0" CACHE STRING "Bit mask of anchors to prioritize for full CIR capture, or 0 for round robin")
set(APP_TAG_CIR_COMPACT_SAMPLE_PERIOD "8" CACHE STRING "Compact CIR samples one sweep every N sweeps; 1 samples every sweep")
set(APP_TAG_RF_DIAG_OUTPUT_ENABLE "0" CACHE STRING "Emit per-anchor RF diagnostics parsed from v2 responses and Tag RX diagnostics")
set(APP_TAG_RF_DIAG_OUTPUT_BLE_ENABLE "1" CACHE STRING "Forward RF diagnostic lines over BLE/NUS when RF diag output is enabled")
set(APP_TAG_RF_DIAG_OUTPUT_PERIOD "1" CACHE STRING "Emit one RF diagnostic row every N sweeps when enabled")
set(APP_TAG_RF_DIAG_LEGACY_RFD_ENABLE "0" CACHE STRING "Emit legacy per-anchor RFD text rows; keep disabled for normal ranging captures")
set(APP_TAG_TR_RF_DIAG_COMPACT_ENABLE "1" CACHE STRING "Append compact RF diagnostics to the normal TR range summary when RF diag is enabled")
set(APP_TAG_RF_DIAG_TAG_RX_ENABLE "0" CACHE STRING "Read Tag-side RX diagnostics in the response hot path; disabled by default to protect ranging success")
set(APP_TAG_VERBOSE_RANGING "0" CACHE STRING "Print per-anchor ranging logs")
set(APP_TAG_VERBOSE_MEASUREMENTS "0" CACHE STRING "Print per-anchor measurement logs")
set(APP_TAG_USB_MIRROR_BLE_STATUS "0" CACHE STRING "Mirror BLE status summaries to USB serial for debug")
set(APP_TAG_MULTITAG_PLAN_MODE "0" CACHE STRING "Enable active/standby/reserve multi-tag anchor plan")
set(APP_TAG_ACTIVE_ANCHOR_0_ID "0" CACHE STRING "Multi-tag active anchor slot 0 ID")
set(APP_TAG_ACTIVE_ANCHOR_1_ID "1" CACHE STRING "Multi-tag active anchor slot 1 ID")
set(APP_TAG_ACTIVE_ANCHOR_2_ID "4" CACHE STRING "Multi-tag active anchor slot 2 ID")
set(APP_TAG_ACTIVE_ANCHOR_3_ID "5" CACHE STRING "Multi-tag active anchor slot 3 ID")
set(APP_TAG_STANDBY_ANCHOR_0_ID "2" CACHE STRING "Multi-tag standby anchor slot 0 ID")
set(APP_TAG_STANDBY_ANCHOR_1_ID "6" CACHE STRING "Multi-tag standby anchor slot 1 ID")
set(APP_TAG_RESERVE_ANCHOR_0_ID "3" CACHE STRING "Multi-tag reserve anchor slot 0 ID")
set(APP_TAG_RESERVE_ANCHOR_1_ID "7" CACHE STRING "Multi-tag reserve anchor slot 1 ID")
set(APP_TAG_REFRESH_ANCHOR_BUDGET "1" CACHE STRING "Additional refresh anchors measured on refresh sweeps")
set(APP_TAG_REFRESH_INTERVAL "10" CACHE STRING "Run one refresh sweep every N sweeps in multi-tag mode")
set(APP_TAG_MAINTENANCE_FULL_INTERVAL "100" CACHE STRING "Run one full 8-anchor maintenance sweep every N sweeps in multi-tag mode")
set(APP_TAG_TDMA_ENABLE "0" CACHE STRING "Enable TDMA slot gating for this tag")
set(APP_TAG_TDMA_SLOT_INDEX "0" CACHE STRING "Zero-based TDMA slot index for this tag")
set(APP_TAG_TDMA_SLOT_COUNT "1" CACHE STRING "Total TDMA slot count in the cycle")
set(APP_TAG_TDMA_SLOT_PERIOD_MS "10" CACHE STRING "TDMA slot period in milliseconds")
set(APP_TAG_TDMA_SLOT_ACTIVE_MS "9" CACHE STRING "Usable active time within each slot in milliseconds")
set(APP_TAG_TDMA_SLOT_ACTIVE_US "0" CACHE STRING "Optional usable active time within each slot in microseconds; 0 uses ACTIVE_MS")
set(APP_TAG_LEGACY_STATIC_SLOT_DIVIDER "1" CACHE STRING "Legacy grouped-static slot divider; normal captures keep this at 1")
set(APP_TAG_TR_BCAST_V2_ENABLE "1" CACHE STRING "Emit broadcast-rich TR;2 range summaries with rx/timing fields")
set(APP_TAG_BCAST_SUMMARY_ENABLE "0" CACHE STRING "Emit 1Hz broadcast SSTWR summary lines")
set(APP_TAG_BCAST_SUMMARY_PERIOD_MS "1000" CACHE STRING "Broadcast SSTWR summary period in milliseconds")
set(APP_TAG_SWEEP_DIAG_ENABLE "0" CACHE STRING "Emit per-sweep timing diagnostic lines")
set(APP_TAG_SWEEP_DIAG_PERIOD "10" CACHE STRING "Emit one sweep timing diagnostic every N sweeps")
set(APP_TAG_BLE_ENABLE "1" CACHE STRING "Enable BLE/NUS and OTA transport on the tag")
set(APP_TAG_BLE_OTA_ENABLE "1" CACHE STRING "Enable OTA command and bootloader-advertising BLE payloads on the tag")
set(APP_TAG_BLE_SETTINGS_ENABLE "1" CACHE STRING "Enable Bluetooth settings persistence on the tag")
set(APP_TAG_MCUBOOT_ENABLE "1" CACHE STRING "Enable MCUboot confirm/OTA plumbing on the tag")
set(APP_TAG_SELF_CONFIRM_MODE "0" CACHE STRING "MCUboot self-confirm mode: 0=normal, 1=proof no-confirm, 2=proof timeout")
set(APP_TAG_SELF_CONFIRM_TIMEOUT_MS "10000" CACHE STRING "Maximum unconfirmed BLE bring-up time before rollback reset")
set(APP_TAG_UWB_ENABLE "1" CACHE STRING "Enable UWB ranging runtime on the tag (0 keeps BLE/OTA online only)")
set(APP_TAG_BLE_COMPACT_STATUS "1" CACHE STRING "Enable compact BLE TagSummary payloads on the tag")
set(APP_TAG_BLE_PACKET_BUNDLE_RECORDS "8" CACHE STRING "Bundle this many TagSummary records into one BLE NUS payload")
set(APP_TAG_BLE_PACKET_BUNDLE_FLUSH_MS "100" CACHE STRING "Flush a partial BLE bundle after this many milliseconds (0 disables)")
set(APP_TAG_BLE_TX_ITEM_COUNT "16" CACHE STRING "BLE NUS transmit queue item count")
set(APP_TAG_BLE_UWB_DIAG_OUTPUT_ENABLE "0" CACHE STRING "Forward UWB diagnostic status lines over BLE")
set(APP_TAG_BLE_NAME_PREFIX "" CACHE STRING "Optional BLE name prefix prepended before BSxxxx")
set(APP_TAG_STREAM_FORCE_OFF_AT_BOOT "0" CACHE STRING "Force STREAM OFF on every boot regardless of persisted setting")
set(APP_TAG_FW_MARKER "unified-default" CACHE STRING "Runtime firmware marker printed at boot for OTA validation")
set(APP_ALT_SS_TWR_ENABLE "1" CACHE STRING "Enable experimental burst-poll SS-TWR protocol")
set(APP_ALT_SS_TWR_BCAST_ENABLE "1" CACHE STRING "Enable clean broadcast Alt SS-TWR path")
set(APP_ALT_SS_TWR_MODE "2" CACHE STRING "Alt SS-TWR mode: 1=unicast burst, 2=broadcast mask")
set(APP_ALT_SS_TWR_POLL_SPACING_US "200" CACHE STRING "Alt SS-TWR spacing between burst polls in microseconds")
set(APP_ALT_SS_TWR_GUARD_US "1200" CACHE STRING "Alt SS-TWR guard time after poll burst in microseconds")
set(APP_ALT_SS_TWR_RESP_SPACING_US "1000" CACHE STRING "Alt SS-TWR spacing between anchor response slots in microseconds")
set(APP_ALT_SS_TWR_BCAST_FORCE_FULL_SWEEP "1" CACHE STRING "Force broadcast Alt SS-TWR sweeps to use all configured anchors")
set(APP_ALT_SS_TWR_LIGHT_TDMA_ENABLE "1" CACHE STRING "Use broadcast-dedicated lightweight TDMA scheduler")
set(APP_ALT_SS_TWR_BCAST_IMMEDIATE_TX_ENABLE "0" CACHE STRING "Use immediate TX for broadcast Alt SS-TWR poll frames")
set(APP_ALT_SS_TWR_BCAST_PREWRITE_TX_ENABLE "0" CACHE STRING "Prewrite broadcast Alt SS-TWR poll TX buffer before the TDMA slot")
set(APP_TAG_ALT_BCAST_RANK_OFFSET_OVERRIDE "255" CACHE STRING "Broadcast responder rank offset override, 0-7. 255 keeps the normal automatic policy")
set(APP_TAG_ALT_POLL_DIAG_PERIOD_MS "5000" CACHE STRING "Alt SS-TWR poll timing diagnostic period in milliseconds")
set(APP_TAG_ALT_RXG_BLE_DIAG_ENABLE "0" CACHE STRING "Forward broadcast RX gap timing diagnostics over BLE")
if(NOT DEFINED APP_TAG_BLE_TOKEN_ID OR APP_TAG_BLE_TOKEN_ID STREQUAL "")
set(APP_TAG_BLE_TOKEN_ID "${APP_TAG_ID}" CACHE STRING "BLE identity token advertised in manufacturer data")
endif()
set(APP_UWB_CHANNEL "5" CACHE STRING "DW1000 UWB channel number")
set(APP_UWB_PAN_ID "0xDECA" CACHE STRING "DW1000 PAN ID")
# MAC/PAN/address frame acceptance only; this does not filter range values.
set(APP_UWB_HW_FRAME_FILTER_ENABLE "1" CACHE STRING "Enable DW1000 hardware frame filtering")

target_include_directories(app PRIVATE ${APP_ROOT}/include)
target_include_directories(app PRIVATE ${APP_ROOT}/drivers/dw1000/include)
target_include_directories(app PRIVATE ${CMAKE_CURRENT_LIST_DIR}/src)
target_compile_definitions(app PRIVATE
    APP_TAG_ID=${APP_TAG_ID}
    APP_TAG_ANCHOR_COUNT=${APP_TAG_ANCHOR_COUNT}
    APP_TAG_ANCHOR_0_ID=${APP_TAG_ANCHOR_0_ID}
    APP_TAG_ANCHOR_1_ID=${APP_TAG_ANCHOR_1_ID}
    APP_TAG_ANCHOR_2_ID=${APP_TAG_ANCHOR_2_ID}
    APP_TAG_ANCHOR_3_ID=${APP_TAG_ANCHOR_3_ID}
    APP_TAG_ANCHOR_4_ID=${APP_TAG_ANCHOR_4_ID}
    APP_TAG_ANCHOR_5_ID=${APP_TAG_ANCHOR_5_ID}
    APP_TAG_ANCHOR_6_ID=${APP_TAG_ANCHOR_6_ID}
    APP_TAG_ANCHOR_7_ID=${APP_TAG_ANCHOR_7_ID}
    APP_TAG_RNG_DELAY_MS=${APP_TAG_RNG_DELAY_MS}
    APP_TAG_CAL_RNG_SETTLE_US=${APP_TAG_CAL_RNG_SETTLE_US}
    APP_TAG_TX_TO_RX_DLY_UUS=${APP_TAG_TX_TO_RX_DLY_UUS}
    APP_TAG_RESP_RX_TIMEOUT_UUS=${APP_TAG_RESP_RX_TIMEOUT_UUS}
    APP_TAG_NORMAL_OUTPUT_ENABLE=${APP_TAG_NORMAL_OUTPUT_ENABLE}
    APP_TAG_CIR_FEATURE_OUTPUT_ENABLE=${APP_TAG_CIR_FEATURE_OUTPUT_ENABLE}
    APP_TAG_CIR_FEATURE_OUTPUT_BLE_ENABLE=${APP_TAG_CIR_FEATURE_OUTPUT_BLE_ENABLE}
    APP_TAG_CIR_FULL_OUTPUT_ENABLE=${APP_TAG_CIR_FULL_OUTPUT_ENABLE}
    APP_TAG_CIR_FULL_OUTPUT_CDC_ENABLE=${APP_TAG_CIR_FULL_OUTPUT_CDC_ENABLE}
    APP_TAG_CIR_FULL_CHUNK_BYTES=${APP_TAG_CIR_FULL_CHUNK_BYTES}
    APP_TAG_CIR_FULL_PRIORITY_MASK=${APP_TAG_CIR_FULL_PRIORITY_MASK}
    APP_TAG_CIR_COMPACT_SAMPLE_PERIOD=${APP_TAG_CIR_COMPACT_SAMPLE_PERIOD}
    APP_TAG_RF_DIAG_OUTPUT_ENABLE=${APP_TAG_RF_DIAG_OUTPUT_ENABLE}
    APP_TAG_RF_DIAG_OUTPUT_BLE_ENABLE=${APP_TAG_RF_DIAG_OUTPUT_BLE_ENABLE}
    APP_TAG_RF_DIAG_OUTPUT_PERIOD=${APP_TAG_RF_DIAG_OUTPUT_PERIOD}
    APP_TAG_RF_DIAG_LEGACY_RFD_ENABLE=${APP_TAG_RF_DIAG_LEGACY_RFD_ENABLE}
    APP_TAG_TR_RF_DIAG_COMPACT_ENABLE=${APP_TAG_TR_RF_DIAG_COMPACT_ENABLE}
    APP_TAG_RF_DIAG_TAG_RX_ENABLE=${APP_TAG_RF_DIAG_TAG_RX_ENABLE}
    APP_TAG_VERBOSE_RANGING=${APP_TAG_VERBOSE_RANGING}
    APP_TAG_VERBOSE_MEASUREMENTS=${APP_TAG_VERBOSE_MEASUREMENTS}
    APP_TAG_USB_MIRROR_BLE_STATUS=${APP_TAG_USB_MIRROR_BLE_STATUS}
    APP_TAG_MULTITAG_PLAN_MODE=${APP_TAG_MULTITAG_PLAN_MODE}
    APP_TAG_ACTIVE_ANCHOR_0_ID=${APP_TAG_ACTIVE_ANCHOR_0_ID}
    APP_TAG_ACTIVE_ANCHOR_1_ID=${APP_TAG_ACTIVE_ANCHOR_1_ID}
    APP_TAG_ACTIVE_ANCHOR_2_ID=${APP_TAG_ACTIVE_ANCHOR_2_ID}
    APP_TAG_ACTIVE_ANCHOR_3_ID=${APP_TAG_ACTIVE_ANCHOR_3_ID}
    APP_TAG_STANDBY_ANCHOR_0_ID=${APP_TAG_STANDBY_ANCHOR_0_ID}
    APP_TAG_STANDBY_ANCHOR_1_ID=${APP_TAG_STANDBY_ANCHOR_1_ID}
    APP_TAG_RESERVE_ANCHOR_0_ID=${APP_TAG_RESERVE_ANCHOR_0_ID}
    APP_TAG_RESERVE_ANCHOR_1_ID=${APP_TAG_RESERVE_ANCHOR_1_ID}
    APP_TAG_REFRESH_ANCHOR_BUDGET=${APP_TAG_REFRESH_ANCHOR_BUDGET}
    APP_TAG_REFRESH_INTERVAL=${APP_TAG_REFRESH_INTERVAL}
    APP_TAG_MAINTENANCE_FULL_INTERVAL=${APP_TAG_MAINTENANCE_FULL_INTERVAL}
    APP_TAG_TDMA_ENABLE=${APP_TAG_TDMA_ENABLE}
    APP_TAG_TDMA_SLOT_INDEX=${APP_TAG_TDMA_SLOT_INDEX}
    APP_TAG_TDMA_SLOT_COUNT=${APP_TAG_TDMA_SLOT_COUNT}
    APP_TAG_TDMA_SLOT_PERIOD_MS=${APP_TAG_TDMA_SLOT_PERIOD_MS}
    APP_TAG_TDMA_SLOT_ACTIVE_MS=${APP_TAG_TDMA_SLOT_ACTIVE_MS}
    APP_TAG_TDMA_SLOT_ACTIVE_US=${APP_TAG_TDMA_SLOT_ACTIVE_US}
    APP_TAG_LEGACY_STATIC_SLOT_DIVIDER=${APP_TAG_LEGACY_STATIC_SLOT_DIVIDER}
    APP_TAG_TR_BCAST_V2_ENABLE=${APP_TAG_TR_BCAST_V2_ENABLE}
    APP_TAG_BCAST_SUMMARY_ENABLE=${APP_TAG_BCAST_SUMMARY_ENABLE}
    APP_TAG_BCAST_SUMMARY_PERIOD_MS=${APP_TAG_BCAST_SUMMARY_PERIOD_MS}
    APP_TAG_SWEEP_DIAG_ENABLE=${APP_TAG_SWEEP_DIAG_ENABLE}
    APP_TAG_SWEEP_DIAG_PERIOD=${APP_TAG_SWEEP_DIAG_PERIOD}
    APP_TAG_BLE_ENABLE=${APP_TAG_BLE_ENABLE}
    APP_TAG_BLE_OTA_ENABLE=${APP_TAG_BLE_OTA_ENABLE}
    APP_TAG_USB_DIAG_TRACE=${APP_TAG_USB_DIAG_TRACE}
    APP_TAG_BLE_SETTINGS_ENABLE=${APP_TAG_BLE_SETTINGS_ENABLE}
    APP_TAG_UWB_ENABLE=${APP_TAG_UWB_ENABLE}
    APP_TAG_BLE_COMPACT_STATUS=${APP_TAG_BLE_COMPACT_STATUS}
    APP_TAG_BLE_PACKET_BUNDLE_RECORDS=${APP_TAG_BLE_PACKET_BUNDLE_RECORDS}
    APP_TAG_BLE_PACKET_BUNDLE_FLUSH_MS=${APP_TAG_BLE_PACKET_BUNDLE_FLUSH_MS}
    APP_TAG_BLE_TX_ITEM_COUNT=${APP_TAG_BLE_TX_ITEM_COUNT}
    APP_TAG_BLE_UWB_DIAG_OUTPUT_ENABLE=${APP_TAG_BLE_UWB_DIAG_OUTPUT_ENABLE}
    APP_TAG_BLE_NAME_PREFIX=\"${APP_TAG_BLE_NAME_PREFIX}\"
    APP_TAG_STREAM_FORCE_OFF_AT_BOOT=${APP_TAG_STREAM_FORCE_OFF_AT_BOOT}
    APP_TAG_FW_MARKER=\"${APP_TAG_FW_MARKER}\"
    APP_ALT_SS_TWR_ENABLE=${APP_ALT_SS_TWR_ENABLE}
    APP_ALT_SS_TWR_BCAST_ENABLE=${APP_ALT_SS_TWR_BCAST_ENABLE}
    APP_ALT_SS_TWR_MODE=${APP_ALT_SS_TWR_MODE}
    APP_ALT_SS_TWR_POLL_SPACING_US=${APP_ALT_SS_TWR_POLL_SPACING_US}
    APP_ALT_SS_TWR_GUARD_US=${APP_ALT_SS_TWR_GUARD_US}
    APP_ALT_SS_TWR_RESP_SPACING_US=${APP_ALT_SS_TWR_RESP_SPACING_US}
    APP_ALT_SS_TWR_BCAST_FORCE_FULL_SWEEP=${APP_ALT_SS_TWR_BCAST_FORCE_FULL_SWEEP}
    APP_ALT_SS_TWR_LIGHT_TDMA_ENABLE=${APP_ALT_SS_TWR_LIGHT_TDMA_ENABLE}
    APP_ALT_SS_TWR_BCAST_IMMEDIATE_TX_ENABLE=${APP_ALT_SS_TWR_BCAST_IMMEDIATE_TX_ENABLE}
    APP_ALT_SS_TWR_BCAST_PREWRITE_TX_ENABLE=${APP_ALT_SS_TWR_BCAST_PREWRITE_TX_ENABLE}
    APP_TAG_ALT_BCAST_RANK_OFFSET_OVERRIDE=${APP_TAG_ALT_BCAST_RANK_OFFSET_OVERRIDE}
    APP_TAG_ALT_POLL_DIAG_PERIOD_MS=${APP_TAG_ALT_POLL_DIAG_PERIOD_MS}
    APP_TAG_ALT_RXG_BLE_DIAG_ENABLE=${APP_TAG_ALT_RXG_BLE_DIAG_ENABLE}
    APP_TAG_BLE_TOKEN_ID=${APP_TAG_BLE_TOKEN_ID}
    APP_TAG_MCUBOOT_ENABLE=${APP_TAG_MCUBOOT_ENABLE}
    APP_TAG_SELF_CONFIRM_MODE=${APP_TAG_SELF_CONFIRM_MODE}
    APP_TAG_SELF_CONFIRM_TIMEOUT_MS=${APP_TAG_SELF_CONFIRM_TIMEOUT_MS}
    APP_UWB_CHANNEL=${APP_UWB_CHANNEL}
    APP_UWB_PAN_ID=${APP_UWB_PAN_ID}
    APP_UWB_HW_FRAME_FILTER_ENABLE=${APP_UWB_HW_FRAME_FILTER_ENABLE}
)

target_sources(app PRIVATE
    src/main.c
    src/tag_app.c
    ${APP_ROOT}/src/uwb_bringup.c
    ${APP_ROOT}/src/uwb_port.c
    ${APP_ROOT}/src/uwb_ss_twr_shared.c
    ${APP_ROOT}/src/biospur_uart_link.c
    ${APP_ROOT}/src/uwb_tdma.c
    ${APP_ROOT}/src/broadcast_tdma.c
    ${APP_ROOT}/src/uwb_range_tracker.c
    ${APP_ROOT}/src/ss_twr_init.c
    ${APP_ROOT}/drivers/dw1000/src/deca_device.c
    ${APP_ROOT}/drivers/dw1000/src/deca_params_init.c
    ${APP_ROOT}/drivers/dw1000/src/deca_range_tables.c
)

if(APP_TAG_BLE_ENABLE)
    target_sources(app PRIVATE
        ${APP_ROOT}/apps/tag/src/uwb_tag_ble.c
    )
endif()
```

## prj.conf
```kconfig
CONFIG_GPIO=y
CONFIG_SPI=y
CONFIG_SERIAL=y
CONFIG_CONSOLE=y
CONFIG_UART_ASYNC_API=y
CONFIG_RING_BUFFER=y
CONFIG_UART_CONSOLE=n
CONFIG_RTT_CONSOLE=y
CONFIG_USE_SEGGER_RTT=y
CONFIG_SEGGER_RTT_MODE_NO_BLOCK_SKIP=y
CONFIG_PRINTK=y
CONFIG_LOG=y
CONFIG_LOG_BACKEND_UART=n
CONFIG_LOG_BACKEND_RTT=y
CONFIG_LOG_BACKEND_RTT_MODE_DROP=y
CONFIG_LOG_MODE_IMMEDIATE=y
CONFIG_LOG_DEFAULT_LEVEL=2
CONFIG_I2C=y
CONFIG_BT=y
CONFIG_BT_PERIPHERAL=y
CONFIG_BT_NUS=y
CONFIG_BT_DEVICE_NAME="BS_AUTO"
CONFIG_BT_LOG_LEVEL_WRN=y
CONFIG_BT_HCI_CORE_LOG_LEVEL_WRN=y
CONFIG_BT_HCI_DRIVER_LOG_LEVEL_WRN=y
CONFIG_BT_GATT_LOG_LEVEL_ERR=y
CONFIG_BT_MAX_CONN=1
CONFIG_BT_MAX_PAIRED=1
CONFIG_BT_SETTINGS=n
CONFIG_SETTINGS=y
CONFIG_SETTINGS_NVS=y
CONFIG_NVS=y
CONFIG_BT_USER_PHY_UPDATE=y
# Safe fallback when a runtime parameter update is refused or never applied.
# Capture avoids the 7.5 ms interval that beats against the UWB sweep window.
CONFIG_BT_PERIPHERAL_PREF_MIN_INT=350
CONFIG_BT_PERIPHERAL_PREF_MAX_INT=350
CONFIG_BT_PERIPHERAL_PREF_LATENCY=0
CONFIG_BT_PERIPHERAL_PREF_TIMEOUT=400
CONFIG_BOOTLOADER_MCUBOOT=y
CONFIG_MCUBOOT_BOOTUTIL_LIB=y
CONFIG_MCUBOOT_SIGNATURE_KEY_FILE="bootloader/mcuboot/root-rsa-2048.pem"
CONFIG_MCUBOOT_IMGTOOL_SIGN_VERSION="0.0.1+12"
CONFIG_FLASH=y
CONFIG_FLASH_PAGE_LAYOUT=y
CONFIG_FLASH_MAP=y
CONFIG_MPU_ALLOW_FLASH_WRITE=y
CONFIG_IMG_MANAGER=y
CONFIG_STREAM_FLASH=y
CONFIG_NET_BUF=y
CONFIG_ZCBOR=y
CONFIG_CRC=y
CONFIG_BASE64=y
CONFIG_MCUMGR=y
CONFIG_MCUMGR_GRP_IMG=y
CONFIG_MCUMGR_GRP_IMG_VERBOSE_ERR=y
CONFIG_MCUMGR_GRP_OS=y
CONFIG_MCUMGR_GRP_OS_BOOTLOADER_INFO=y
CONFIG_MCUMGR_GRP_OS_MCUMGR_PARAMS=y
CONFIG_MCUMGR_TRANSPORT_BT=y
CONFIG_MCUMGR_TRANSPORT_BT_PERM_RW=y
CONFIG_MCUMGR_TRANSPORT_BT_CONN_PARAM_CONTROL=y
CONFIG_MCUMGR_TRANSPORT_BT_REASSEMBLY=y
# The OTA master has exactly one request in flight and its largest 448-byte
# IMG_UPLOAD request is below 512 bytes including SMP/CBOR overhead.  Two
# buffers cover that request and its response without a permanently oversized
# four-buffer pool.
CONFIG_MCUMGR_TRANSPORT_NETBUF_SIZE=512
CONFIG_MCUMGR_TRANSPORT_NETBUF_COUNT=2
CONFIG_MCUMGR_TRANSPORT_WORKQUEUE_STACK_SIZE=3072
CONFIG_BT_L2CAP_TX_MTU=498
CONFIG_BT_BUF_ACL_RX_SIZE=502
CONFIG_BT_BUF_ACL_TX_SIZE=502
CONFIG_BT_BUF_ACL_RX_COUNT=3
CONFIG_BT_BUF_ACL_TX_COUNT=3
CONFIG_BT_L2CAP_TX_BUF_COUNT=3
CONFIG_BT_BUF_CMD_TX_COUNT=3
CONFIG_BT_BUF_EVT_RX_SIZE=255
CONFIG_BT_BUF_EVT_RX_COUNT=4
CONFIG_BT_CTLR_PHY_2M=y
CONFIG_BT_CTLR_DATA_LENGTH_MAX=251
CONFIG_MAIN_THREAD_PRIORITY=5
CONFIG_MAIN_STACK_SIZE=3584
CONFIG_SYSTEM_WORKQUEUE_STACK_SIZE=3072
CONFIG_ISR_STACK_SIZE=3072
CONFIG_RESET_ON_FATAL_ERROR=y
CONFIG_BT_RX_STACK_SIZE=1600

# This image has no C allocator callers.  Never infer a heap from whatever RAM
# happens to remain after linking.
CONFIG_COMMON_LIBC_MALLOC_ARENA_SIZE=0

# No kernel-heap caller is linked.  MCUmgr already uses its static 556-byte
# flash_img_context when this pool is zero.
CONFIG_HEAP_MEM_POOL_SIZE=0

# Keep the current conservative stack sizes until hardware high-water marks
# justify cuts.  Reports go to non-blocking RTT once per minute.
CONFIG_THREAD_ANALYZER=y
CONFIG_THREAD_ANALYZER_USE_PRINTK=y
CONFIG_THREAD_ANALYZER_AUTO=y
CONFIG_THREAD_ANALYZER_AUTO_INTERVAL=60
CONFIG_THREAD_ANALYZER_AUTO_STACK_SIZE=1024
CONFIG_THREAD_NAME=y
```

## src/tag_app.c
```c
#include <zephyr/kernel.h>
#if APP_TAG_MCUBOOT_ENABLE
#include <zephyr/dfu/mcuboot.h>
#endif
#include <zephyr/drivers/uart.h>
#include <zephyr/sys/printk.h>
#include <zephyr/sys/util.h>

#include "biospur_uart_link.h"
#include "ss_twr_init.h"
#include "uwb_bringup.h"
#include "uwb_port.h"
#include <deca_device_api.h>
#if APP_TAG_BLE_ENABLE
#include "uwb_tag_ble.h"
#endif

#ifndef APP_TAG_MCUBOOT_ENABLE
#define APP_TAG_MCUBOOT_ENABLE 1U
#endif

#ifndef APP_TAG_ID
#define APP_TAG_ID 0U
#endif

#ifndef APP_TAG_BLE_TOKEN_ID
#define APP_TAG_BLE_TOKEN_ID APP_TAG_ID
#endif

#ifndef APP_TAG_ANCHOR_COUNT
#define APP_TAG_ANCHOR_COUNT 8U
#endif

#ifndef APP_TAG_ANCHOR_0_ID
#define APP_TAG_ANCHOR_0_ID 0U
#endif

#ifndef APP_TAG_ANCHOR_1_ID
#define APP_TAG_ANCHOR_1_ID 1U
#endif

#ifndef APP_TAG_ANCHOR_2_ID
#define APP_TAG_ANCHOR_2_ID 2U
#endif

#ifndef APP_TAG_ANCHOR_3_ID
#define APP_TAG_ANCHOR_3_ID 3U
#endif

#ifndef APP_TAG_ANCHOR_4_ID
#define APP_TAG_ANCHOR_4_ID 4U
#endif

#ifndef APP_TAG_ANCHOR_5_ID
#define APP_TAG_ANCHOR_5_ID 5U
#endif

#ifndef APP_TAG_ANCHOR_6_ID
#define APP_TAG_ANCHOR_6_ID 6U
#endif

#ifndef APP_TAG_ANCHOR_7_ID
#define APP_TAG_ANCHOR_7_ID 7U
#endif

#ifndef APP_TAG_MULTITAG_PLAN_MODE
#define APP_TAG_MULTITAG_PLAN_MODE 0U
#endif

#ifndef APP_TAG_ACTIVE_ANCHOR_0_ID
#define APP_TAG_ACTIVE_ANCHOR_0_ID 0U
#endif

#ifndef APP_TAG_ACTIVE_ANCHOR_1_ID
#define APP_TAG_ACTIVE_ANCHOR_1_ID 1U
#endif

#ifndef APP_TAG_ACTIVE_ANCHOR_2_ID
#define APP_TAG_ACTIVE_ANCHOR_2_ID 4U
#endif

#ifndef APP_TAG_ACTIVE_ANCHOR_3_ID
#define APP_TAG_ACTIVE_ANCHOR_3_ID 5U
#endif

#ifndef APP_TAG_STANDBY_ANCHOR_0_ID
#define APP_TAG_STANDBY_ANCHOR_0_ID 2U
#endif

#ifndef APP_TAG_STANDBY_ANCHOR_1_ID
#define APP_TAG_STANDBY_ANCHOR_1_ID 6U
#endif

#ifndef APP_TAG_RESERVE_ANCHOR_0_ID
#define APP_TAG_RESERVE_ANCHOR_0_ID 3U
#endif

#ifndef APP_TAG_RESERVE_ANCHOR_1_ID
#define APP_TAG_RESERVE_ANCHOR_1_ID 7U
#endif

#if APP_TAG_USB_DIAG_TRACE
static void tag_diag_write(const char *msg)
{
    const struct device *console = DEVICE_DT_GET(DT_CHOSEN(zephyr_console));

    if (!device_is_ready(console) || msg == NULL) {
        return;
    }

    while (*msg != '\0') {
        uart_poll_out(console, *msg++);
    }
}
#endif

#ifndef APP_TAG_REFRESH_ANCHOR_BUDGET
#define APP_TAG_REFRESH_ANCHOR_BUDGET 1U
#endif

#ifndef APP_TAG_REFRESH_INTERVAL
#define APP_TAG_REFRESH_INTERVAL 10U
#endif

#ifndef APP_TAG_MAINTENANCE_FULL_INTERVAL
#define APP_TAG_MAINTENANCE_FULL_INTERVAL 100U
#endif

#ifndef APP_TAG_TDMA_ENABLE
#define APP_TAG_TDMA_ENABLE 0U
#endif

#ifndef APP_TAG_TDMA_SLOT_INDEX
#define APP_TAG_TDMA_SLOT_INDEX 0U
#endif

#ifndef APP_TAG_TDMA_SLOT_COUNT
#define APP_TAG_TDMA_SLOT_COUNT 1U
#endif

#ifndef APP_TAG_TDMA_SLOT_PERIOD_MS
#define APP_TAG_TDMA_SLOT_PERIOD_MS 25U
#endif

#ifndef APP_TAG_TDMA_SLOT_ACTIVE_MS
#define APP_TAG_TDMA_SLOT_ACTIVE_MS 20U
#endif

#ifndef APP_TAG_TDMA_SLOT_ACTIVE_US
#define APP_TAG_TDMA_SLOT_ACTIVE_US 0U
#endif

#ifndef APP_TAG_FW_MARKER
#define APP_TAG_FW_MARKER "unified-default"
#endif

#ifndef APP_TAG_UWB_ENABLE
#define APP_TAG_UWB_ENABLE 1U
#endif

#ifndef APP_TAG_OTP_DIAG
#define APP_TAG_OTP_DIAG 0U
#endif

static void tag_print_otp_diag(void)
{
#if APP_TAG_OTP_DIAG
    uint32 dev_id_port = 0U;
    uint32 otp_01c = 0U;
    uint32 otp_01d = 0U;
    uint32 otp_01e = 0U;
    uint16 otp_anchor_delay = 0U;
    uint16 otp_tag_delay = 0U;

    (void)uwb_port_set_spi_slow();
    (void)uwb_port_read_dev_id(&dev_id_port);
    dwt_otpread(0x01C, &otp_01c, 1);
    dwt_otpread(0x01D, &otp_01d, 1);
    dwt_otpread(0x01E, &otp_01e, 1);
    otp_anchor_delay = (uint16)(otp_01c & 0xFFFFU);
    otp_tag_delay = (uint16)((otp_01c >> 16) & 0xFFFFU);

    printk("OTP_DIAG port_devid=0x%08X dwt_devid=0x%08X otp_rev=0x%02X addr_01C=0x%08X addr_01D=0x%08X addr_01E=0x%08X anchor_delay=%u tag_delay=%u\n",
           (unsigned int)dev_id_port,
           (unsigned int)dwt_readdevid(),
           (unsigned int)dwt_otprevision(),
           (unsigned int)otp_01c,
           (unsigned int)otp_01d,
           (unsigned int)otp_01e,
           (unsigned int)otp_anchor_delay,
           (unsigned int)otp_tag_delay);

    {
        uint32 otp_words[0x20];
        int a;

        for (a = 0; a < 0x20; a++) {
            otp_words[a] = 0U;
            dwt_otpread((uint16)a, &otp_words[a], 1);
        }
        for (a = 0; a < 0x20; a += 4) {
            printk("OTP_DUMP[0x%02X] %08X %08X %08X %08X\n",
                   (unsigned int)a,
                   (unsigned int)otp_words[a], (unsigned int)otp_words[a + 1],
                   (unsigned int)otp_words[a + 2], (unsigned int)otp_words[a + 3]);
        }
        /* Vbat=V@3.3V(0x08.b0); Vtemp23=T@23C SAR(0x09.b0); tmeas_antcal=Tmeas@AntCal(0x09.b1);
         * xtrim=XTAL trim(0x1E low5); ant delay 0x1C: tag=high16 anchor=low16 */
        printk("OTP_DECODE ldotune=0x%08X partid=0x%08X lotid=0x%08X vbat=0x%02X vtemp23=0x%02X tmeas_antcal=0x%02X xtrim=0x%02X otprev=0x%02X ant_tag=%u ant_anchor=%u\n",
               (unsigned int)otp_words[0x04],
               (unsigned int)otp_words[0x06],
               (unsigned int)otp_words[0x07],
               (unsigned int)(otp_words[0x08] & 0xFFU),
               (unsigned int)(otp_words[0x09] & 0xFFU),
               (unsigned int)((otp_words[0x09] >> 8) & 0xFFU),
               (unsigned int)(otp_words[0x1E] & 0x1FU),
               (unsigned int)dwt_otprevision(),
               (unsigned int)((otp_words[0x1C] >> 16) & 0xFFFFU),
               (unsigned int)(otp_words[0x1C] & 0xFFFFU));
    }
    (void)uwb_port_set_spi_fast();
#endif
}

int tag_app_run(void)
{
    static const uint8_t target_anchor_ids[] = {
        APP_TAG_ANCHOR_0_ID,
        APP_TAG_ANCHOR_1_ID,
        APP_TAG_ANCHOR_2_ID,
        APP_TAG_ANCHOR_3_ID,
        APP_TAG_ANCHOR_4_ID,
        APP_TAG_ANCHOR_5_ID,
        APP_TAG_ANCHOR_6_ID,
        APP_TAG_ANCHOR_7_ID,
    };
    static const uint8_t active_anchor_ids[] = {
        APP_TAG_ACTIVE_ANCHOR_0_ID,
        APP_TAG_ACTIVE_ANCHOR_1_ID,
        APP_TAG_ACTIVE_ANCHOR_2_ID,
        APP_TAG_ACTIVE_ANCHOR_3_ID,
    };
    static const uint8_t standby_anchor_ids[] = {
        APP_TAG_STANDBY_ANCHOR_0_ID,
        APP_TAG_STANDBY_ANCHOR_1_ID,
    };
    static const uint8_t reserve_anchor_ids[] = {
        APP_TAG_RESERVE_ANCHOR_0_ID,
        APP_TAG_RESERVE_ANCHOR_1_ID,
    };
    struct uwb_tag_runtime_config runtime_config = {
        .identity_code = 0U,
        .tag_id = 0U,
        .slot_source = UWB_TAG_SLOT_SOURCE_BUILD,
        .positioning_mode = UWB_TAG_MODE_RUN,
        .anchor_selection_mode = UWB_TAG_ANCHOR_SELECTION_DYNAMIC_2P2,
        .anchor_ids = target_anchor_ids,
        .anchor_count = APP_TAG_ANCHOR_COUNT,
        .fixed_anchor_mode = false,
        .fixed_anchor_ids = NULL,
        .fixed_anchor_count = 0U,
        .multitag_anchor_plan_mode = (APP_TAG_MULTITAG_PLAN_MODE != 0U),
        .active_anchor_ids = active_anchor_ids,
        .active_anchor_count = ARRAY_SIZE(active_anchor_ids),
        .standby_anchor_ids = standby_anchor_ids,
        .standby_anchor_count = ARRAY_SIZE(standby_anchor_ids),
        .reserve_anchor_ids = reserve_anchor_ids,
        .reserve_anchor_count = ARRAY_SIZE(reserve_anchor_ids),
        .refresh_anchor_budget = APP_TAG_REFRESH_ANCHOR_BUDGET,
        .refresh_interval_sweeps = APP_TAG_REFRESH_INTERVAL,
        .full_sweep_interval_sweeps = APP_TAG_MAINTENANCE_FULL_INTERVAL,
        .tdma =
            {
                .enabled = (APP_TAG_TDMA_ENABLE != 0U),
                .slot_index = APP_TAG_TDMA_SLOT_INDEX,
                .slot_count = APP_TAG_TDMA_SLOT_COUNT,
                .slot_period_ms = APP_TAG_TDMA_SLOT_PERIOD_MS,
                .slot_active_ms = APP_TAG_TDMA_SLOT_ACTIVE_MS,
                .slot_active_us = APP_TAG_TDMA_SLOT_ACTIVE_US,
            },
    };
    int ret;

#if !APP_TAG_MCUBOOT_ENABLE
    printk("MCUboot disabled, running direct USB serial image\n");
#endif

    ret = biospur_uart_link_init();
    if (ret) {
        printk("BioSpur UART link init failed: %d\n", ret);
        return ret;
    }

#if APP_TAG_BLE_ENABLE
    ret = uwb_tag_ble_init();
    if (ret) {
        printk("Tag BLE init failed, continuing with UWB only: %d\n", ret);
    }
    runtime_config.identity_code = uwb_tag_ble_identity_code();
    runtime_config.tag_id = uwb_tag_ble_tag_id();
    {
        struct uwb_tag_runtime_params ble_params;

		if (uwb_tag_ble_runtime_config_get(&ble_params)) {
            if (ble_params.identity_code != 0U) {
                runtime_config.identity_code = ble_params.identity_code;
            }
            if (ble_params.logical_tag_id < UWB_MAX_TAGS) {
                runtime_config.tag_id = ble_params.logical_tag_id;
            }
            runtime_config.slot_source = ble_params.slot_source;
            runtime_config.positioning_mode = ble_params.positioning_mode;
            runtime_config.anchor_selection_mode =
                UWB_TAG_ANCHOR_SELECTION_DYNAMIC_2P2;
            runtime_config.fixed_anchor_mode = false;
            runtime_config.fixed_anchor_count = 0U;

            if (ble_params.tdma.slot_count != 0U &&
                ble_params.tdma.slot_period_ms != 0U &&
                ble_params.tdma.slot_active_ms != 0U) {
                runtime_config.tdma = ble_params.tdma;
            }
        }
    }

    if (runtime_config.tdma.enabled && runtime_config.tdma.slot_count != 0U) {
        printk("Tag TDMA runtime config: slot=%u/%u period=%u active=%u source=%u epoch_valid=%u gen=%u\n",
               (unsigned int)runtime_config.tdma.slot_index,
               (unsigned int)runtime_config.tdma.slot_count,
               (unsigned int)runtime_config.tdma.slot_period_ms,
               (unsigned int)runtime_config.tdma.slot_active_ms,
               (unsigned int)runtime_config.slot_source,
               (unsigned int)runtime_config.tdma.epoch_valid,
               (unsigned int)runtime_config.tdma.generation);
    } else {
        printk("Tag TDMA runtime config disabled\n");
    }
#else
    printk("Tag BLE disabled, running pure UWB/USB serial mode\n");
#endif

    if (APP_TAG_UWB_ENABLE) {
        printk("Tag UWB bringup starting\n");
        k_msleep(100);
        ret = uwb_hw_bringup_and_init();
        if (ret) {
            printk("Tag UWB bringup failed: %d\n", ret);
            return ret;
        }
        printk("Tag UWB bringup done\n");
        tag_print_otp_diag();
    } else {
        printk("Tag UWB disabled by build profile (BLE/OTA only)\n");
    }

#if APP_TAG_USB_DIAG_TRACE
    tag_diag_write("TAG_APP: handoff enter\n");
#endif
    printk("Tag firmware marker: %s\n", APP_TAG_FW_MARKER);
    printk("Tag app ready bs=BS%04X logical_tag=%u anchor_count=%u tdma=%u slot=%u/%u period=%u active=%u slot_src=%u mode=%s pmode=%u anchor_plan=dynamic range=instantaneous_unsmoothed\n",
           (unsigned int)runtime_config.identity_code,
           runtime_config.tag_id, APP_TAG_ANCHOR_COUNT,
           (unsigned int)runtime_config.tdma.enabled,
           (unsigned int)runtime_config.tdma.slot_index,
           (unsigned int)runtime_config.tdma.slot_count,
           (unsigned int)runtime_config.tdma.slot_period_ms,
           (unsigned int)runtime_config.tdma.slot_active_ms,
           (unsigned int)runtime_config.slot_source,
           (runtime_config.positioning_mode == UWB_TAG_MODE_IDLE) ? "IDLE" : "RUN",
           (unsigned int)runtime_config.positioning_mode);
    printk("Tag app anchors=[%u,%u,%u,%u,%u,%u,%u,%u] active=[%u,%u,%u,%u] standby=[%u,%u] reserve=[%u,%u] refresh=%u/%u full=%u\n",
           APP_TAG_ANCHOR_0_ID,
           APP_TAG_ANCHOR_1_ID, APP_TAG_ANCHOR_2_ID, APP_TAG_ANCHOR_3_ID,
           APP_TAG_ANCHOR_4_ID, APP_TAG_ANCHOR_5_ID, APP_TAG_ANCHOR_6_ID,
           APP_TAG_ANCHOR_7_ID,
           APP_TAG_ACTIVE_ANCHOR_0_ID,
           APP_TAG_ACTIVE_ANCHOR_1_ID, APP_TAG_ACTIVE_ANCHOR_2_ID,
           APP_TAG_ACTIVE_ANCHOR_3_ID, APP_TAG_STANDBY_ANCHOR_0_ID,
           APP_TAG_STANDBY_ANCHOR_1_ID, APP_TAG_RESERVE_ANCHOR_0_ID,
           APP_TAG_RESERVE_ANCHOR_1_ID, APP_TAG_REFRESH_ANCHOR_BUDGET,
           APP_TAG_REFRESH_INTERVAL, APP_TAG_MAINTENANCE_FULL_INTERVAL);
    if (APP_TAG_UWB_ENABLE) {
        printk("Tag app handoff: entering SS-TWR\n");
#if APP_TAG_BLE_ENABLE
        uwb_tag_ble_led_set_uwb_ready(true);
#endif
        ret = ss_twr_init_start_with_config(&runtime_config);
        if (ret) {
            printk("ss_twr_init_start_with_config failed: %d\n", ret);
#if APP_TAG_BLE_ENABLE
            uwb_tag_ble_led_set_uwb_ready(false);
#endif
            return ret;
        }
    } else {
        printk("Tag app handoff: UWB scheduler skipped (UWB disabled)\n");
        while (1) {
            k_sleep(K_SECONDS(1));
        }
    }

    return 0;
}
```

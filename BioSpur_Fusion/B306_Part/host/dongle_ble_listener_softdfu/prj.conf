## CMakeLists.txt
```
cmake_minimum_required(VERSION 3.20.0)

if(NOT ZEPHYR_MODULES)
  execute_process(
    COMMAND west list --format={abspath}
    WORKING_DIRECTORY ${CMAKE_CURRENT_LIST_DIR}
    OUTPUT_VARIABLE WEST_MODULES_RAW
    OUTPUT_STRIP_TRAILING_WHITESPACE
    RESULT_VARIABLE WEST_LIST_RESULT
  )
  if(WEST_LIST_RESULT EQUAL 0 AND WEST_MODULES_RAW)
    string(REPLACE "\n" ";" ZEPHYR_MODULES "${WEST_MODULES_RAW}")
  endif()
endif()

find_package(Zephyr REQUIRED HINTS $ENV{ZEPHYR_BASE})

project(BioSpur_BLE_Listener_SoftDFU)

# Reuse the audited observer implementation without editing the frozen UWB
# workspace. This Fusion-local add-on replaces the lossy 100 ms polling
# assumption with an event-driven CDC SET_LINE_CODING callback and uses the
# PCA10059's P0.19-to-RESET self-reset wiring.
set(UPSTREAM_LISTENER_MAIN
    "${CMAKE_CURRENT_LIST_DIR}/../../../../BioSpur_UWB_before_start/SS-TWR/alt-SS-TWR/broadcast/apps/ble_listener/src/main.c")

target_sources(app PRIVATE
  ${UPSTREAM_LISTENER_MAIN}
  src/soft_dfu.c
)
```

## prj.conf
```kconfig
CONFIG_SERIAL=y
CONFIG_CONSOLE=y
CONFIG_UART_CONSOLE=y
CONFIG_UART_INTERRUPT_DRIVEN=y
CONFIG_PRINTK=y
CONFIG_GPIO=y
CONFIG_DK_LIBRARY=y

CONFIG_USB_DEVICE_STACK=y
CONFIG_USB_CDC_ACM=y
CONFIG_UART_LINE_CTRL=y
CONFIG_CDC_ACM_DTE_RATE_CALLBACK_SUPPORT=y
CONFIG_REBOOT=y
CONFIG_USB_DEVICE_MANUFACTURER="BioSpur"
CONFIG_USB_DEVICE_PRODUCT="BioSpur_BLE_Listener"
CONFIG_USB_DEVICE_PID=0x10F3
CONFIG_USB_DEVICE_VID=0x2FE3

CONFIG_BT=y
CONFIG_BT_OBSERVER=y
CONFIG_BT_CENTRAL=n
CONFIG_BT_PERIPHERAL=n
CONFIG_BT_DEVICE_NAME="BioSpur_BLE_Listener"
CONFIG_BT_DEVICE_APPEARANCE=0

CONFIG_HEAP_MEM_POOL_SIZE=1024
CONFIG_COMMON_LIBC_MALLOC_ARENA_SIZE=0
CONFIG_MAIN_STACK_SIZE=4096
CONFIG_SYSTEM_WORKQUEUE_STACK_SIZE=2048
```

## listener_extra.conf
```kconfig
# Fusion-project build overlay for the independent nRF52840 dongle observer.
# Keep the allocator finite so this diagnostic image passes the production
# memory gate. The listener source already implements the 1200-baud software
# entry into Nordic Open DFU.
CONFIG_COMMON_LIBC_MALLOC_ARENA_SIZE=0
```

## src/soft_dfu.c
```c
#include <stdint.h>

#include <hal/nrf_gpio.h>

#include <zephyr/device.h>
#include <zephyr/devicetree.h>
#include <zephyr/drivers/uart/cdc_acm.h>
#include <zephyr/drivers/usb/usb_dc.h>
#include <zephyr/init.h>

#define DFU_TOUCH_BAUD 1200U
#define PCA10059_SELF_RESET_PIN NRF_GPIO_PIN_MAP(0, 19)

static const struct device *const cdc_console =
	DEVICE_DT_GET(DT_CHOSEN(zephyr_console));

static void dte_rate_changed(const struct device *dev, uint32_t rate)
{
	ARG_UNUSED(dev);

	if (rate != DFU_TOUCH_BAUD) {
		return;
	}

	/*
	 * Handle the USB class event itself instead of sampling the current baud
	 * every 100 ms. A short-lived 1200-baud touch can otherwise be missed.
	 *
	 * The stock PCA10059 Open USB bootloader enters DFU on pin reset. P0.19
	 * is physically wired back to RESET on this board, so driving it low is
	 * the software-controlled equivalent of pressing the reset button. A
	 * plain NVIC reset (even with GPREGRET=0xB1) does not hold this stock
	 * bootloader in DFU.
	 */
	(void)usb_dc_detach();
	nrf_gpio_cfg_output(PCA10059_SELF_RESET_PIN);
	nrf_gpio_pin_clear(PCA10059_SELF_RESET_PIN);
}

static int soft_dfu_init(void)
{
	if (!device_is_ready(cdc_console)) {
		return -ENODEV;
	}

	return cdc_acm_dte_rate_callback_set(cdc_console, dte_rate_changed);
}

SYS_INIT(soft_dfu_init, APPLICATION, 0);
```

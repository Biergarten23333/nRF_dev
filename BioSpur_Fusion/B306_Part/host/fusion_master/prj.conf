## CMakeLists.txt
```
# SPDX-License-Identifier: Apache-2.0

cmake_minimum_required(VERSION 3.20.0)
find_package(Zephyr REQUIRED HINTS $ENV{ZEPHYR_BASE})
project(biospur_fusion_master_bridge)

target_sources(app PRIVATE src/main.c src/led_panel.c)
target_include_directories(app PRIVATE ${CMAKE_CURRENT_SOURCE_DIR}/../../include)
target_include_directories(app PRIVATE ${CMAKE_CURRENT_SOURCE_DIR}/../include)
target_include_directories(app PRIVATE ${ZEPHYR_BASE}/subsys/bluetooth/host)
```

## Kconfig
```
mainmenu "BioSpur Fusion Master"

config BSF_CCC_FILTERED_REPRO
	bool "Reproduce the v15 UUID-filtered data-CCC discovery"
	default n
	help
	  Restore the v15 data CCC discovery request for one diagnostic image.
	  Production images enumerate descriptors and validate UUID 0x2902.

source "Kconfig.zephyr"
```

## prj.conf
```kconfig
# Diagnostic Fusion Master: B306 BLE data/telemetry -> RTT.
CONFIG_BT=y
CONFIG_BT_CENTRAL=y
CONFIG_BT_OBSERVER=y
CONFIG_BT_GATT_CLIENT=y
CONFIG_BT_HCI_VS_EVT_USER=y
CONFIG_BT_MAX_CONN=10
CONFIG_BT_DEVICE_NAME="BSF-FUSION-M"

CONFIG_BT_USER_PHY_UPDATE=y
CONFIG_BT_USER_DATA_LEN_UPDATE=y
CONFIG_BT_L2CAP_TX_MTU=247
CONFIG_BT_BUF_ACL_RX_SIZE=251
CONFIG_BT_BUF_ACL_TX_SIZE=251
CONFIG_BT_BUF_ACL_RX_COUNT=32
CONFIG_BT_CTLR_DATA_LENGTH_MAX=251
CONFIG_BT_ATT_TX_COUNT=32
CONFIG_BT_L2CAP_TX_BUF_COUNT=32
CONFIG_BT_BUF_ACL_TX_COUNT=32
CONFIG_BT_CTLR_SDC_MAX_CONN_EVENT_LEN_DEFAULT_OVERRIDE=y
CONFIG_BT_CTLR_SDC_MAX_CONN_EVENT_LEN_DEFAULT=5000
CONFIG_BT_CTLR_SDC_CENTRAL_ACL_EVENT_SPACING_DEFAULT=5000
CONFIG_BT_RX_STACK_SIZE=3072
CONFIG_NET_BUF_POOL_USAGE=y

CONFIG_PRINTK=y
CONFIG_CONSOLE=y
CONFIG_SERIAL=y
CONFIG_GPIO=y
CONFIG_UART_INTERRUPT_DRIVEN=y
CONFIG_RING_BUFFER=y
CONFIG_USB_DEVICE_STACK=y
CONFIG_USB_DEVICE_VID=0x2FE3
CONFIG_USB_DEVICE_PID=0x10F4
CONFIG_USB_DEVICE_PRODUCT="BioSpur Fusion Master"
CONFIG_USB_DEVICE_MANUFACTURER="BioSpur"
CONFIG_USB_CDC_ACM=y
CONFIG_USE_SEGGER_RTT=y
CONFIG_RTT_CONSOLE=y
CONFIG_UART_CONSOLE=n
CONFIG_SEGGER_RTT_MODE_NO_BLOCK_SKIP=y
CONFIG_SEGGER_RTT_BUFFER_SIZE_UP=8192
CONFIG_SEGGER_RTT_BUFFER_SIZE_DOWN=256

# No allocator caller is linked; never consume "all remaining RAM".
CONFIG_COMMON_LIBC_MALLOC_ARENA_SIZE=0
CONFIG_HEAP_MEM_POOL_SIZE=0

CONFIG_MAIN_STACK_SIZE=3072
CONFIG_SYSTEM_WORKQUEUE_STACK_SIZE=3072
CONFIG_THREAD_ANALYZER=y
CONFIG_THREAD_ANALYZER_USE_PRINTK=y
CONFIG_THREAD_ANALYZER_AUTO=y
CONFIG_THREAD_ANALYZER_AUTO_INTERVAL=60
CONFIG_THREAD_NAME=y
```

## ccc_repro.conf
```kconfig
CONFIG_BSF_CCC_FILTERED_REPRO=y
```

## boards/nrf52840dk_nrf52840.overlay
```dts
/ {
	zephyr,user {
		/* Keep RTT as Zephyr console; CDC is owned directly by the app. */
	};
};

&zephyr_udc0 {
	cdc_acm_uart0: cdc_acm_uart0 {
		compatible = "zephyr,cdc-acm-uart";
	};
};
```

## src/led_panel.c
```c
/*
 * Fixed-storage fault latch for the Fusion Master LED panel.
 *
 * SPDX-License-Identifier: Apache-2.0
 */

#include "led_panel.h"

#include <limits.h>
#include <string.h>

void fusion_led_fault_note(struct fusion_led_fault_latch *latch,
			   enum fusion_led_fault_class fault,
			   uint32_t amount)
{
	uint32_t remaining;

	if (latch == NULL || fault >= FUSION_LED_FAULT_CLASS_COUNT ||
	    amount == 0u) {
		return;
	}
	latch->mask |= 1u << (uint32_t)fault;
	remaining = UINT32_MAX - latch->count[fault];
	latch->count[fault] += amount > remaining ? remaining : amount;
}

void fusion_led_fault_clear(struct fusion_led_fault_latch *latch)
{
	if (latch != NULL) {
		memset(latch, 0, sizeof(*latch));
	}
}
```

## src/led_panel.h
```c
/*
 * Fixed-storage fault latch for the Fusion Master LED panel.
 *
 * SPDX-License-Identifier: Apache-2.0
 */

#ifndef BIOSPUR_FUSION_MASTER_LED_PANEL_H_
#define BIOSPUR_FUSION_MASTER_LED_PANEL_H_

#include <stdint.h>

enum fusion_led_fault_class {
	FUSION_LED_FAULT_CRC_HEADER = 0,
	FUSION_LED_FAULT_SEQUENCE,
	FUSION_LED_FAULT_QUEUE,
	FUSION_LED_FAULT_NOTIFY_UART,
	FUSION_LED_FAULT_DISCONNECT,
	FUSION_LED_FAULT_CLASS_COUNT,
};

struct fusion_led_fault_latch {
	uint32_t mask;
	uint32_t count[FUSION_LED_FAULT_CLASS_COUNT];
};

void fusion_led_fault_note(struct fusion_led_fault_latch *latch,
			   enum fusion_led_fault_class fault,
			   uint32_t amount);
void fusion_led_fault_clear(struct fusion_led_fault_latch *latch);

#endif /* BIOSPUR_FUSION_MASTER_LED_PANEL_H_ */
```

## src/timer_epoch.h
```c
#ifndef BIOSPUR_FUSION_TIMER_EPOCH_H
#define BIOSPUR_FUSION_TIMER_EPOCH_H

#include <stdint.h>

/*
 * Return the 64-bit value congruent with low modulo 2^32 that is nearest to
 * reference. The caller supplies a recent full-width timestamp from this node
 * (normally the preceding IMU base, otherwise UWB or telemetry).
 */
static inline uint64_t bsf_extend_low32_near(uint32_t low, uint64_t reference)
{
	const uint64_t period = UINT64_C(1) << 32;
	const uint64_t half = period >> 1;
	uint64_t candidate = (reference & ~(period - 1u)) | low;

	if (candidate < reference && reference - candidate > half) {
		candidate += period;
	} else if (candidate > reference && candidate - reference > half &&
		   candidate >= period) {
		candidate -= period;
	}
	return candidate;
}

#endif /* BIOSPUR_FUSION_TIMER_EPOCH_H */
```

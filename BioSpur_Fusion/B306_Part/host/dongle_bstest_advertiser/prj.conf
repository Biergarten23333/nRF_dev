## CMakeLists.txt
```
cmake_minimum_required(VERSION 3.20.0)

find_package(Zephyr REQUIRED HINTS $ENV{ZEPHYR_BASE})
project(BioSpur_BSTEST_Advertiser)

target_sources(app PRIVATE src/main.c)
```

## prj.conf
```kconfig
CONFIG_SERIAL=y
CONFIG_CONSOLE=y
CONFIG_UART_CONSOLE=y
CONFIG_UART_INTERRUPT_DRIVEN=y
CONFIG_PRINTK=y

CONFIG_USB_DEVICE_STACK=y
CONFIG_USB_CDC_ACM=y
CONFIG_UART_LINE_CTRL=y
CONFIG_REBOOT=y
CONFIG_USB_DEVICE_MANUFACTURER="BioSpur"
CONFIG_USB_DEVICE_PRODUCT="BioSpur_BSTEST_Advertiser"
CONFIG_USB_DEVICE_PID=0x10F4
CONFIG_USB_DEVICE_VID=0x2FE3

CONFIG_BT=y
CONFIG_BT_BROADCASTER=y
CONFIG_BT_OBSERVER=n
CONFIG_BT_CENTRAL=n
CONFIG_BT_PERIPHERAL=n
CONFIG_BT_DEVICE_NAME="BSBEEF"
CONFIG_BT_DEVICE_APPEARANCE=0

CONFIG_HEAP_MEM_POOL_SIZE=1024
CONFIG_COMMON_LIBC_MALLOC_ARENA_SIZE=0
CONFIG_MAIN_STACK_SIZE=2048
CONFIG_SYSTEM_WORKQUEUE_STACK_SIZE=1024
```

## src/main.c
```c
#include <errno.h>
#include <stdint.h>

#include <zephyr/bluetooth/bluetooth.h>
#include <zephyr/drivers/uart.h>
#include <zephyr/kernel.h>
#include <zephyr/sys/printk.h>
#include <zephyr/sys/reboot.h>
#include <zephyr/usb/usb_device.h>

#include <hal/nrf_power.h>

#define TEST_NAME "BSBEEF"
#define DFU_TOUCH_BAUD 1200U
#define BOOTLOADER_DFU_START 0xB1U

static const struct device *const cdc_console =
	DEVICE_DT_GET(DT_CHOSEN(zephyr_console));

static const uint8_t tag_token[] = {
	0xff, 0xff, 'B', 0xef, 0xef, 0xbe,
};

static const struct bt_data ad[] = {
	BT_DATA_BYTES(BT_DATA_FLAGS, BT_LE_AD_GENERAL | BT_LE_AD_NO_BREDR),
	BT_DATA(BT_DATA_NAME_COMPLETE, TEST_NAME, sizeof(TEST_NAME) - 1U),
	BT_DATA(BT_DATA_MANUFACTURER_DATA, tag_token, sizeof(tag_token)),
};

static void enter_dfu_bootloader(void)
{
	printk("BSTEST_DFU 1200-baud touch\n");
	k_msleep(80);
	nrf_power_gpregret_set(NRF_POWER, 0U, BOOTLOADER_DFU_START);
	sys_reboot(SYS_REBOOT_COLD);
}

int main(void)
{
	int err;

	err = usb_enable(NULL);
	if (err != 0 && err != -EALREADY) {
		printk("BSTEST_USB_FAIL err=%d\n", err);
	}

	err = bt_enable(NULL);
	if (err) {
		printk("BSTEST_BT_FAIL err=%d\n", err);
		return err;
	}

	err = bt_le_adv_start(BT_LE_ADV_NCONN, ad, ARRAY_SIZE(ad), NULL, 0);
	printk("BSTEST_READY name=%s token=BSBEEF connectable=0 adv_rc=%d\n",
	       TEST_NAME, err);
	if (err) {
		return err;
	}

	for (;;) {
		uint32_t baud = 0U;

		if (device_is_ready(cdc_console) &&
		    uart_line_ctrl_get(cdc_console, UART_LINE_CTRL_BAUD_RATE,
				       &baud) == 0 &&
		    baud == DFU_TOUCH_BAUD) {
			enter_dfu_bootloader();
		}
		k_sleep(K_MSEC(100));
	}

	return 0;
}
```

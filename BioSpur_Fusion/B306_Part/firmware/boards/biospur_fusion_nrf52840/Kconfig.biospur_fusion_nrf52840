## BioSpur_Fusion/B306_Part/firmware/boards/biospur_fusion_nrf52840/Kconfig.biospur_fusion_nrf52840
```kconfig
# BioSpur Fusion NINA-B306 board configuration

# SPDX-License-Identifier: Apache-2.0

config BOARD_BIOSPUR_FUSION_NRF52840
	select SOC_NRF52840_QIAA
```

## BioSpur_Fusion/B306_Part/firmware/boards/biospur_fusion_nrf52840/Kconfig.defconfig
```kconfig
# BioSpur Fusion NINA-B306 board configuration

# SPDX-License-Identifier: Apache-2.0

if BOARD_BIOSPUR_FUSION_NRF52840

config BT_CTLR
	default BT

endif # BOARD_BIOSPUR_FUSION_NRF52840
```

## BioSpur_Fusion/B306_Part/firmware/boards/biospur_fusion_nrf52840/board.yml
```yaml
board:
  name: biospur_fusion_nrf52840
  vendor: biospur
  socs:
    - name: nrf52840
```

## BioSpur_MultiNode_Gesture_System/build/tx_node/mcuboot/Kconfig/boards/Kconfig.nrf52840dk
```kconfig
# Load board Kconfig descriptions.
osource "/home/zekaixiao/ncs/v2.8.0/zephyr/boards/nordic/nrf52840dk/Kconfig.nrf52840dk"
```

## BioSpur_MultiNode_Gesture_System/central/build/Kconfig/arch/Kconfig
```kconfig
# Load Zephyr Arch Kconfig descriptions.
osource "/home/zekaixiao/ncs/v2.8.0/zephyr/arch/x86/Kconfig"
osource "/home/zekaixiao/ncs/v2.8.0/zephyr/arch/xtensa/Kconfig"
osource "/home/zekaixiao/ncs/v2.8.0/zephyr/arch/sparc/Kconfig"
osource "/home/zekaixiao/ncs/v2.8.0/zephyr/arch/riscv/Kconfig"
osource "/home/zekaixiao/ncs/v2.8.0/zephyr/arch/posix/Kconfig"
osource "/home/zekaixiao/ncs/v2.8.0/zephyr/arch/nios2/Kconfig"
osource "/home/zekaixiao/ncs/v2.8.0/zephyr/arch/mips/Kconfig"
osource "/home/zekaixiao/ncs/v2.8.0/zephyr/arch/arm64/Kconfig"
osource "/home/zekaixiao/ncs/v2.8.0/zephyr/arch/arm/Kconfig"
osource "/home/zekaixiao/ncs/v2.8.0/zephyr/arch/arc/Kconfig"
```

## BioSpur_UWB_before_start/127/Kconfig/boards/Kconfig.decawave_dwm1001_dev
```kconfig
# Load board Kconfig descriptions.
osource "/home/zekaixiao/ncs/v2.8.0/zephyr/boards/qorvo/decawave_dwm1001_dev/Kconfig.decawave_dwm1001_dev"
```

## BioSpur_UWB_before_start/127/Kconfig/boards/Kconfig.sysbuild
```kconfig
# Load Sysbuild board Kconfig descriptions.
osource "/home/zekaixiao/ncs/v2.8.0/zephyr/boards/qorvo/decawave_dwm1001_dev/Kconfig.sysbuild"
```

## BioSpur_UWB_before_start/127/mcuboot/Kconfig/boards/Kconfig.defconfig
```kconfig
# Load Zephyr board defconfig descriptions.
osource "/home/zekaixiao/ncs/v2.8.0/zephyr/boards/qorvo/decawave_dwm1001_dev/Kconfig.defconfig"
```

## BioSpur_UWB_before_start/2026-07-15-FREEZE/firmware/src/apps/master_ota/Kconfig
```kconfig
#
# Copyright (c) 2026
# SPDX-License-Identifier: Apache-2.0
#

mainmenu "BioSpur UWB master OTA"

source "Kconfig.zephyr"
```

## BioSpur_UWB_before_start/alt-SS-TWR/broadcast/UWB_listener/Kconfig
```kconfig
source "Kconfig.zephyr"

menu "BioSpur UWB listener"

config APP_LISTENER_UI_ENABLE
	bool "Enable listener LED/button/buzzer UI"
	default y

config APP_LISTENER_STATUS_PRINT_ENABLE
	bool "Enable listener human-readable status prints"
	default n

config APP_LISTENER_DEBUG_PRINT_ENABLE
	bool "Enable listener verbose debug prints"
	default n

endmenu
```

## SPI/build_1/Kconfig/Kconfig.shield
```kconfig
osource "/home/zekaixiao/Documents/nRF_dev/SPI/boards/shields/*/Kconfig.shield"
osource "/home/zekaixiao/Documents/nRF_dev/central_uart/boards/shields/*/Kconfig.shield"
osource "/home/zekaixiao/Documents/nRF_dev/JY901B/boards/shields/*/Kconfig.shield"
osource "/home/zekaixiao/ncs/v2.8.0/nrf/boards/shields/*/Kconfig.shield"
```

## SPI/build_1/Kconfig/Kconfig.shield.defconfig
```kconfig
osource "/home/zekaixiao/Documents/nRF_dev/SPI/boards/shields/*/Kconfig.defconfig"
osource "/home/zekaixiao/Documents/nRF_dev/central_uart/boards/shields/*/Kconfig.defconfig"
osource "/home/zekaixiao/Documents/nRF_dev/JY901B/boards/shields/*/Kconfig.defconfig"
osource "/home/zekaixiao/ncs/v2.8.0/nrf/boards/shields/*/Kconfig.defconfig"
```

## central_uart_nrf5340/build/Kconfig/boards/Kconfig.sysbuild
```kconfig
# Load Sysbuild board Kconfig descriptions.
osource "/home/zekaixiao/ncs/v2.8.0/zephyr/boards/nordic/nrf52840dk/Kconfig.sysbuild"
```

## central_uart_try_dongle/build/central_uart_try_dongle/Kconfig/boards/Kconfig.defconfig
```kconfig
# Load Zephyr board defconfig descriptions.
osource "/home/zekaixiao/ncs/v2.8.0/zephyr/boards/nordic/nrf52840dongle/Kconfig.defconfig"
```

## nRF54L15/build_nosys/Kconfig/boards/Kconfig.defconfig
```kconfig
# Load Zephyr board defconfig descriptions.
osource "/home/zekaixiao/ncs/v2.8.0/zephyr/boards/nordic/nrf54l15dk/Kconfig.defconfig"
```

## nRF54L15/build_nosys/Kconfig/boards/Kconfig.nrf54l15dk
```kconfig
# Load board Kconfig descriptions.
osource "/home/zekaixiao/ncs/v2.8.0/zephyr/boards/nordic/nrf54l15dk/Kconfig.nrf54l15dk"
```

## peripheral_uart_5340/build/peripheral_uart_5340/Kconfig/soc/Kconfig
```kconfig
# Load Zephyr SoC Kconfig descriptions.
osource "/home/zekaixiao/ncs/v2.8.0/zephyr/soc/xlnx/zynqmp/Kconfig"
osource "/home/zekaixiao/ncs/v2.8.0/zephyr/soc/xlnx/zynq7000/Kconfig"
osource "/home/zekaixiao/ncs/v2.8.0/zephyr/soc/xen/Kconfig"
osource "/home/zekaixiao/ncs/v2.8.0/zephyr/soc/ti/simplelink/Kconfig"
osource "/home/zekaixiao/ncs/v2.8.0/zephyr/soc/ti/lm3s6965/Kconfig"
osource "/home/zekaixiao/ncs/v2.8.0/zephyr/soc/ti/k3/Kconfig"
osource "/home/zekaixiao/ncs/v2.8.0/zephyr/soc/telink/tlsr/Kconfig"
osource "/home/zekaixiao/ncs/v2.8.0/zephyr/soc/starfive/jh71xx/Kconfig"
osource "/home/zekaixiao/ncs/v2.8.0/zephyr/soc/st/stm32/Kconfig"
osource "/home/zekaixiao/ncs/v2.8.0/zephyr/soc/snps/qemu_arc/Kconfig"
osource "/home/zekaixiao/ncs/v2.8.0/zephyr/soc/snps/nsim/arc_v/Kconfig"
osource "/home/zekaixiao/ncs/v2.8.0/zephyr/soc/snps/nsim/arc_classic/Kconfig"
osource "/home/zekaixiao/ncs/v2.8.0/zephyr/soc/snps/hsdk4xd/Kconfig"
osource "/home/zekaixiao/ncs/v2.8.0/zephyr/soc/snps/hsdk/Kconfig"
osource "/home/zekaixiao/ncs/v2.8.0/zephyr/soc/snps/emsk/Kconfig"
osource "/home/zekaixiao/ncs/v2.8.0/zephyr/soc/snps/emsdp/Kconfig"
osource "/home/zekaixiao/ncs/v2.8.0/zephyr/soc/snps/arc_iot/Kconfig"
osource "/home/zekaixiao/ncs/v2.8.0/zephyr/soc/silabs/Kconfig"
osource "/home/zekaixiao/ncs/v2.8.0/zephyr/soc/sifive/sifive_freedom/Kconfig"
osource "/home/zekaixiao/ncs/v2.8.0/zephyr/soc/sensry/Kconfig"
osource "/home/zekaixiao/ncs/v2.8.0/zephyr/soc/rockchip/Kconfig"
osource "/home/zekaixiao/ncs/v2.8.0/zephyr/soc/renode/riscv_virtual/Kconfig"
osource "/home/zekaixiao/ncs/v2.8.0/zephyr/soc/renesas/smartbond/Kconfig"
osource "/home/zekaixiao/ncs/v2.8.0/zephyr/soc/renesas/rzt2m/Kconfig"
osource "/home/zekaixiao/ncs/v2.8.0/zephyr/soc/renesas/rcar/Kconfig"
osource "/home/zekaixiao/ncs/v2.8.0/zephyr/soc/renesas/ra/Kconfig"
osource "/home/zekaixiao/ncs/v2.8.0/zephyr/soc/raspberrypi/Kconfig"
osource "/home/zekaixiao/ncs/v2.8.0/zephyr/soc/quicklogic/eos_s3/Kconfig"
osource "/home/zekaixiao/ncs/v2.8.0/zephyr/soc/qemu/virt_riscv/Kconfig"
osource "/home/zekaixiao/ncs/v2.8.0/zephyr/soc/qemu/malta/Kconfig"
osource "/home/zekaixiao/ncs/v2.8.0/zephyr/soc/openisa/rv32m1/Kconfig"
osource "/home/zekaixiao/ncs/v2.8.0/zephyr/soc/nxp/s32/Kconfig"
osource "/home/zekaixiao/ncs/v2.8.0/zephyr/soc/nxp/rw/Kconfig"
osource "/home/zekaixiao/ncs/v2.8.0/zephyr/soc/nxp/mcx/Kconfig"
osource "/home/zekaixiao/ncs/v2.8.0/zephyr/soc/nxp/lpc/Kconfig"
osource "/home/zekaixiao/ncs/v2.8.0/zephyr/soc/nxp/layerscape/Kconfig"
osource "/home/zekaixiao/ncs/v2.8.0/zephyr/soc/nxp/kinetis/Kconfig"
osource "/home/zekaixiao/ncs/v2.8.0/zephyr/soc/nxp/imxrt/Kconfig"
osource "/home/zekaixiao/ncs/v2.8.0/zephyr/soc/nxp/imx/Kconfig"
osource "/home/zekaixiao/ncs/v2.8.0/zephyr/soc/nuvoton/numicro/Kconfig"
osource "/home/zekaixiao/ncs/v2.8.0/zephyr/soc/nuvoton/numaker/Kconfig"
osource "/home/zekaixiao/ncs/v2.8.0/zephyr/soc/nuvoton/npcx/Kconfig"
osource "/home/zekaixiao/ncs/v2.8.0/zephyr/soc/nuvoton/npcm/Kconfig"
osource "/home/zekaixiao/ncs/v2.8.0/zephyr/soc/nordic/Kconfig"
osource "/home/zekaixiao/ncs/v2.8.0/zephyr/soc/neorv32/Kconfig"
osource "/home/zekaixiao/ncs/v2.8.0/zephyr/soc/native/inf_clock/Kconfig"
osource "/home/zekaixiao/ncs/v2.8.0/zephyr/soc/microchip/miv/Kconfig"
osource "/home/zekaixiao/ncs/v2.8.0/zephyr/soc/microchip/mec/Kconfig"
osource "/home/zekaixiao/ncs/v2.8.0/zephyr/soc/mediatek/mtk_adsp/Kconfig"
osource "/home/zekaixiao/ncs/v2.8.0/zephyr/soc/lowrisc/opentitan/Kconfig"
osource "/home/zekaixiao/ncs/v2.8.0/zephyr/soc/litex/litex_vexriscv/Kconfig"
osource "/home/zekaixiao/ncs/v2.8.0/zephyr/soc/ite/ec/Kconfig"
osource "/home/zekaixiao/ncs/v2.8.0/zephyr/soc/intel/raptor_lake/Kconfig"
osource "/home/zekaixiao/ncs/v2.8.0/zephyr/soc/intel/lakemont/Kconfig"
osource "/home/zekaixiao/ncs/v2.8.0/zephyr/soc/intel/intel_socfpga_std/Kconfig"
osource "/home/zekaixiao/ncs/v2.8.0/zephyr/soc/intel/intel_socfpga/Kconfig"
osource "/home/zekaixiao/ncs/v2.8.0/zephyr/soc/intel/intel_niosv/Kconfig"
osource "/home/zekaixiao/ncs/v2.8.0/zephyr/soc/intel/intel_ish/Kconfig"
osource "/home/zekaixiao/ncs/v2.8.0/zephyr/soc/intel/intel_adsp/Kconfig"
osource "/home/zekaixiao/ncs/v2.8.0/zephyr/soc/intel/elkhart_lake/Kconfig"
osource "/home/zekaixiao/ncs/v2.8.0/zephyr/soc/intel/atom/Kconfig"
osource "/home/zekaixiao/ncs/v2.8.0/zephyr/soc/intel/apollo_lake/Kconfig"
osource "/home/zekaixiao/ncs/v2.8.0/zephyr/soc/intel/alder_lake/Kconfig"
osource "/home/zekaixiao/ncs/v2.8.0/zephyr/soc/infineon/cat3/Kconfig"
osource "/home/zekaixiao/ncs/v2.8.0/zephyr/soc/infineon/cat1b/Kconfig"
osource "/home/zekaixiao/ncs/v2.8.0/zephyr/soc/infineon/cat1a/Kconfig"
osource "/home/zekaixiao/ncs/v2.8.0/zephyr/soc/gd/gd32/Kconfig"
osource "/home/zekaixiao/ncs/v2.8.0/zephyr/soc/gaisler/leon3/Kconfig"
osource "/home/zekaixiao/ncs/v2.8.0/zephyr/soc/gaisler/gr716a/Kconfig"
osource "/home/zekaixiao/ncs/v2.8.0/zephyr/soc/espressif/Kconfig"
osource "/home/zekaixiao/ncs/v2.8.0/zephyr/soc/ene/kb1200/Kconfig"
osource "/home/zekaixiao/ncs/v2.8.0/zephyr/soc/efinix/sapphire/Kconfig"
osource "/home/zekaixiao/ncs/v2.8.0/zephyr/soc/cdns/xtensa_sample_controller/Kconfig"
osource "/home/zekaixiao/ncs/v2.8.0/zephyr/soc/cdns/dc233c/Kconfig"
osource "/home/zekaixiao/ncs/v2.8.0/zephyr/soc/brcm/bcmvk/Kconfig"
osource "/home/zekaixiao/ncs/v2.8.0/zephyr/soc/brcm/bcm2712/Kconfig"
osource "/home/zekaixiao/ncs/v2.8.0/zephyr/soc/brcm/bcm2711/Kconfig"
osource "/home/zekaixiao/ncs/v2.8.0/zephyr/soc/atmel/sam0/Kconfig"
osource "/home/zekaixiao/ncs/v2.8.0/zephyr/soc/atmel/sam/Kconfig"
osource "/home/zekaixiao/ncs/v2.8.0/zephyr/soc/aspeed/Kconfig"
osource "/home/zekaixiao/ncs/v2.8.0/zephyr/soc/arm/Kconfig"
osource "/home/zekaixiao/ncs/v2.8.0/zephyr/soc/arm/beetle/Kconfig"
osource "/home/zekaixiao/ncs/v2.8.0/zephyr/soc/andestech/Kconfig"
osource "/home/zekaixiao/ncs/v2.8.0/zephyr/soc/ambiq/Kconfig"
osource "/home/zekaixiao/ncs/v2.8.0/zephyr/soc/altr/zephyr_nios2f/Kconfig"
osource "/home/zekaixiao/ncs/v2.8.0/zephyr/soc/altr/qemu_nios2/Kconfig"
osource "/home/zekaixiao/ncs/v2.8.0/zephyr/soc/adi/max32/Kconfig"
```

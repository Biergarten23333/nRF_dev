/ {
	nrf_radio_fem: nrf_radio_fem {
		compatible = "generic-fem-two-ctrl-pins";
		ctx-gpios = <&gpio1 8 GPIO_ACTIVE_HIGH>;
		crx-gpios = <&gpio1 9 GPIO_ACTIVE_HIGH>;
		ctx-settle-time-us = <23>;
		crx-settle-time-us = <5>;
		tx-gain-db = <10>;
		rx-gain-db = <5>;
	};
};

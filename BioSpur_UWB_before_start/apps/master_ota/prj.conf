## CMakeLists.txt
```
cmake_minimum_required(VERSION 3.20.0)

if(NOT ZEPHYR_MODULES)
  execute_process(
    COMMAND west list --format={abspath}
    WORKING_DIRECTORY ${CMAKE_CURRENT_LIST_DIR}
    OUTPUT_VARIABLE WEST_MODULES_RAW
    OUTPUT_STRIP_TRAILING_WHITESPACE
    RESULT_VARIABLE WEST_LIST_RESULT
  )
  if(WEST_LIST_RESULT EQUAL 0 AND WEST_MODULES_RAW)
    string(REPLACE "\n" ";" ZEPHYR_MODULES "${WEST_MODULES_RAW}")
  endif()
endif()

find_package(Zephyr REQUIRED HINTS $ENV{ZEPHYR_BASE})

project(BioSpur_UWB_master_ota)

set(APP_MASTER_OTA_TARGET_NAME "" CACHE STRING
    "Exact BLE device name to OTA; empty accepts any DFU SMP advertiser")
set(APP_MASTER_OTA_TARGET_NAME_PREFIX "BS" CACHE STRING
    "BLE device-name prefix to OTA when no exact name is provided")
set(APP_MASTER_OTA_TARGET_TOKEN_ID "-1" CACHE STRING
    "BioSpur manufacturer token tag ID to OTA; -1 accepts any token")

get_filename_component(NCS_BASE ${ZEPHYR_BASE} DIRECTORY)

target_include_directories(app PRIVATE
    ${CMAKE_CURRENT_LIST_DIR}/src
    ${CMAKE_CURRENT_LIST_DIR}/generated
    ${NCS_BASE}/modules/lib/zcbor/include
    ${ZEPHYR_BASE}/subsys/mgmt/mcumgr/util/include
)

target_compile_definitions(app PRIVATE
    ZCBOR_CANONICAL
    APP_MASTER_OTA_TARGET_NAME=\"${APP_MASTER_OTA_TARGET_NAME}\"
    APP_MASTER_OTA_TARGET_NAME_PREFIX=\"${APP_MASTER_OTA_TARGET_NAME_PREFIX}\"
    APP_MASTER_OTA_TARGET_TOKEN_ID=${APP_MASTER_OTA_TARGET_TOKEN_ID}
)

target_sources(app PRIVATE
    src/main.c
    ${NCS_BASE}/modules/lib/zcbor/src/zcbor_common.c
    ${NCS_BASE}/modules/lib/zcbor/src/zcbor_encode.c
    ${NCS_BASE}/modules/lib/zcbor/src/zcbor_decode.c
    ${ZEPHYR_BASE}/subsys/mgmt/mcumgr/util/src/zcbor_bulk.c
)
```

## Kconfig
```
#
# Copyright (c) 2026
# SPDX-License-Identifier: Apache-2.0
#

mainmenu "BioSpur UWB master OTA"

source "/home/zekaixiao/ncs/v2.8.0/zephyr/Kconfig.constants"
source "/home/zekaixiao/ncs/v2.8.0/nrf/lib/dk_buttons_and_leds/Kconfig"
source "/home/zekaixiao/ncs/v2.8.0/nrf/subsys/bluetooth/Kconfig"
source "/home/zekaixiao/ncs/v2.8.0/nrf/subsys/bluetooth/services/Kconfig"

source "Kconfig.zephyr"
```

## prj.conf
```kconfig
CONFIG_SERIAL=y
CONFIG_CONSOLE=y
CONFIG_UART_CONSOLE=y
CONFIG_PRINTK=y
CONFIG_GPIO=y
CONFIG_SETTINGS=y
CONFIG_DK_LIBRARY=y

CONFIG_BT=y
CONFIG_BT_CENTRAL=y
CONFIG_BT_OBSERVER=y
CONFIG_BT_SMP=y
CONFIG_BT_GATT_CLIENT=y
CONFIG_BT_GATT_DM=y
CONFIG_BT_SCAN=y
CONFIG_BT_SCAN_FILTER_ENABLE=y
CONFIG_BT_SCAN_UUID_CNT=1
CONFIG_BT_SCAN_NAME_CNT=1
CONFIG_BT_MAX_CONN=1
CONFIG_BT_SETTINGS=y
CONFIG_BT_GATT_CACHING=n
CONFIG_BT_L2CAP_TX_MTU=498
CONFIG_BT_BUF_ACL_RX_SIZE=502
CONFIG_BT_BUF_ACL_TX_SIZE=502
CONFIG_BT_CTLR_DATA_LENGTH_MAX=251
CONFIG_BT_DFU_SMP=y
CONFIG_BT_NUS_CLIENT=y
CONFIG_FLASH=y
CONFIG_USE_SEGGER_RTT=n

CONFIG_HEAP_MEM_POOL_SIZE=4096
CONFIG_MAIN_STACK_SIZE=4096
CONFIG_SYSTEM_WORKQUEUE_STACK_SIZE=2048
```

## boards/nrf54l15dk_nrf54l15_cpuapp.conf
```kconfig
#
# Copyright (c) 2026
# SPDX-License-Identifier: Apache-2.0
#

CONFIG_BT_LL_SOFTDEVICE_MULTIROLE=y
CONFIG_CHIP_MALLOC_SYS_HEAP_SIZE=10240
CONFIG_MPSL_WORK_STACK_SIZE=2048
CONFIG_SETTINGS_ZMS_SECTOR_COUNT=10
CONFIG_NVS=n
```

## src/master_ota.h
```c
#ifndef BIOSPUR_MASTER_OTA_H_
#define BIOSPUR_MASTER_OTA_H_

#include <stdbool.h>

#ifdef __cplusplus
extern "C" {
#endif

int master_ota_run(void);
void master_ota_target_reset(void);
int master_ota_target_set_token(int token_id);
int master_ota_target_set_name(const char *name);
int master_ota_target_set_prefix(const char *prefix);
int master_ota_target_set_uuid(const char *uuid_hex);
void master_ota_target_print(void);
int master_ota_initiate(void);
int master_ota_reset_target(void);
void master_ota_set_expect_nus(bool expect_nus);
void master_ota_prepare_mode_switch(void);

#ifdef __cplusplus
}
#endif

#endif /* BIOSPUR_MASTER_OTA_H_ */
```

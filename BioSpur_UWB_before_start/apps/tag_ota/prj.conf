## CMakeLists.txt
```
cmake_minimum_required(VERSION 3.20.0)

if(NOT ZEPHYR_MODULES)
  execute_process(
    COMMAND west list --format={abspath}
    WORKING_DIRECTORY ${CMAKE_CURRENT_LIST_DIR}
    OUTPUT_VARIABLE WEST_MODULES_RAW
    OUTPUT_STRIP_TRAILING_WHITESPACE
    RESULT_VARIABLE WEST_LIST_RESULT
  )
  if(WEST_LIST_RESULT EQUAL 0 AND WEST_MODULES_RAW)
    string(REPLACE "\n" ";" ZEPHYR_MODULES "${WEST_MODULES_RAW}")
  endif()
endif()

find_package(Zephyr REQUIRED HINTS $ENV{ZEPHYR_BASE})

project(BioSpur_UWB_tag_motion_ota)

if(DEFINED ENV{APP_TAG_PRELOAD_FILE} AND EXISTS $ENV{APP_TAG_PRELOAD_FILE})
  include($ENV{APP_TAG_PRELOAD_FILE})
endif()

set(APP_ROOT ${CMAKE_CURRENT_LIST_DIR}/../..)
if(NOT DEFINED APP_TAG_ID OR APP_TAG_ID STREQUAL "")
  set(APP_TAG_ID "0" CACHE STRING "Tag node ID")
endif()
if(NOT DEFINED APP_TAG_BLE_TOKEN_ID OR APP_TAG_BLE_TOKEN_ID STREQUAL "")
  set(APP_TAG_BLE_TOKEN_ID "${APP_TAG_ID}" CACHE STRING "BLE identity token advertised in manufacturer data")
endif()

set(APP_TAG_USB_DIAG_TRACE "0" CACHE STRING "Enable low-level console trace for bringup debugging")
set(APP_TAG_ANCHOR_COUNT "8" CACHE STRING "Number of anchors to range against")
set(APP_TAG_ANCHOR_0_ID "0" CACHE STRING "Anchor slot 0 ID")
set(APP_TAG_ANCHOR_1_ID "1" CACHE STRING "Anchor slot 1 ID")
set(APP_TAG_ANCHOR_2_ID "2" CACHE STRING "Anchor slot 2 ID")
set(APP_TAG_ANCHOR_3_ID "3" CACHE STRING "Anchor slot 3 ID")
set(APP_TAG_ANCHOR_4_ID "4" CACHE STRING "Anchor slot 4 ID")
set(APP_TAG_ANCHOR_5_ID "5" CACHE STRING "Anchor slot 5 ID")
set(APP_TAG_ANCHOR_6_ID "6" CACHE STRING "Anchor slot 6 ID")
set(APP_TAG_ANCHOR_7_ID "7" CACHE STRING "Anchor slot 7 ID")
set(APP_TAG_RNG_DELAY_MS "0" CACHE STRING "Delay between anchor polls in milliseconds")
set(APP_TAG_TX_TO_RX_DLY_UUS "140" CACHE STRING "Initiator RX enable delay after poll TX in UWB usec")
set(APP_TAG_RESP_RX_TIMEOUT_UUS "1800" CACHE STRING "Initiator response RX timeout in UWB usec")
set(APP_TAG_FAST_TRACKING "1" CACHE STRING "Use reduced anchor subset between periodic full sweeps")
set(APP_TAG_FULL_SWEEP_INTERVAL "4" CACHE STRING "Run one full 8-anchor sweep every N sweeps")
set(APP_TAG_TRACK_ANCHOR_COUNT "6" CACHE STRING "Anchor count used in fast tracking sweeps")
set(APP_TAG_SUMMARY_PERIOD "1" CACHE STRING "Print one motion summary every N completed sweeps")
set(APP_TAG_PENDING_PRINT_PERIOD "20" CACHE STRING "Print one solve-pending line every N failed sweeps")
set(APP_TAG_IMU_SAMPLE_PERIOD "8" CACHE STRING "Read the IMU once every N completed sweeps")
set(APP_TAG_CONSOLE_SUMMARY_ENABLE "1" CACHE STRING "Print motion summaries to the console")
set(APP_TAG_VERBOSE_RANGING "0" CACHE STRING "Print per-anchor ranging logs")
set(APP_TAG_VERBOSE_MEASUREMENTS "0" CACHE STRING "Print per-anchor measurement logs")
set(APP_TAG_VERBOSE_PERF "1" CACHE STRING "Print per-window performance summaries")
set(APP_TAG_RANGE_CONTINUITY_ENABLE "1" CACHE STRING "Enable per-anchor range continuity gating")
set(APP_TAG_USB_MIRROR_BLE_STATUS "0" CACHE STRING "Mirror BLE status summaries to USB serial for debug")
set(APP_TAG_LOC_MIN_QUALITY_PERCENT "50" CACHE STRING "Minimum per-anchor quality percentage accepted by the solver")
set(APP_TAG_FIXED_MODE "0" CACHE STRING "Use a fixed anchor subset instead of adaptive reselection")
set(APP_TAG_FIXED_ANCHOR_COUNT "4" CACHE STRING "Number of anchors in fixed-anchor mode")
set(APP_TAG_FIXED_ANCHOR_0_ID "1" CACHE STRING "Fixed-anchor slot 0 ID")
set(APP_TAG_FIXED_ANCHOR_1_ID "2" CACHE STRING "Fixed-anchor slot 1 ID")
set(APP_TAG_FIXED_ANCHOR_2_ID "5" CACHE STRING "Fixed-anchor slot 2 ID")
set(APP_TAG_FIXED_ANCHOR_3_ID "6" CACHE STRING "Fixed-anchor slot 3 ID")
set(APP_TAG_MULTITAG_PLAN_MODE "0" CACHE STRING "Enable active/standby/reserve multi-tag anchor plan")
set(APP_TAG_ACTIVE_ANCHOR_0_ID "0" CACHE STRING "Multi-tag active anchor slot 0 ID")
set(APP_TAG_ACTIVE_ANCHOR_1_ID "1" CACHE STRING "Multi-tag active anchor slot 1 ID")
set(APP_TAG_ACTIVE_ANCHOR_2_ID "4" CACHE STRING "Multi-tag active anchor slot 2 ID")
set(APP_TAG_ACTIVE_ANCHOR_3_ID "5" CACHE STRING "Multi-tag active anchor slot 3 ID")
set(APP_TAG_STANDBY_ANCHOR_0_ID "2" CACHE STRING "Multi-tag standby anchor slot 0 ID")
set(APP_TAG_STANDBY_ANCHOR_1_ID "6" CACHE STRING "Multi-tag standby anchor slot 1 ID")
set(APP_TAG_RESERVE_ANCHOR_0_ID "3" CACHE STRING "Multi-tag reserve anchor slot 0 ID")
set(APP_TAG_RESERVE_ANCHOR_1_ID "7" CACHE STRING "Multi-tag reserve anchor slot 1 ID")
set(APP_TAG_REFRESH_ANCHOR_BUDGET "1" CACHE STRING "Additional refresh anchors measured on refresh sweeps")
set(APP_TAG_REFRESH_INTERVAL "10" CACHE STRING "Run one refresh sweep every N sweeps in multi-tag mode")
set(APP_TAG_MAINTENANCE_FULL_INTERVAL "100" CACHE STRING "Run one full 8-anchor maintenance sweep every N sweeps in multi-tag mode")
set(APP_TAG_TDMA_ENABLE "0" CACHE STRING "Enable TDMA slot gating for this tag")
set(APP_TAG_TDMA_SLOT_INDEX "0" CACHE STRING "Zero-based TDMA slot index for this tag")
set(APP_TAG_TDMA_SLOT_COUNT "1" CACHE STRING "Total TDMA slot count in the cycle")
set(APP_TAG_TDMA_SLOT_PERIOD_MS "25" CACHE STRING "TDMA slot period in milliseconds")
set(APP_TAG_TDMA_SLOT_ACTIVE_MS "20" CACHE STRING "Usable active time within each slot in milliseconds")
set(APP_TAG_EKF_ENABLE "0" CACHE STRING "Enable the post-solve linear position filter (legacy EKF name)")
set(APP_TAG_EKF_MEAS_STD_MM "25" CACHE STRING "Base measurement standard deviation for the post-solve position filter")
set(APP_TAG_EKF_RESIDUAL_GAIN_PCT "0" CACHE STRING "Additional measurement std as a percent of residual hint")
set(APP_TAG_EKF_PROC_ACCEL_MM_S2 "250" CACHE STRING "Process acceleration standard deviation for the post-solve position filter")
set(APP_TAG_EKF_INIT_POS_STD_MM "200" CACHE STRING "Initial position standard deviation for the post-solve position filter")
set(APP_TAG_EKF_INIT_VEL_STD_MM_S "1000" CACHE STRING "Initial velocity standard deviation for the post-solve position filter")
set(APP_TAG_EKF_OUTLIER_GATE_MM "0" CACHE STRING "Reject position updates larger than this gate in millimeters (0 disables)")
set(APP_TAG_RANGE_SOFT_RESIDUAL_MM "180" CACHE STRING "Soft residual gate for per-anchor range continuity weighting")
set(APP_TAG_RANGE_HARD_RESIDUAL_MM "350" CACHE STRING "Hard residual gate for per-anchor range continuity rejection")
set(APP_TAG_OUTPUT_MAX_RMS_MM "0" CACHE STRING "Reject solved positions above this RMS residual in millimeters (0 disables)")
set(APP_TAG_OUTPUT_MAX_MAX_MM "0" CACHE STRING "Reject solved positions above this max residual in millimeters (0 disables)")
set(APP_TAG_OUTPUT_MAX_STEP_MM "0" CACHE STRING "Reject solved positions that jump more than this distance from the last accepted position in millimeters (0 disables)")
set(APP_TAG_MOTION_FULL_SWEEP_INTERVAL "0" CACHE STRING "Use a shorter full-sweep interval while in dynamic context (0 disables)")
set(APP_TAG_MOTION_SPEED_THRESHOLD_MM_S "250" CACHE STRING "Recent speed threshold used to classify dynamic context")
set(APP_TAG_MOTION_RANGE_SOFT_BONUS_MM "0" CACHE STRING "Additional continuity soft gate while in dynamic context")
set(APP_TAG_MOTION_RANGE_HARD_BONUS_MM "0" CACHE STRING "Additional continuity hard gate while in dynamic context")
set(APP_TAG_MOTION_EKF_MEAS_STD_MM "0" CACHE STRING "Override measurement std while in dynamic context (0 keeps base)")
set(APP_TAG_MOTION_EKF_PROC_ACCEL_MM_S2 "0" CACHE STRING "Override process acceleration std while in dynamic context (0 keeps base)")
set(APP_TAG_MOTION_EKF_OUTLIER_GATE_MM "0" CACHE STRING "Override outlier gate while in dynamic context (0 keeps base)")
set(APP_TAG_MOTION_IMU_DELTA_THRESHOLD_MG "750" CACHE STRING "IMU delta threshold used to classify dynamic context")
set(APP_TAG_MOTION_IMU_GRAVITY_ERR_THRESHOLD_MG "400" CACHE STRING "IMU gravity-error threshold used to classify dynamic context")
set(APP_TAG_BLE_ENABLE "1" CACHE STRING "Enable BLE/NUS and OTA transport on the tag")
set(APP_TAG_BLE_OTA_ENABLE "1" CACHE STRING "Enable OTA command and bootloader-advertising BLE payloads on the tag")
set(APP_TAG_BLE_SETTINGS_ENABLE "1" CACHE STRING "Enable Bluetooth settings persistence on the tag")
set(APP_TAG_MCUBOOT_ENABLE "1" CACHE STRING "Enable MCUboot confirm/OTA plumbing on the tag")
set(APP_TAG_BLE_COMPACT_STATUS "0" CACHE STRING "Enable compact BLE TagSummary payloads on the tag")
set(APP_TAG_BLE_PACKET_BUNDLE_RECORDS "1" CACHE STRING "Bundle this many TagSummary records into one BLE NUS payload")
set(APP_TAG_BLE_PACKET_BUNDLE_FLUSH_MS "0" CACHE STRING "Flush a partial BLE bundle after this many milliseconds (0 disables)")
set(APP_UWB_CHANNEL "5" CACHE STRING "DW1000 UWB channel number")
set(APP_UWB_PAN_ID "0xDECA" CACHE STRING "DW1000 PAN ID")

target_include_directories(app PRIVATE ${APP_ROOT}/include)
target_include_directories(app PRIVATE ${APP_ROOT}/drivers/dw1000/include)
target_include_directories(app PRIVATE ${CMAKE_CURRENT_LIST_DIR}/../tag/src)
target_compile_definitions(app PRIVATE
    APP_TAG_ID=${APP_TAG_ID}
    APP_TAG_ANCHOR_COUNT=${APP_TAG_ANCHOR_COUNT}
    APP_TAG_ANCHOR_0_ID=${APP_TAG_ANCHOR_0_ID}
    APP_TAG_ANCHOR_1_ID=${APP_TAG_ANCHOR_1_ID}
    APP_TAG_ANCHOR_2_ID=${APP_TAG_ANCHOR_2_ID}
    APP_TAG_ANCHOR_3_ID=${APP_TAG_ANCHOR_3_ID}
    APP_TAG_ANCHOR_4_ID=${APP_TAG_ANCHOR_4_ID}
    APP_TAG_ANCHOR_5_ID=${APP_TAG_ANCHOR_5_ID}
    APP_TAG_ANCHOR_6_ID=${APP_TAG_ANCHOR_6_ID}
    APP_TAG_ANCHOR_7_ID=${APP_TAG_ANCHOR_7_ID}
    APP_TAG_RNG_DELAY_MS=${APP_TAG_RNG_DELAY_MS}
    APP_TAG_TX_TO_RX_DLY_UUS=${APP_TAG_TX_TO_RX_DLY_UUS}
    APP_TAG_RESP_RX_TIMEOUT_UUS=${APP_TAG_RESP_RX_TIMEOUT_UUS}
    APP_TAG_FAST_TRACKING=${APP_TAG_FAST_TRACKING}
    APP_TAG_FULL_SWEEP_INTERVAL=${APP_TAG_FULL_SWEEP_INTERVAL}
    APP_TAG_TRACK_ANCHOR_COUNT=${APP_TAG_TRACK_ANCHOR_COUNT}
    APP_TAG_SUMMARY_PERIOD=${APP_TAG_SUMMARY_PERIOD}
    APP_TAG_PENDING_PRINT_PERIOD=${APP_TAG_PENDING_PRINT_PERIOD}
    APP_TAG_IMU_SAMPLE_PERIOD=${APP_TAG_IMU_SAMPLE_PERIOD}
    APP_TAG_CONSOLE_SUMMARY_ENABLE=${APP_TAG_CONSOLE_SUMMARY_ENABLE}
    APP_TAG_VERBOSE_RANGING=${APP_TAG_VERBOSE_RANGING}
    APP_TAG_VERBOSE_MEASUREMENTS=${APP_TAG_VERBOSE_MEASUREMENTS}
    APP_TAG_VERBOSE_PERF=${APP_TAG_VERBOSE_PERF}
    APP_TAG_RANGE_CONTINUITY_ENABLE=${APP_TAG_RANGE_CONTINUITY_ENABLE}
    APP_TAG_USB_MIRROR_BLE_STATUS=${APP_TAG_USB_MIRROR_BLE_STATUS}
    APP_TAG_LOC_MIN_QUALITY_PERCENT=${APP_TAG_LOC_MIN_QUALITY_PERCENT}
    APP_TAG_FIXED_MODE=${APP_TAG_FIXED_MODE}
    APP_TAG_FIXED_ANCHOR_COUNT=${APP_TAG_FIXED_ANCHOR_COUNT}
    APP_TAG_FIXED_ANCHOR_0_ID=${APP_TAG_FIXED_ANCHOR_0_ID}
    APP_TAG_FIXED_ANCHOR_1_ID=${APP_TAG_FIXED_ANCHOR_1_ID}
    APP_TAG_FIXED_ANCHOR_2_ID=${APP_TAG_FIXED_ANCHOR_2_ID}
    APP_TAG_FIXED_ANCHOR_3_ID=${APP_TAG_FIXED_ANCHOR_3_ID}
    APP_TAG_MULTITAG_PLAN_MODE=${APP_TAG_MULTITAG_PLAN_MODE}
    APP_TAG_ACTIVE_ANCHOR_0_ID=${APP_TAG_ACTIVE_ANCHOR_0_ID}
    APP_TAG_ACTIVE_ANCHOR_1_ID=${APP_TAG_ACTIVE_ANCHOR_1_ID}
    APP_TAG_ACTIVE_ANCHOR_2_ID=${APP_TAG_ACTIVE_ANCHOR_2_ID}
    APP_TAG_ACTIVE_ANCHOR_3_ID=${APP_TAG_ACTIVE_ANCHOR_3_ID}
    APP_TAG_STANDBY_ANCHOR_0_ID=${APP_TAG_STANDBY_ANCHOR_0_ID}
    APP_TAG_STANDBY_ANCHOR_1_ID=${APP_TAG_STANDBY_ANCHOR_1_ID}
    APP_TAG_RESERVE_ANCHOR_0_ID=${APP_TAG_RESERVE_ANCHOR_0_ID}
    APP_TAG_RESERVE_ANCHOR_1_ID=${APP_TAG_RESERVE_ANCHOR_1_ID}
    APP_TAG_REFRESH_ANCHOR_BUDGET=${APP_TAG_REFRESH_ANCHOR_BUDGET}
    APP_TAG_REFRESH_INTERVAL=${APP_TAG_REFRESH_INTERVAL}
    APP_TAG_MAINTENANCE_FULL_INTERVAL=${APP_TAG_MAINTENANCE_FULL_INTERVAL}
    APP_TAG_TDMA_ENABLE=${APP_TAG_TDMA_ENABLE}
    APP_TAG_TDMA_SLOT_INDEX=${APP_TAG_TDMA_SLOT_INDEX}
    APP_TAG_TDMA_SLOT_COUNT=${APP_TAG_TDMA_SLOT_COUNT}
    APP_TAG_TDMA_SLOT_PERIOD_MS=${APP_TAG_TDMA_SLOT_PERIOD_MS}
    APP_TAG_TDMA_SLOT_ACTIVE_MS=${APP_TAG_TDMA_SLOT_ACTIVE_MS}
    APP_TAG_EKF_ENABLE=${APP_TAG_EKF_ENABLE}
    APP_TAG_EKF_MEAS_STD_MM=${APP_TAG_EKF_MEAS_STD_MM}
    APP_TAG_EKF_RESIDUAL_GAIN_PCT=${APP_TAG_EKF_RESIDUAL_GAIN_PCT}
    APP_TAG_EKF_PROC_ACCEL_MM_S2=${APP_TAG_EKF_PROC_ACCEL_MM_S2}
    APP_TAG_EKF_INIT_POS_STD_MM=${APP_TAG_EKF_INIT_POS_STD_MM}
    APP_TAG_EKF_INIT_VEL_STD_MM_S=${APP_TAG_EKF_INIT_VEL_STD_MM_S}
    APP_TAG_EKF_OUTLIER_GATE_MM=${APP_TAG_EKF_OUTLIER_GATE_MM}
    APP_TAG_RANGE_SOFT_RESIDUAL_MM=${APP_TAG_RANGE_SOFT_RESIDUAL_MM}
    APP_TAG_RANGE_HARD_RESIDUAL_MM=${APP_TAG_RANGE_HARD_RESIDUAL_MM}
    APP_TAG_OUTPUT_MAX_RMS_MM=${APP_TAG_OUTPUT_MAX_RMS_MM}
    APP_TAG_OUTPUT_MAX_MAX_MM=${APP_TAG_OUTPUT_MAX_MAX_MM}
    APP_TAG_OUTPUT_MAX_STEP_MM=${APP_TAG_OUTPUT_MAX_STEP_MM}
    APP_TAG_MOTION_FULL_SWEEP_INTERVAL=${APP_TAG_MOTION_FULL_SWEEP_INTERVAL}
    APP_TAG_MOTION_SPEED_THRESHOLD_MM_S=${APP_TAG_MOTION_SPEED_THRESHOLD_MM_S}
    APP_TAG_MOTION_RANGE_SOFT_BONUS_MM=${APP_TAG_MOTION_RANGE_SOFT_BONUS_MM}
    APP_TAG_MOTION_RANGE_HARD_BONUS_MM=${APP_TAG_MOTION_RANGE_HARD_BONUS_MM}
    APP_TAG_MOTION_EKF_MEAS_STD_MM=${APP_TAG_MOTION_EKF_MEAS_STD_MM}
    APP_TAG_MOTION_EKF_PROC_ACCEL_MM_S2=${APP_TAG_MOTION_EKF_PROC_ACCEL_MM_S2}
    APP_TAG_MOTION_EKF_OUTLIER_GATE_MM=${APP_TAG_MOTION_EKF_OUTLIER_GATE_MM}
    APP_TAG_MOTION_IMU_DELTA_THRESHOLD_MG=${APP_TAG_MOTION_IMU_DELTA_THRESHOLD_MG}
    APP_TAG_MOTION_IMU_GRAVITY_ERR_THRESHOLD_MG=${APP_TAG_MOTION_IMU_GRAVITY_ERR_THRESHOLD_MG}
    APP_TAG_BLE_ENABLE=${APP_TAG_BLE_ENABLE}
    APP_TAG_BLE_OTA_ENABLE=${APP_TAG_BLE_OTA_ENABLE}
    APP_TAG_USB_DIAG_TRACE=${APP_TAG_USB_DIAG_TRACE}
    APP_TAG_BLE_SETTINGS_ENABLE=${APP_TAG_BLE_SETTINGS_ENABLE}
    APP_TAG_BLE_COMPACT_STATUS=${APP_TAG_BLE_COMPACT_STATUS}
    APP_TAG_BLE_PACKET_BUNDLE_RECORDS=${APP_TAG_BLE_PACKET_BUNDLE_RECORDS}
    APP_TAG_BLE_PACKET_BUNDLE_FLUSH_MS=${APP_TAG_BLE_PACKET_BUNDLE_FLUSH_MS}
    APP_TAG_BLE_TOKEN_ID=${APP_TAG_BLE_TOKEN_ID}
    APP_TAG_MCUBOOT_ENABLE=${APP_TAG_MCUBOOT_ENABLE}
    APP_UWB_CHANNEL=${APP_UWB_CHANNEL}
    APP_UWB_PAN_ID=${APP_UWB_PAN_ID}
)

target_sources(app PRIVATE
    ../tag/src/main.c
    ../tag/src/tag_app.c
    ${APP_ROOT}/src/uwb_bringup.c
    ${APP_ROOT}/src/uwb_port.c
    ${APP_ROOT}/src/uwb_anchor_layout.c
    ${APP_ROOT}/src/uwb_imu.c
    ${APP_ROOT}/src/uwb_ekf.c
    ${APP_ROOT}/src/uwb_motion.c
    ${APP_ROOT}/src/uwb_ss_twr_shared.c
    ${APP_ROOT}/src/uwb_tdma.c
    ${APP_ROOT}/src/uwb_range_tracker.c
    ${APP_ROOT}/src/uwb_tag_loc.c
    ${APP_ROOT}/src/ss_twr_init.c
    ${APP_ROOT}/drivers/dw1000/src/deca_device.c
    ${APP_ROOT}/drivers/dw1000/src/deca_params_init.c
    ${APP_ROOT}/drivers/dw1000/src/deca_range_tables.c
)

if(APP_TAG_BLE_ENABLE)
  target_sources(app PRIVATE
      ${APP_ROOT}/apps/tag/src/uwb_tag_ble.c
  )
endif()
```

## prj.conf
```kconfig
CONFIG_GPIO=y
CONFIG_SPI=y
CONFIG_I2C=y
CONFIG_SERIAL=y
CONFIG_CONSOLE=y
CONFIG_UART_CONSOLE=y
CONFIG_RTT_CONSOLE=n
CONFIG_USE_SEGGER_RTT=n
CONFIG_PRINTK=y
CONFIG_LOG=y
CONFIG_LOG_BACKEND_UART=y
CONFIG_LOG_MODE_IMMEDIATE=y
CONFIG_LOG_DEFAULT_LEVEL=2

CONFIG_BT=y
CONFIG_BT_PERIPHERAL=y
CONFIG_BT_NUS=y
CONFIG_BT_DEVICE_NAME="BS_AUTO"
CONFIG_BT_MAX_CONN=1
CONFIG_BT_MAX_PAIRED=1
CONFIG_BT_USER_PHY_UPDATE=y
CONFIG_BT_SETTINGS=n
CONFIG_SETTINGS=n
CONFIG_BT_PERIPHERAL_PREF_MIN_INT=6
CONFIG_BT_PERIPHERAL_PREF_MAX_INT=6
CONFIG_BT_PERIPHERAL_PREF_LATENCY=0
CONFIG_BT_PERIPHERAL_PREF_TIMEOUT=400

CONFIG_BOOTLOADER_MCUBOOT=y
CONFIG_MCUBOOT_BOOTUTIL_LIB=y
CONFIG_MCUBOOT_SIGNATURE_KEY_FILE="bootloader/mcuboot/root-rsa-2048.pem"
CONFIG_MCUBOOT_IMGTOOL_SIGN_VERSION="0.0.1+1"
CONFIG_FLASH=y
CONFIG_FLASH_PAGE_LAYOUT=y
CONFIG_FLASH_MAP=y
CONFIG_IMG_MANAGER=y
CONFIG_STREAM_FLASH=y

CONFIG_NET_BUF=y
CONFIG_ZCBOR=y
CONFIG_CRC=y
CONFIG_MCUMGR=y
CONFIG_MCUMGR_GRP_IMG=y
CONFIG_MCUMGR_GRP_IMG_VERBOSE_ERR=y
CONFIG_MCUMGR_GRP_IMG_LOG_LEVEL_DBG=y
CONFIG_MCUMGR_GRP_OS=y
CONFIG_MCUMGR_GRP_OS_BOOTLOADER_INFO=y
CONFIG_MCUMGR_GRP_OS_MCUMGR_PARAMS=y
CONFIG_MCUMGR_TRANSPORT_BT=y
CONFIG_MCUMGR_TRANSPORT_BT_PERM_RW=y
CONFIG_MCUMGR_TRANSPORT_BT_CONN_PARAM_CONTROL=y
CONFIG_MCUMGR_TRANSPORT_BT_REASSEMBLY=y
CONFIG_MCUMGR_TRANSPORT_NETBUF_SIZE=768
CONFIG_MCUMGR_TRANSPORT_WORKQUEUE_STACK_SIZE=3072

CONFIG_BT_L2CAP_TX_MTU=247
CONFIG_BT_BUF_ACL_RX_SIZE=251
CONFIG_BT_BUF_ACL_TX_SIZE=251
CONFIG_BT_BUF_ACL_RX_COUNT=8
CONFIG_BT_BUF_ACL_TX_COUNT=12
CONFIG_BT_L2CAP_TX_BUF_COUNT=12
CONFIG_BT_BUF_CMD_TX_COUNT=6
CONFIG_BT_BUF_EVT_RX_SIZE=255
CONFIG_BT_BUF_EVT_RX_COUNT=8
CONFIG_BT_CTLR_PHY_2M=y
CONFIG_BT_CTLR_DATA_LENGTH_MAX=251

CONFIG_MAIN_THREAD_PRIORITY=5
CONFIG_MAIN_STACK_SIZE=4096
CONFIG_SYSTEM_WORKQUEUE_STACK_SIZE=4096
CONFIG_ISR_STACK_SIZE=4096
CONFIG_RESET_ON_FATAL_ERROR=y
CONFIG_BT_RX_STACK_SIZE=1800
CONFIG_HEAP_MEM_POOL_SIZE=8192
```

## src/main.c
```c
#include <zephyr/kernel.h>
#include <zephyr/sys/printk.h>
#include <zephyr/dfu/mcuboot.h>

void start_smp_bluetooth_adverts(void);

int main(void)
{
	int confirmed;
	int rc;

	printk("Tag OTA SMP server starting\n");
	confirmed = boot_is_img_confirmed();
	printk("Tag OTA boot confirmed: %d\n", confirmed);
	if (!confirmed) {
		rc = boot_write_img_confirmed();
		if (rc) {
			printk("Tag OTA confirm failed: %d\n", rc);
		} else {
			printk("Tag OTA image confirmed\n");
		}
	}

	start_smp_bluetooth_adverts();
	printk("Tag OTA ready: BLE SMP transport + MCUboot\n");

	while (1) {
		k_sleep(K_SECONDS(1));
	}

	return 0;
}
```

## src/bluetooth.c
```c
/*
 * Minimal BLE SMP server for OTA testing.
 */

#include <zephyr/bluetooth/bluetooth.h>
#include <zephyr/bluetooth/conn.h>
#include <zephyr/bluetooth/gatt.h>
#include <zephyr/bluetooth/hci.h>
#include <zephyr/kernel.h>
#include <zephyr/mgmt/mcumgr/transport/smp_bt.h>

#include <zephyr/logging/log.h>
LOG_MODULE_REGISTER(tag_ota_ble, LOG_LEVEL_INF);

static struct k_work advertise_work;

static const struct bt_data ad[] = {
	BT_DATA_BYTES(BT_DATA_FLAGS, (BT_LE_AD_GENERAL | BT_LE_AD_NO_BREDR)),
	BT_DATA_BYTES(BT_DATA_UUID128_ALL,
		      0x84, 0xaa, 0x60, 0x74, 0x52, 0x8a, 0x8b, 0x86,
		      0xd3, 0x4c, 0xb7, 0x1d, 0x1d, 0xdc, 0x53, 0x8d),
};

static const struct bt_data sd[] = {
	BT_DATA(BT_DATA_NAME_COMPLETE, CONFIG_BT_DEVICE_NAME,
		sizeof(CONFIG_BT_DEVICE_NAME) - 1U),
};

static void advertise(struct k_work *work)
{
	int rc;

	rc = bt_le_adv_start(BT_LE_ADV_CONN, ad, ARRAY_SIZE(ad), sd, ARRAY_SIZE(sd));
	if (rc) {
		LOG_ERR("Advertising failed to start (rc %d)", rc);
		return;
	}

	LOG_INF("Advertising started as %s", CONFIG_BT_DEVICE_NAME);
}

static void connected(struct bt_conn *conn, uint8_t err)
{
	ARG_UNUSED(conn);

	if (err) {
		LOG_ERR("Connection failed, err 0x%02x %s", err, bt_hci_err_to_str(err));
	} else {
		LOG_INF("Connected");
	}

	k_work_submit(&advertise_work);
}

static void disconnected(struct bt_conn *conn, uint8_t reason)
{
	ARG_UNUSED(conn);
	LOG_INF("Disconnected, reason 0x%02x %s", reason, bt_hci_err_to_str(reason));
}

static void on_conn_recycled(void)
{
	k_work_submit(&advertise_work);
}

BT_CONN_CB_DEFINE(conn_callbacks) = {
	.connected = connected,
	.disconnected = disconnected,
	.recycled = on_conn_recycled,
};

static void bt_ready(int err)
{
	if (err != 0) {
		LOG_ERR("Bluetooth failed to initialise: %d", err);
	} else {
		k_work_submit(&advertise_work);
	}
}

void start_smp_bluetooth_adverts(void)
{
	int rc;

	k_work_init(&advertise_work, advertise);
	rc = bt_enable(bt_ready);

	if (rc != 0) {
		LOG_ERR("Bluetooth enable failed: %d", rc);
	}
}
```

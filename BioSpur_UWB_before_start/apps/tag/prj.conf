## CMakeLists.txt
```
cmake_minimum_required(VERSION 3.20.0)

if(NOT ZEPHYR_MODULES)
  execute_process(
    COMMAND west list --format={abspath}
    WORKING_DIRECTORY ${CMAKE_CURRENT_LIST_DIR}
    OUTPUT_VARIABLE WEST_MODULES_RAW
    OUTPUT_STRIP_TRAILING_WHITESPACE
    RESULT_VARIABLE WEST_LIST_RESULT
  )
  if(WEST_LIST_RESULT EQUAL 0 AND WEST_MODULES_RAW)
    string(REPLACE "\n" ";" ZEPHYR_MODULES "${WEST_MODULES_RAW}")
  endif()
endif()

find_package(Zephyr REQUIRED HINTS $ENV{ZEPHYR_BASE})

project(BioSpur_UWB_tag)

if(DEFINED ENV{APP_TAG_PRELOAD_FILE} AND EXISTS $ENV{APP_TAG_PRELOAD_FILE})
    include($ENV{APP_TAG_PRELOAD_FILE})
endif()

set(APP_ROOT ${CMAKE_CURRENT_LIST_DIR}/../..)
if(NOT DEFINED APP_TAG_ID OR APP_TAG_ID STREQUAL "")
set(APP_TAG_ID "0" CACHE STRING "Tag node ID")
endif()
set(APP_TAG_USB_DIAG_TRACE "0" CACHE STRING "Enable low-level console trace for bringup debugging")
set(APP_TAG_ANCHOR_COUNT "8" CACHE STRING "Number of anchors to range against")
set(APP_TAG_ANCHOR_0_ID "0" CACHE STRING "Anchor slot 0 ID")
set(APP_TAG_ANCHOR_1_ID "1" CACHE STRING "Anchor slot 1 ID")
set(APP_TAG_ANCHOR_2_ID "2" CACHE STRING "Anchor slot 2 ID")
set(APP_TAG_ANCHOR_3_ID "3" CACHE STRING "Anchor slot 3 ID")
set(APP_TAG_ANCHOR_4_ID "4" CACHE STRING "Anchor slot 4 ID")
set(APP_TAG_ANCHOR_5_ID "5" CACHE STRING "Anchor slot 5 ID")
set(APP_TAG_ANCHOR_6_ID "6" CACHE STRING "Anchor slot 6 ID")
set(APP_TAG_ANCHOR_7_ID "7" CACHE STRING "Anchor slot 7 ID")
set(APP_TAG_RNG_DELAY_MS "0" CACHE STRING "Delay between anchor polls in milliseconds")
set(APP_TAG_CAL_RNG_SETTLE_US "0" CACHE STRING "Calibration-mode settle time between anchor polls in microseconds")
set(APP_TAG_TX_TO_RX_DLY_UUS "140" CACHE STRING "Initiator RX enable delay after poll TX in UWB usec")
set(APP_TAG_RESP_RX_TIMEOUT_UUS "1800" CACHE STRING "Initiator response RX timeout in UWB usec")
set(APP_TAG_FAST_TRACKING "1" CACHE STRING "Use reduced anchor subset between periodic full sweeps")
set(APP_TAG_FULL_SWEEP_INTERVAL "4" CACHE STRING "Run one full 8-anchor sweep every N sweeps")
set(APP_TAG_TRACK_ANCHOR_COUNT "6" CACHE STRING "Anchor count used in fast tracking sweeps")
set(APP_TAG_SUMMARY_PERIOD "1" CACHE STRING "Print one motion summary every N completed sweeps")
set(APP_TAG_PENDING_PRINT_PERIOD "20" CACHE STRING "Print one solve-pending line every N failed sweeps")
set(APP_TAG_IMU_SAMPLE_PERIOD "8" CACHE STRING "Read the IMU once every N completed sweeps")
set(APP_TAG_CONSOLE_SUMMARY_ENABLE "1" CACHE STRING "Print motion summaries to the console")
set(APP_TAG_VERBOSE_RANGING "0" CACHE STRING "Print per-anchor ranging logs")
set(APP_TAG_VERBOSE_MEASUREMENTS "0" CACHE STRING "Print per-anchor measurement logs")
set(APP_TAG_VERBOSE_PERF "1" CACHE STRING "Print per-window performance summaries")
set(APP_TAG_RANGE_CONTINUITY_ENABLE "1" CACHE STRING "Enable per-anchor range continuity gating")
set(APP_TAG_USB_MIRROR_BLE_STATUS "0" CACHE STRING "Mirror BLE status summaries to USB serial for debug")
set(APP_TAG_LOC_MIN_QUALITY_PERCENT "50" CACHE STRING "Minimum per-anchor quality percentage accepted by the solver")
set(APP_TAG_FIXED_MODE "0" CACHE STRING "Use a fixed anchor subset instead of adaptive reselection")
set(APP_TAG_FIXED_ANCHOR_COUNT "4" CACHE STRING "Number of anchors in fixed-anchor mode")
set(APP_TAG_FIXED_ANCHOR_0_ID "1" CACHE STRING "Fixed-anchor slot 0 ID")
set(APP_TAG_FIXED_ANCHOR_1_ID "2" CACHE STRING "Fixed-anchor slot 1 ID")
set(APP_TAG_FIXED_ANCHOR_2_ID "5" CACHE STRING "Fixed-anchor slot 2 ID")
set(APP_TAG_FIXED_ANCHOR_3_ID "6" CACHE STRING "Fixed-anchor slot 3 ID")
set(APP_TAG_MULTITAG_PLAN_MODE "0" CACHE STRING "Enable active/standby/reserve multi-tag anchor plan")
set(APP_TAG_ACTIVE_ANCHOR_0_ID "0" CACHE STRING "Multi-tag active anchor slot 0 ID")
set(APP_TAG_ACTIVE_ANCHOR_1_ID "1" CACHE STRING "Multi-tag active anchor slot 1 ID")
set(APP_TAG_ACTIVE_ANCHOR_2_ID "4" CACHE STRING "Multi-tag active anchor slot 2 ID")
set(APP_TAG_ACTIVE_ANCHOR_3_ID "5" CACHE STRING "Multi-tag active anchor slot 3 ID")
set(APP_TAG_STANDBY_ANCHOR_0_ID "2" CACHE STRING "Multi-tag standby anchor slot 0 ID")
set(APP_TAG_STANDBY_ANCHOR_1_ID "6" CACHE STRING "Multi-tag standby anchor slot 1 ID")
set(APP_TAG_RESERVE_ANCHOR_0_ID "3" CACHE STRING "Multi-tag reserve anchor slot 0 ID")
set(APP_TAG_RESERVE_ANCHOR_1_ID "7" CACHE STRING "Multi-tag reserve anchor slot 1 ID")
set(APP_TAG_REFRESH_ANCHOR_BUDGET "1" CACHE STRING "Additional refresh anchors measured on refresh sweeps")
set(APP_TAG_REFRESH_INTERVAL "10" CACHE STRING "Run one refresh sweep every N sweeps in multi-tag mode")
set(APP_TAG_MAINTENANCE_FULL_INTERVAL "100" CACHE STRING "Run one full 8-anchor maintenance sweep every N sweeps in multi-tag mode")
set(APP_TAG_TDMA_ENABLE "0" CACHE STRING "Enable TDMA slot gating for this tag")
set(APP_TAG_TDMA_SLOT_INDEX "0" CACHE STRING "Zero-based TDMA slot index for this tag")
set(APP_TAG_TDMA_SLOT_COUNT "1" CACHE STRING "Total TDMA slot count in the cycle")
set(APP_TAG_TDMA_SLOT_PERIOD_MS "25" CACHE STRING "TDMA slot period in milliseconds")
set(APP_TAG_TDMA_SLOT_ACTIVE_MS "20" CACHE STRING "Usable active time within each slot in milliseconds")
set(APP_TAG_CAL_STATIC_SLOT_DIVIDER "1" CACHE STRING "Sample one CAL_STATIC slot out of every N TDMA slots")
set(APP_TAG_EKF_ENABLE "0" CACHE STRING "Enable the post-solve linear position filter (legacy EKF name)")
set(APP_TAG_EKF_MEAS_STD_MM "25" CACHE STRING "Base measurement standard deviation for the post-solve position filter")
set(APP_TAG_EKF_RESIDUAL_GAIN_PCT "0" CACHE STRING "Additional measurement std as a percent of residual hint")
set(APP_TAG_EKF_PROC_ACCEL_MM_S2 "250" CACHE STRING "Process acceleration standard deviation for the post-solve position filter")
set(APP_TAG_EKF_INIT_POS_STD_MM "200" CACHE STRING "Initial position standard deviation for the post-solve position filter")
set(APP_TAG_EKF_INIT_VEL_STD_MM_S "1000" CACHE STRING "Initial velocity standard deviation for the post-solve position filter")
set(APP_TAG_EKF_OUTLIER_GATE_MM "0" CACHE STRING "Reject position updates larger than this gate in millimeters (0 disables)")
set(APP_TAG_RANGE_SOFT_RESIDUAL_MM "180" CACHE STRING "Soft residual gate for per-anchor range continuity weighting")
set(APP_TAG_RANGE_HARD_RESIDUAL_MM "350" CACHE STRING "Hard residual gate for per-anchor range continuity rejection")
set(APP_TAG_OUTPUT_MAX_RMS_MM "0" CACHE STRING "Reject solved positions above this RMS residual in millimeters (0 disables)")
set(APP_TAG_OUTPUT_MAX_MAX_MM "0" CACHE STRING "Reject solved positions above this max residual in millimeters (0 disables)")
set(APP_TAG_OUTPUT_MAX_STEP_MM "0" CACHE STRING "Reject solved positions that jump more than this distance from the last accepted position in millimeters (0 disables)")
set(APP_TAG_MOTION_FULL_SWEEP_INTERVAL "0" CACHE STRING "Use a shorter full-sweep interval while in dynamic context (0 disables)")
set(APP_TAG_MOTION_SPEED_THRESHOLD_MM_S "250" CACHE STRING "Recent speed threshold used to classify dynamic context")
set(APP_TAG_MOTION_RANGE_SOFT_BONUS_MM "0" CACHE STRING "Additional continuity soft gate while in dynamic context")
set(APP_TAG_MOTION_RANGE_HARD_BONUS_MM "0" CACHE STRING "Additional continuity hard gate while in dynamic context")
set(APP_TAG_MOTION_EKF_MEAS_STD_MM "0" CACHE STRING "Override measurement std while in dynamic context (0 keeps base)")
set(APP_TAG_MOTION_EKF_PROC_ACCEL_MM_S2 "0" CACHE STRING "Override process acceleration std while in dynamic context (0 keeps base)")
set(APP_TAG_MOTION_EKF_OUTLIER_GATE_MM "0" CACHE STRING "Override outlier gate while in dynamic context (0 keeps base)")
set(APP_TAG_MOTION_IMU_DELTA_THRESHOLD_MG "750" CACHE STRING "IMU delta threshold used to classify dynamic context")
set(APP_TAG_MOTION_IMU_GRAVITY_ERR_THRESHOLD_MG "400" CACHE STRING "IMU gravity-error threshold used to classify dynamic context")
set(APP_TAG_BLE_ENABLE "1" CACHE STRING "Enable BLE/NUS and OTA transport on the tag")
set(APP_TAG_BLE_OTA_ENABLE "1" CACHE STRING "Enable OTA command and bootloader-advertising BLE payloads on the tag")
set(APP_TAG_BLE_SETTINGS_ENABLE "1" CACHE STRING "Enable Bluetooth settings persistence on the tag")
set(APP_TAG_MCUBOOT_ENABLE "1" CACHE STRING "Enable MCUboot confirm/OTA plumbing on the tag")
set(APP_TAG_UWB_ENABLE "1" CACHE STRING "Enable UWB ranging runtime on the tag (0 keeps BLE/OTA online only)")
set(APP_TAG_BLE_COMPACT_STATUS "1" CACHE STRING "Enable compact BLE TagSummary payloads on the tag")
set(APP_TAG_BLE_PACKET_BUNDLE_RECORDS "3" CACHE STRING "Bundle this many TagSummary records into one BLE NUS payload")
set(APP_TAG_BLE_PACKET_BUNDLE_FLUSH_MS "250" CACHE STRING "Flush a partial BLE bundle after this many milliseconds (0 disables)")
set(APP_TAG_BLE_NAME_PREFIX "" CACHE STRING "Optional BLE name prefix prepended before BSxxxx, for example Wand")
set(APP_TAG_WAND_MODE_ENABLE "0" CACHE STRING "Enable experimental Calibration Wand direct Tag-to-Tag sweep commands")
set(APP_TAG_STREAM_FORCE_OFF_AT_BOOT "0" CACHE STRING "Force STREAM OFF on every boot regardless of persisted setting")
set(APP_TAG_FW_MARKER "unified-default" CACHE STRING "Runtime firmware marker printed at boot for OTA validation")
set(APP_TAG_CALIBRATION_MODE "0" CACHE STRING "Calibration-role mode: ignore runtime TDMA settings/master slot commands")
if(NOT DEFINED APP_TAG_BLE_TOKEN_ID OR APP_TAG_BLE_TOKEN_ID STREQUAL "")
set(APP_TAG_BLE_TOKEN_ID "${APP_TAG_ID}" CACHE STRING "BLE identity token advertised in manufacturer data")
endif()
set(APP_UWB_CHANNEL "5" CACHE STRING "DW1000 UWB channel number")
set(APP_UWB_PAN_ID "0xDECA" CACHE STRING "DW1000 PAN ID")

target_include_directories(app PRIVATE ${APP_ROOT}/include)
target_include_directories(app PRIVATE ${APP_ROOT}/drivers/dw1000/include)
target_include_directories(app PRIVATE ${CMAKE_CURRENT_LIST_DIR}/src)
target_compile_definitions(app PRIVATE
    APP_TAG_ID=${APP_TAG_ID}
    APP_TAG_ANCHOR_COUNT=${APP_TAG_ANCHOR_COUNT}
    APP_TAG_ANCHOR_0_ID=${APP_TAG_ANCHOR_0_ID}
    APP_TAG_ANCHOR_1_ID=${APP_TAG_ANCHOR_1_ID}
    APP_TAG_ANCHOR_2_ID=${APP_TAG_ANCHOR_2_ID}
    APP_TAG_ANCHOR_3_ID=${APP_TAG_ANCHOR_3_ID}
    APP_TAG_ANCHOR_4_ID=${APP_TAG_ANCHOR_4_ID}
    APP_TAG_ANCHOR_5_ID=${APP_TAG_ANCHOR_5_ID}
    APP_TAG_ANCHOR_6_ID=${APP_TAG_ANCHOR_6_ID}
    APP_TAG_ANCHOR_7_ID=${APP_TAG_ANCHOR_7_ID}
    APP_TAG_RNG_DELAY_MS=${APP_TAG_RNG_DELAY_MS}
    APP_TAG_CAL_RNG_SETTLE_US=${APP_TAG_CAL_RNG_SETTLE_US}
    APP_TAG_TX_TO_RX_DLY_UUS=${APP_TAG_TX_TO_RX_DLY_UUS}
    APP_TAG_RESP_RX_TIMEOUT_UUS=${APP_TAG_RESP_RX_TIMEOUT_UUS}
    APP_TAG_FAST_TRACKING=${APP_TAG_FAST_TRACKING}
    APP_TAG_FULL_SWEEP_INTERVAL=${APP_TAG_FULL_SWEEP_INTERVAL}
    APP_TAG_TRACK_ANCHOR_COUNT=${APP_TAG_TRACK_ANCHOR_COUNT}
    APP_TAG_SUMMARY_PERIOD=${APP_TAG_SUMMARY_PERIOD}
    APP_TAG_PENDING_PRINT_PERIOD=${APP_TAG_PENDING_PRINT_PERIOD}
    APP_TAG_IMU_SAMPLE_PERIOD=${APP_TAG_IMU_SAMPLE_PERIOD}
    APP_TAG_CONSOLE_SUMMARY_ENABLE=${APP_TAG_CONSOLE_SUMMARY_ENABLE}
    APP_TAG_VERBOSE_RANGING=${APP_TAG_VERBOSE_RANGING}
    APP_TAG_VERBOSE_MEASUREMENTS=${APP_TAG_VERBOSE_MEASUREMENTS}
    APP_TAG_VERBOSE_PERF=${APP_TAG_VERBOSE_PERF}
    APP_TAG_RANGE_CONTINUITY_ENABLE=${APP_TAG_RANGE_CONTINUITY_ENABLE}
    APP_TAG_USB_MIRROR_BLE_STATUS=${APP_TAG_USB_MIRROR_BLE_STATUS}
    APP_TAG_LOC_MIN_QUALITY_PERCENT=${APP_TAG_LOC_MIN_QUALITY_PERCENT}
    APP_TAG_FIXED_MODE=${APP_TAG_FIXED_MODE}
    APP_TAG_FIXED_ANCHOR_COUNT=${APP_TAG_FIXED_ANCHOR_COUNT}
    APP_TAG_FIXED_ANCHOR_0_ID=${APP_TAG_FIXED_ANCHOR_0_ID}
    APP_TAG_FIXED_ANCHOR_1_ID=${APP_TAG_FIXED_ANCHOR_1_ID}
    APP_TAG_FIXED_ANCHOR_2_ID=${APP_TAG_FIXED_ANCHOR_2_ID}
    APP_TAG_FIXED_ANCHOR_3_ID=${APP_TAG_FIXED_ANCHOR_3_ID}
    APP_TAG_MULTITAG_PLAN_MODE=${APP_TAG_MULTITAG_PLAN_MODE}
    APP_TAG_ACTIVE_ANCHOR_0_ID=${APP_TAG_ACTIVE_ANCHOR_0_ID}
    APP_TAG_ACTIVE_ANCHOR_1_ID=${APP_TAG_ACTIVE_ANCHOR_1_ID}
    APP_TAG_ACTIVE_ANCHOR_2_ID=${APP_TAG_ACTIVE_ANCHOR_2_ID}
    APP_TAG_ACTIVE_ANCHOR_3_ID=${APP_TAG_ACTIVE_ANCHOR_3_ID}
    APP_TAG_STANDBY_ANCHOR_0_ID=${APP_TAG_STANDBY_ANCHOR_0_ID}
    APP_TAG_STANDBY_ANCHOR_1_ID=${APP_TAG_STANDBY_ANCHOR_1_ID}
    APP_TAG_RESERVE_ANCHOR_0_ID=${APP_TAG_RESERVE_ANCHOR_0_ID}
    APP_TAG_RESERVE_ANCHOR_1_ID=${APP_TAG_RESERVE_ANCHOR_1_ID}
    APP_TAG_REFRESH_ANCHOR_BUDGET=${APP_TAG_REFRESH_ANCHOR_BUDGET}
    APP_TAG_REFRESH_INTERVAL=${APP_TAG_REFRESH_INTERVAL}
    APP_TAG_MAINTENANCE_FULL_INTERVAL=${APP_TAG_MAINTENANCE_FULL_INTERVAL}
    APP_TAG_TDMA_ENABLE=${APP_TAG_TDMA_ENABLE}
    APP_TAG_TDMA_SLOT_INDEX=${APP_TAG_TDMA_SLOT_INDEX}
    APP_TAG_TDMA_SLOT_COUNT=${APP_TAG_TDMA_SLOT_COUNT}
    APP_TAG_TDMA_SLOT_PERIOD_MS=${APP_TAG_TDMA_SLOT_PERIOD_MS}
    APP_TAG_TDMA_SLOT_ACTIVE_MS=${APP_TAG_TDMA_SLOT_ACTIVE_MS}
    APP_TAG_CAL_STATIC_SLOT_DIVIDER=${APP_TAG_CAL_STATIC_SLOT_DIVIDER}
    APP_TAG_EKF_ENABLE=${APP_TAG_EKF_ENABLE}
    APP_TAG_EKF_MEAS_STD_MM=${APP_TAG_EKF_MEAS_STD_MM}
    APP_TAG_EKF_RESIDUAL_GAIN_PCT=${APP_TAG_EKF_RESIDUAL_GAIN_PCT}
    APP_TAG_EKF_PROC_ACCEL_MM_S2=${APP_TAG_EKF_PROC_ACCEL_MM_S2}
    APP_TAG_EKF_INIT_POS_STD_MM=${APP_TAG_EKF_INIT_POS_STD_MM}
    APP_TAG_EKF_INIT_VEL_STD_MM_S=${APP_TAG_EKF_INIT_VEL_STD_MM_S}
    APP_TAG_EKF_OUTLIER_GATE_MM=${APP_TAG_EKF_OUTLIER_GATE_MM}
    APP_TAG_RANGE_SOFT_RESIDUAL_MM=${APP_TAG_RANGE_SOFT_RESIDUAL_MM}
    APP_TAG_RANGE_HARD_RESIDUAL_MM=${APP_TAG_RANGE_HARD_RESIDUAL_MM}
    APP_TAG_OUTPUT_MAX_RMS_MM=${APP_TAG_OUTPUT_MAX_RMS_MM}
    APP_TAG_OUTPUT_MAX_MAX_MM=${APP_TAG_OUTPUT_MAX_MAX_MM}
    APP_TAG_OUTPUT_MAX_STEP_MM=${APP_TAG_OUTPUT_MAX_STEP_MM}
    APP_TAG_MOTION_FULL_SWEEP_INTERVAL=${APP_TAG_MOTION_FULL_SWEEP_INTERVAL}
    APP_TAG_MOTION_SPEED_THRESHOLD_MM_S=${APP_TAG_MOTION_SPEED_THRESHOLD_MM_S}
    APP_TAG_MOTION_RANGE_SOFT_BONUS_MM=${APP_TAG_MOTION_RANGE_SOFT_BONUS_MM}
    APP_TAG_MOTION_RANGE_HARD_BONUS_MM=${APP_TAG_MOTION_RANGE_HARD_BONUS_MM}
    APP_TAG_MOTION_EKF_MEAS_STD_MM=${APP_TAG_MOTION_EKF_MEAS_STD_MM}
    APP_TAG_MOTION_EKF_PROC_ACCEL_MM_S2=${APP_TAG_MOTION_EKF_PROC_ACCEL_MM_S2}
    APP_TAG_MOTION_EKF_OUTLIER_GATE_MM=${APP_TAG_MOTION_EKF_OUTLIER_GATE_MM}
    APP_TAG_MOTION_IMU_DELTA_THRESHOLD_MG=${APP_TAG_MOTION_IMU_DELTA_THRESHOLD_MG}
    APP_TAG_MOTION_IMU_GRAVITY_ERR_THRESHOLD_MG=${APP_TAG_MOTION_IMU_GRAVITY_ERR_THRESHOLD_MG}
    APP_TAG_BLE_ENABLE=${APP_TAG_BLE_ENABLE}
    APP_TAG_BLE_OTA_ENABLE=${APP_TAG_BLE_OTA_ENABLE}
    APP_TAG_USB_DIAG_TRACE=${APP_TAG_USB_DIAG_TRACE}
    APP_TAG_BLE_SETTINGS_ENABLE=${APP_TAG_BLE_SETTINGS_ENABLE}
    APP_TAG_UWB_ENABLE=${APP_TAG_UWB_ENABLE}
    APP_TAG_BLE_COMPACT_STATUS=${APP_TAG_BLE_COMPACT_STATUS}
    APP_TAG_BLE_PACKET_BUNDLE_RECORDS=${APP_TAG_BLE_PACKET_BUNDLE_RECORDS}
    APP_TAG_BLE_PACKET_BUNDLE_FLUSH_MS=${APP_TAG_BLE_PACKET_BUNDLE_FLUSH_MS}
    APP_TAG_BLE_NAME_PREFIX=\"${APP_TAG_BLE_NAME_PREFIX}\"
    APP_TAG_WAND_MODE_ENABLE=${APP_TAG_WAND_MODE_ENABLE}
    APP_TAG_STREAM_FORCE_OFF_AT_BOOT=${APP_TAG_STREAM_FORCE_OFF_AT_BOOT}
    APP_TAG_FW_MARKER=\"${APP_TAG_FW_MARKER}\"
    APP_TAG_CALIBRATION_MODE=${APP_TAG_CALIBRATION_MODE}
    APP_TAG_BLE_TOKEN_ID=${APP_TAG_BLE_TOKEN_ID}
    APP_TAG_MCUBOOT_ENABLE=${APP_TAG_MCUBOOT_ENABLE}
    APP_UWB_CHANNEL=${APP_UWB_CHANNEL}
    APP_UWB_PAN_ID=${APP_UWB_PAN_ID}
)

target_sources(app PRIVATE
    src/main.c
    src/tag_app.c
    ${APP_ROOT}/src/uwb_bringup.c
    ${APP_ROOT}/src/uwb_port.c
    ${APP_ROOT}/src/uwb_anchor_layout.c
    ${APP_ROOT}/src/uwb_imu.c
    ${APP_ROOT}/src/uwb_ekf.c
    ${APP_ROOT}/src/uwb_motion.c
    ${APP_ROOT}/src/uwb_ss_twr_shared.c
    ${APP_ROOT}/src/uwb_tdma.c
    ${APP_ROOT}/src/uwb_range_tracker.c
    ${APP_ROOT}/src/uwb_tag_loc.c
    ${APP_ROOT}/src/ss_twr_init.c
    ${APP_ROOT}/drivers/dw1000/src/deca_device.c
    ${APP_ROOT}/drivers/dw1000/src/deca_params_init.c
    ${APP_ROOT}/drivers/dw1000/src/deca_range_tables.c
)

if(APP_TAG_BLE_ENABLE)
    target_sources(app PRIVATE
        ${APP_ROOT}/apps/tag/src/uwb_tag_ble.c
    )
endif()
```

## prj.conf
```kconfig
CONFIG_GPIO=y
CONFIG_SPI=y
CONFIG_SERIAL=y
CONFIG_CONSOLE=y
CONFIG_UART_CONSOLE=y
CONFIG_RTT_CONSOLE=n
CONFIG_USE_SEGGER_RTT=n
CONFIG_PRINTK=y
CONFIG_LOG=y
CONFIG_LOG_BACKEND_UART=y
CONFIG_LOG_MODE_IMMEDIATE=y
CONFIG_LOG_DEFAULT_LEVEL=2
CONFIG_I2C=y
CONFIG_BT=y
CONFIG_BT_PERIPHERAL=y
CONFIG_BT_NUS=y
CONFIG_BT_DEVICE_NAME="BS_AUTO"
CONFIG_BT_LOG_LEVEL_WRN=y
CONFIG_BT_HCI_CORE_LOG_LEVEL_WRN=y
CONFIG_BT_HCI_DRIVER_LOG_LEVEL_WRN=y
CONFIG_BT_GATT_LOG_LEVEL_ERR=y
CONFIG_BT_MAX_CONN=1
CONFIG_BT_MAX_PAIRED=1
CONFIG_BT_SETTINGS=n
CONFIG_SETTINGS=n
CONFIG_BT_USER_PHY_UPDATE=y
CONFIG_BT_PERIPHERAL_PREF_MIN_INT=6
CONFIG_BT_PERIPHERAL_PREF_MAX_INT=6
CONFIG_BT_PERIPHERAL_PREF_LATENCY=0
CONFIG_BT_PERIPHERAL_PREF_TIMEOUT=400
CONFIG_BOOTLOADER_MCUBOOT=y
CONFIG_MCUBOOT_BOOTUTIL_LIB=y
CONFIG_MCUBOOT_SIGNATURE_KEY_FILE="bootloader/mcuboot/root-rsa-2048.pem"
CONFIG_MCUBOOT_IMGTOOL_SIGN_VERSION="0.0.1+11"
CONFIG_FLASH=y
CONFIG_FLASH_PAGE_LAYOUT=y
CONFIG_FLASH_MAP=y
CONFIG_IMG_MANAGER=y
CONFIG_STREAM_FLASH=y
CONFIG_NET_BUF=y
CONFIG_ZCBOR=y
CONFIG_CRC=y
CONFIG_MCUMGR=y
CONFIG_MCUMGR_GRP_IMG=y
CONFIG_MCUMGR_GRP_IMG_VERBOSE_ERR=y
CONFIG_MCUMGR_GRP_OS=y
CONFIG_MCUMGR_GRP_OS_BOOTLOADER_INFO=y
CONFIG_MCUMGR_GRP_OS_MCUMGR_PARAMS=y
CONFIG_MCUMGR_TRANSPORT_BT=y
CONFIG_MCUMGR_TRANSPORT_BT_PERM_RW=y
CONFIG_MCUMGR_TRANSPORT_BT_CONN_PARAM_CONTROL=y
CONFIG_MCUMGR_TRANSPORT_BT_REASSEMBLY=y
CONFIG_MCUMGR_TRANSPORT_NETBUF_SIZE=1536
CONFIG_MCUMGR_TRANSPORT_WORKQUEUE_STACK_SIZE=3072
CONFIG_BT_L2CAP_TX_MTU=498
CONFIG_BT_BUF_ACL_RX_SIZE=502
CONFIG_BT_BUF_ACL_TX_SIZE=502
CONFIG_BT_BUF_ACL_RX_COUNT=4
CONFIG_BT_BUF_ACL_TX_COUNT=6
CONFIG_BT_L2CAP_TX_BUF_COUNT=6
CONFIG_BT_BUF_CMD_TX_COUNT=3
CONFIG_BT_BUF_EVT_RX_SIZE=255
CONFIG_BT_BUF_EVT_RX_COUNT=4
CONFIG_BT_CTLR_PHY_2M=y
CONFIG_BT_CTLR_DATA_LENGTH_MAX=251
CONFIG_MAIN_THREAD_PRIORITY=5
CONFIG_MAIN_STACK_SIZE=3584
CONFIG_SYSTEM_WORKQUEUE_STACK_SIZE=3072
CONFIG_ISR_STACK_SIZE=3072
CONFIG_RESET_ON_FATAL_ERROR=y
CONFIG_BT_RX_STACK_SIZE=1600
CONFIG_HEAP_MEM_POOL_SIZE=6144
```

## src/tag_app.c
```c
#include <zephyr/kernel.h>
#if APP_TAG_MCUBOOT_ENABLE
#include <zephyr/dfu/mcuboot.h>
#endif
#include <zephyr/drivers/uart.h>
#include <zephyr/sys/printk.h>
#include <zephyr/sys/util.h>

#include "ss_twr_init.h"
#include "uwb_bringup.h"
#include "uwb_port.h"
#include <deca_device_api.h>
#if APP_TAG_BLE_ENABLE
#include "uwb_tag_ble.h"
#endif

#ifndef APP_TAG_MCUBOOT_ENABLE
#define APP_TAG_MCUBOOT_ENABLE 1U
#endif

#ifndef APP_TAG_ID
#define APP_TAG_ID 0U
#endif

#ifndef APP_TAG_BLE_TOKEN_ID
#define APP_TAG_BLE_TOKEN_ID APP_TAG_ID
#endif

#ifndef APP_TAG_ANCHOR_COUNT
#define APP_TAG_ANCHOR_COUNT 8U
#endif

#ifndef APP_TAG_ANCHOR_0_ID
#define APP_TAG_ANCHOR_0_ID 0U
#endif

#ifndef APP_TAG_ANCHOR_1_ID
#define APP_TAG_ANCHOR_1_ID 1U
#endif

#ifndef APP_TAG_ANCHOR_2_ID
#define APP_TAG_ANCHOR_2_ID 2U
#endif

#ifndef APP_TAG_ANCHOR_3_ID
#define APP_TAG_ANCHOR_3_ID 3U
#endif

#ifndef APP_TAG_ANCHOR_4_ID
#define APP_TAG_ANCHOR_4_ID 4U
#endif

#ifndef APP_TAG_ANCHOR_5_ID
#define APP_TAG_ANCHOR_5_ID 5U
#endif

#ifndef APP_TAG_ANCHOR_6_ID
#define APP_TAG_ANCHOR_6_ID 6U
#endif

#ifndef APP_TAG_ANCHOR_7_ID
#define APP_TAG_ANCHOR_7_ID 7U
#endif

#ifndef APP_TAG_FIXED_MODE
#define APP_TAG_FIXED_MODE 0U
#endif

#ifndef APP_TAG_FIXED_ANCHOR_COUNT
#define APP_TAG_FIXED_ANCHOR_COUNT 4U
#endif

#ifndef APP_TAG_FIXED_ANCHOR_0_ID
#define APP_TAG_FIXED_ANCHOR_0_ID 1U
#endif

#ifndef APP_TAG_FIXED_ANCHOR_1_ID
#define APP_TAG_FIXED_ANCHOR_1_ID 2U
#endif

#ifndef APP_TAG_FIXED_ANCHOR_2_ID
#define APP_TAG_FIXED_ANCHOR_2_ID 5U
#endif

#ifndef APP_TAG_FIXED_ANCHOR_3_ID
#define APP_TAG_FIXED_ANCHOR_3_ID 6U
#endif

#ifndef APP_TAG_MULTITAG_PLAN_MODE
#define APP_TAG_MULTITAG_PLAN_MODE 0U
#endif

#ifndef APP_TAG_ACTIVE_ANCHOR_0_ID
#define APP_TAG_ACTIVE_ANCHOR_0_ID 0U
#endif

#ifndef APP_TAG_ACTIVE_ANCHOR_1_ID
#define APP_TAG_ACTIVE_ANCHOR_1_ID 1U
#endif

#ifndef APP_TAG_ACTIVE_ANCHOR_2_ID
#define APP_TAG_ACTIVE_ANCHOR_2_ID 4U
#endif

#ifndef APP_TAG_ACTIVE_ANCHOR_3_ID
#define APP_TAG_ACTIVE_ANCHOR_3_ID 5U
#endif

#ifndef APP_TAG_STANDBY_ANCHOR_0_ID
#define APP_TAG_STANDBY_ANCHOR_0_ID 2U
#endif

#ifndef APP_TAG_STANDBY_ANCHOR_1_ID
#define APP_TAG_STANDBY_ANCHOR_1_ID 6U
#endif

#ifndef APP_TAG_RESERVE_ANCHOR_0_ID
#define APP_TAG_RESERVE_ANCHOR_0_ID 3U
#endif

#ifndef APP_TAG_RESERVE_ANCHOR_1_ID
#define APP_TAG_RESERVE_ANCHOR_1_ID 7U
#endif

#if APP_TAG_USB_DIAG_TRACE
static void tag_diag_write(const char *msg)
{
    const struct device *console = DEVICE_DT_GET(DT_CHOSEN(zephyr_console));

    if (!device_is_ready(console) || msg == NULL) {
        return;
    }

    while (*msg != '\0') {
        uart_poll_out(console, *msg++);
    }
}
#endif

#ifndef APP_TAG_REFRESH_ANCHOR_BUDGET
#define APP_TAG_REFRESH_ANCHOR_BUDGET 1U
#endif

#ifndef APP_TAG_REFRESH_INTERVAL
#define APP_TAG_REFRESH_INTERVAL 10U
#endif

#ifndef APP_TAG_MAINTENANCE_FULL_INTERVAL
#define APP_TAG_MAINTENANCE_FULL_INTERVAL 100U
#endif

#ifndef APP_TAG_TDMA_ENABLE
#define APP_TAG_TDMA_ENABLE 0U
#endif

#ifndef APP_TAG_TDMA_SLOT_INDEX
#define APP_TAG_TDMA_SLOT_INDEX 0U
#endif

#ifndef APP_TAG_TDMA_SLOT_COUNT
#define APP_TAG_TDMA_SLOT_COUNT 1U
#endif

#ifndef APP_TAG_TDMA_SLOT_PERIOD_MS
#define APP_TAG_TDMA_SLOT_PERIOD_MS 25U
#endif

#ifndef APP_TAG_TDMA_SLOT_ACTIVE_MS
#define APP_TAG_TDMA_SLOT_ACTIVE_MS 20U
#endif

#ifndef APP_TAG_EKF_ENABLE
#define APP_TAG_EKF_ENABLE 0U
#endif

#ifndef APP_TAG_EKF_MEAS_STD_MM
#define APP_TAG_EKF_MEAS_STD_MM 25U
#endif

#ifndef APP_TAG_EKF_RESIDUAL_GAIN_PCT
#define APP_TAG_EKF_RESIDUAL_GAIN_PCT 0U
#endif

#ifndef APP_TAG_EKF_PROC_ACCEL_MM_S2
#define APP_TAG_EKF_PROC_ACCEL_MM_S2 250U
#endif

#ifndef APP_TAG_EKF_INIT_POS_STD_MM
#define APP_TAG_EKF_INIT_POS_STD_MM 200U
#endif

#ifndef APP_TAG_EKF_INIT_VEL_STD_MM_S
#define APP_TAG_EKF_INIT_VEL_STD_MM_S 1000U
#endif

#ifndef APP_TAG_EKF_OUTLIER_GATE_MM
#define APP_TAG_EKF_OUTLIER_GATE_MM 0U
#endif

#ifndef APP_TAG_RANGE_SOFT_RESIDUAL_MM
#define APP_TAG_RANGE_SOFT_RESIDUAL_MM 180U
#endif

#ifndef APP_TAG_RANGE_HARD_RESIDUAL_MM
#define APP_TAG_RANGE_HARD_RESIDUAL_MM 350U
#endif

#ifndef APP_TAG_MOTION_FULL_SWEEP_INTERVAL
#define APP_TAG_MOTION_FULL_SWEEP_INTERVAL 0U
#endif

#ifndef APP_TAG_MOTION_SPEED_THRESHOLD_MM_S
#define APP_TAG_MOTION_SPEED_THRESHOLD_MM_S 250U
#endif

#ifndef APP_TAG_MOTION_RANGE_SOFT_BONUS_MM
#define APP_TAG_MOTION_RANGE_SOFT_BONUS_MM 0U
#endif

#ifndef APP_TAG_MOTION_RANGE_HARD_BONUS_MM
#define APP_TAG_MOTION_RANGE_HARD_BONUS_MM 0U
#endif

#ifndef APP_TAG_MOTION_EKF_MEAS_STD_MM
#define APP_TAG_MOTION_EKF_MEAS_STD_MM 0U
#endif

#ifndef APP_TAG_MOTION_EKF_PROC_ACCEL_MM_S2
#define APP_TAG_MOTION_EKF_PROC_ACCEL_MM_S2 0U
#endif

#ifndef APP_TAG_MOTION_EKF_OUTLIER_GATE_MM
#define APP_TAG_MOTION_EKF_OUTLIER_GATE_MM 0U
#endif

#ifndef APP_TAG_MOTION_IMU_DELTA_THRESHOLD_MG
#define APP_TAG_MOTION_IMU_DELTA_THRESHOLD_MG 750U
#endif

#ifndef APP_TAG_MOTION_IMU_GRAVITY_ERR_THRESHOLD_MG
#define APP_TAG_MOTION_IMU_GRAVITY_ERR_THRESHOLD_MG 400U
#endif

#ifndef APP_TAG_FW_MARKER
#define APP_TAG_FW_MARKER "unified-default"
#endif

#ifndef APP_TAG_CALIBRATION_MODE
#define APP_TAG_CALIBRATION_MODE 0U
#endif

#ifndef APP_TAG_UWB_ENABLE
#define APP_TAG_UWB_ENABLE 1U
#endif

#ifndef APP_TAG_OTP_DIAG
#define APP_TAG_OTP_DIAG 0U
#endif

static void tag_print_otp_diag(void)
{
#if APP_TAG_OTP_DIAG
    uint32 dev_id_port = 0U;
    uint32 otp_01c = 0U;
    uint32 otp_01d = 0U;
    uint32 otp_01e = 0U;
    uint16 otp_anchor_delay = 0U;
    uint16 otp_tag_delay = 0U;

    (void)uwb_port_read_dev_id(&dev_id_port);
    dwt_otpread(0x01C, &otp_01c, 1);
    dwt_otpread(0x01D, &otp_01d, 1);
    dwt_otpread(0x01E, &otp_01e, 1);
    otp_anchor_delay = (uint16)(otp_01c & 0xFFFFU);
    otp_tag_delay = (uint16)((otp_01c >> 16) & 0xFFFFU);

    printk("OTP_DIAG port_devid=0x%08X dwt_devid=0x%08X otp_rev=0x%02X addr_01C=0x%08X addr_01D=0x%08X addr_01E=0x%08X anchor_delay=%u tag_delay=%u\n",
           (unsigned int)dev_id_port,
           (unsigned int)dwt_readdevid(),
           (unsigned int)dwt_otprevision(),
           (unsigned int)otp_01c,
           (unsigned int)otp_01d,
           (unsigned int)otp_01e,
           (unsigned int)otp_anchor_delay,
           (unsigned int)otp_tag_delay);
#endif
}

int tag_app_run(void)
{
    static const uint8_t target_anchor_ids[] = {
        APP_TAG_ANCHOR_0_ID,
        APP_TAG_ANCHOR_1_ID,
        APP_TAG_ANCHOR_2_ID,
        APP_TAG_ANCHOR_3_ID,
        APP_TAG_ANCHOR_4_ID,
        APP_TAG_ANCHOR_5_ID,
        APP_TAG_ANCHOR_6_ID,
        APP_TAG_ANCHOR_7_ID,
    };
    static uint8_t runtime_fixed_anchor_ids[] = {
        APP_TAG_FIXED_ANCHOR_0_ID,
        APP_TAG_FIXED_ANCHOR_1_ID,
        APP_TAG_FIXED_ANCHOR_2_ID,
        APP_TAG_FIXED_ANCHOR_3_ID,
    };
    static const uint8_t active_anchor_ids[] = {
        APP_TAG_ACTIVE_ANCHOR_0_ID,
        APP_TAG_ACTIVE_ANCHOR_1_ID,
        APP_TAG_ACTIVE_ANCHOR_2_ID,
        APP_TAG_ACTIVE_ANCHOR_3_ID,
    };
    static const uint8_t standby_anchor_ids[] = {
        APP_TAG_STANDBY_ANCHOR_0_ID,
        APP_TAG_STANDBY_ANCHOR_1_ID,
    };
    static const uint8_t reserve_anchor_ids[] = {
        APP_TAG_RESERVE_ANCHOR_0_ID,
        APP_TAG_RESERVE_ANCHOR_1_ID,
    };
    struct uwb_tag_runtime_config runtime_config = {
        .identity_code = 0U,
        .tag_id = 0U,
        .slot_source = UWB_TAG_SLOT_SOURCE_BUILD,
        .positioning_mode = UWB_TAG_MODE_RANGE,
        .anchor_selection_mode = (APP_TAG_FIXED_MODE != 0U) ?
            UWB_TAG_ANCHOR_SELECTION_FIXED_SUBSET :
            UWB_TAG_ANCHOR_SELECTION_DYNAMIC_2P2,
        .anchor_ids = target_anchor_ids,
        .anchor_count = APP_TAG_ANCHOR_COUNT,
        .fixed_anchor_mode = (APP_TAG_FIXED_MODE != 0U),
        .fixed_anchor_ids = runtime_fixed_anchor_ids,
        .fixed_anchor_count = APP_TAG_FIXED_ANCHOR_COUNT,
        .multitag_anchor_plan_mode = false,
        .active_anchor_ids = active_anchor_ids,
        .active_anchor_count = ARRAY_SIZE(active_anchor_ids),
        .standby_anchor_ids = standby_anchor_ids,
        .standby_anchor_count = ARRAY_SIZE(standby_anchor_ids),
        .reserve_anchor_ids = reserve_anchor_ids,
        .reserve_anchor_count = ARRAY_SIZE(reserve_anchor_ids),
        .refresh_anchor_budget = APP_TAG_REFRESH_ANCHOR_BUDGET,
        .refresh_interval_sweeps = APP_TAG_REFRESH_INTERVAL,
        .full_sweep_interval_sweeps = APP_TAG_MAINTENANCE_FULL_INTERVAL,
        .tdma =
            {
                .enabled = (APP_TAG_TDMA_ENABLE != 0U),
                .slot_index = APP_TAG_TDMA_SLOT_INDEX,
                .slot_count = APP_TAG_TDMA_SLOT_COUNT,
                .slot_period_ms = APP_TAG_TDMA_SLOT_PERIOD_MS,
                .slot_active_ms = APP_TAG_TDMA_SLOT_ACTIVE_MS,
            },
    };
    int ret;

#if APP_TAG_MCUBOOT_ENABLE
    if (!boot_is_img_confirmed()) {
        ret = boot_write_img_confirmed();
        printk("MCUboot confirm rc=%d\n", ret);
        if (ret) {
            printk("MCUboot confirm failed, continuing: %d\n", ret);
        }
    }
#else
    printk("MCUboot disabled, running direct USB serial image\n");
#endif

#if APP_TAG_BLE_ENABLE
    ret = uwb_tag_ble_init();
    if (ret) {
        printk("Tag BLE init failed, continuing with UWB only: %d\n", ret);
    }
    runtime_config.identity_code = uwb_tag_ble_identity_code();
    runtime_config.tag_id = uwb_tag_ble_tag_id();
    {
        struct uwb_tag_runtime_params ble_params;

		if (uwb_tag_ble_runtime_config_get(&ble_params)) {
            if (ble_params.identity_code != 0U) {
                runtime_config.identity_code = ble_params.identity_code;
            }
            if (ble_params.logical_tag_id < UWB_MAX_TAGS) {
                runtime_config.tag_id = ble_params.logical_tag_id;
            }
            runtime_config.slot_source = ble_params.slot_source;
            runtime_config.positioning_mode = ble_params.positioning_mode;
            runtime_config.anchor_selection_mode =
                ble_params.anchor_selection_mode;

            if (ble_params.tdma.slot_count != 0U &&
                ble_params.tdma.slot_period_ms != 0U &&
                ble_params.tdma.slot_active_ms != 0U) {
                runtime_config.tdma = ble_params.tdma;
            }

            if (ble_params.anchor_selection_mode ==
                    UWB_TAG_ANCHOR_SELECTION_FIXED_SUBSET &&
                ble_params.fixed_anchor_count >= 4U) {
                runtime_config.fixed_anchor_mode = true;
                runtime_config.fixed_anchor_count = ble_params.fixed_anchor_count;
                for (size_t i = 0U; i < ble_params.fixed_anchor_count &&
                                    i < ARRAY_SIZE(runtime_fixed_anchor_ids);
                     ++i) {
                    runtime_fixed_anchor_ids[i] = ble_params.fixed_anchor_ids[i];
                }
            } else {
                runtime_config.fixed_anchor_mode = false;
            }
        }
    }

	if (APP_TAG_CALIBRATION_MODE) {
		runtime_config.positioning_mode = UWB_TAG_MODE_RANGE;
		runtime_config.slot_source = UWB_TAG_SLOT_SOURCE_BUILD;
		if (runtime_config.tdma.slot_count == 0U ||
		    runtime_config.tdma.slot_period_ms == 0U ||
		    runtime_config.tdma.slot_active_ms == 0U) {
			runtime_config.tdma.enabled = (APP_TAG_TDMA_ENABLE != 0U);
			runtime_config.tdma.slot_index = APP_TAG_TDMA_SLOT_INDEX;
			runtime_config.tdma.slot_count = APP_TAG_TDMA_SLOT_COUNT;
			runtime_config.tdma.slot_period_ms = APP_TAG_TDMA_SLOT_PERIOD_MS;
			runtime_config.tdma.slot_active_ms = APP_TAG_TDMA_SLOT_ACTIVE_MS;
		}
		runtime_config.tdma.epoch_valid = false;
		runtime_config.tdma.epoch_ms = 0U;
		runtime_config.tdma.generation = 0U;
		printk("Tag calibration build flag ignored; broadcast TR mode remains enabled\n");
	}

    if (runtime_config.tdma.enabled && runtime_config.tdma.slot_count != 0U) {
        printk("Tag TDMA runtime config: slot=%u/%u period=%u active=%u source=%u epoch_valid=%u gen=%u\n",
               (unsigned int)runtime_config.tdma.slot_index,
               (unsigned int)runtime_config.tdma.slot_count,
               (unsigned int)runtime_config.tdma.slot_period_ms,
               (unsigned int)runtime_config.tdma.slot_active_ms,
               (unsigned int)runtime_config.slot_source,
               (unsigned int)runtime_config.tdma.epoch_valid,
               (unsigned int)runtime_config.tdma.generation);
    } else {
        printk("Tag TDMA runtime config disabled\n");
    }
#else
    printk("Tag BLE disabled, running pure UWB/USB serial mode\n");
#endif

    if (APP_TAG_UWB_ENABLE) {
        printk("Tag UWB bringup starting\n");
        k_msleep(100);
        ret = uwb_hw_bringup_and_init();
        if (ret) {
            printk("Tag UWB bringup failed: %d\n", ret);
            return ret;
        }
        printk("Tag UWB bringup done\n");
        tag_print_otp_diag();
    } else {
        printk("Tag UWB disabled by build profile (BLE/OTA only)\n");
    }

#if APP_TAG_USB_DIAG_TRACE
    tag_diag_write("TAG_APP: handoff enter\n");
#endif
    printk("Tag firmware marker: %s\n", APP_TAG_FW_MARKER);
    printk("Tag app ready bs=BS%04X logical_tag=%u anchor_count=%u fixed=%u fixed_count=%u tdma=%u slot=%u/%u period=%u active=%u slot_src=%u pmode=%u amode=%u filter=%s meas_std=%u residual_gain=%u proc_accel=%u init_pos=%u init_vel=%u gate=%u motion_meas=%u motion_proc=%u motion_gate=%u speed_thr=%u imu_delta=%u imu_gerr=%u range_soft=%u range_hard=%u motion_soft=%u motion_hard=%u\n",
           (unsigned int)runtime_config.identity_code,
           runtime_config.tag_id, APP_TAG_ANCHOR_COUNT,
           (unsigned int)runtime_config.fixed_anchor_mode,
           (unsigned int)runtime_config.fixed_anchor_count,
           (unsigned int)runtime_config.tdma.enabled,
           (unsigned int)runtime_config.tdma.slot_index,
           (unsigned int)runtime_config.tdma.slot_count,
           (unsigned int)runtime_config.tdma.slot_period_ms,
           (unsigned int)runtime_config.tdma.slot_active_ms,
           (unsigned int)runtime_config.slot_source,
           (unsigned int)runtime_config.positioning_mode,
           (unsigned int)runtime_config.anchor_selection_mode,
           (APP_TAG_EKF_ENABLE != 0U) ? "post_kf" : "raw",
           APP_TAG_EKF_MEAS_STD_MM, APP_TAG_EKF_RESIDUAL_GAIN_PCT,
           APP_TAG_EKF_PROC_ACCEL_MM_S2, APP_TAG_EKF_INIT_POS_STD_MM,
           APP_TAG_EKF_INIT_VEL_STD_MM_S, APP_TAG_EKF_OUTLIER_GATE_MM,
           APP_TAG_MOTION_EKF_MEAS_STD_MM,
           APP_TAG_MOTION_EKF_PROC_ACCEL_MM_S2,
           APP_TAG_MOTION_EKF_OUTLIER_GATE_MM,
           APP_TAG_MOTION_SPEED_THRESHOLD_MM_S,
           APP_TAG_MOTION_IMU_DELTA_THRESHOLD_MG,
           APP_TAG_MOTION_IMU_GRAVITY_ERR_THRESHOLD_MG,
           APP_TAG_RANGE_SOFT_RESIDUAL_MM, APP_TAG_RANGE_HARD_RESIDUAL_MM,
           APP_TAG_MOTION_RANGE_SOFT_BONUS_MM,
           APP_TAG_MOTION_RANGE_HARD_BONUS_MM);
    printk("Tag app anchors=[%u,%u,%u,%u,%u,%u,%u,%u] fixed_anchors=[%u,%u,%u,%u] active=[%u,%u,%u,%u] standby=[%u,%u] reserve=[%u,%u] refresh=%u/%u full=%u motion_full=%u\n",
           APP_TAG_ANCHOR_0_ID,
           APP_TAG_ANCHOR_1_ID, APP_TAG_ANCHOR_2_ID, APP_TAG_ANCHOR_3_ID,
           APP_TAG_ANCHOR_4_ID, APP_TAG_ANCHOR_5_ID, APP_TAG_ANCHOR_6_ID,
           APP_TAG_ANCHOR_7_ID,
           runtime_fixed_anchor_ids[0], runtime_fixed_anchor_ids[1],
           runtime_fixed_anchor_ids[2], runtime_fixed_anchor_ids[3],
           APP_TAG_ACTIVE_ANCHOR_0_ID,
           APP_TAG_ACTIVE_ANCHOR_1_ID, APP_TAG_ACTIVE_ANCHOR_2_ID,
           APP_TAG_ACTIVE_ANCHOR_3_ID, APP_TAG_STANDBY_ANCHOR_0_ID,
           APP_TAG_STANDBY_ANCHOR_1_ID, APP_TAG_RESERVE_ANCHOR_0_ID,
           APP_TAG_RESERVE_ANCHOR_1_ID, APP_TAG_REFRESH_ANCHOR_BUDGET,
           APP_TAG_REFRESH_INTERVAL, APP_TAG_MAINTENANCE_FULL_INTERVAL,
           APP_TAG_MOTION_FULL_SWEEP_INTERVAL);
    if (APP_TAG_UWB_ENABLE) {
        printk("Tag app handoff: entering SS-TWR\n");
        ret = ss_twr_init_start_with_config(&runtime_config);
        if (ret) {
            printk("ss_twr_init_start_with_config failed: %d\n", ret);
            return ret;
        }
    } else {
        printk("Tag app handoff: UWB scheduler skipped (UWB disabled)\n");
        while (1) {
            k_sleep(K_SECONDS(1));
        }
    }

    return 0;
}
```

## CMakeLists.txt
```
cmake_minimum_required(VERSION 3.20.0)

if(NOT ZEPHYR_MODULES)
  execute_process(
    COMMAND west list --format={abspath}
    WORKING_DIRECTORY ${CMAKE_CURRENT_LIST_DIR}
    OUTPUT_VARIABLE WEST_MODULES_RAW
    OUTPUT_STRIP_TRAILING_WHITESPACE
    RESULT_VARIABLE WEST_LIST_RESULT
  )
  if(WEST_LIST_RESULT EQUAL 0 AND WEST_MODULES_RAW)
    string(REPLACE "\n" ";" ZEPHYR_MODULES "${WEST_MODULES_RAW}")
  endif()
endif()

find_package(Zephyr REQUIRED HINTS $ENV{ZEPHYR_BASE})

project(BioSpur_UWB_anchor)

set(APP_ROOT ${CMAKE_CURRENT_LIST_DIR}/../..)
function(set_cache_from_env name default type doc)
  if(DEFINED ENV{${name}} AND NOT "$ENV{${name}}" STREQUAL "")
    set(_value "$ENV{${name}}")
  else()
    set(_value "${default}")
  endif()
  set(${name} "${_value}" CACHE ${type} "${doc}")
endfunction()

set_cache_from_env(APP_ANCHOR_ID "4" STRING "Anchor node ID (0..7 legacy fallback only)")
set_cache_from_env(APP_ANCHOR_ROLE "0" STRING "Anchor role: 0=legacy,1=master,2=matrix,3=responder")
set_cache_from_env(APP_ANCHOR_FORCE_BOOT_ROLE "0" STRING "Force runtime boot role when nonzero: 1=master,2=matrix,3=responder")
set_cache_from_env(APP_ANCHOR_CONFIG_ADDR "0x0007E000" STRING "Flash address of anchor_config_t provisioning block")
set_cache_from_env(APP_ANCHOR_CONFIG_PAGE_SIZE "4096" STRING "Flash erase page size for anchor config")
set_cache_from_env(APP_ANCHOR_BLE_ID_ENABLE "1" STRING "Enable BLE identification advertising")
set_cache_from_env(APP_ANCHOR_SERIAL_CMD_ENABLE "1" STRING "Enable UART role/config command handler")
set_cache_from_env(APP_ANCHOR_SERIAL_CMD_BOOT_WINDOW_MS "5000" STRING "Boot window for serial config before ranging starts")
set_cache_from_env(APP_ANCHOR_FW_MARKER "anchor-unified" STRING "Firmware marker/version string for startup/control readback")
set_cache_from_env(APP_ANCHOR_MASTER "0" STRING "Whether this anchor actively ranges peers")
set_cache_from_env(APP_ANCHOR_PEER_COUNT "3" STRING "Number of peer anchors for master mode")
set_cache_from_env(APP_ANCHOR_PEER_0_ID "5" STRING "Peer slot 0")
set_cache_from_env(APP_ANCHOR_PEER_1_ID "6" STRING "Peer slot 1")
set_cache_from_env(APP_ANCHOR_PEER_2_ID "7" STRING "Peer slot 2")
set_cache_from_env(APP_ANCHOR_USE_AUTO_SCHEDULE "1" STRING "Use built-in upper-triangle peer schedule")
set_cache_from_env(APP_ANCHOR_SCHEDULE_MODE "2" STRING "1=upper triangle, 2=all except self")
set_cache_from_env(APP_ANCHOR_ALLOW_TAG_POLLS "1" STRING "Worker accepts tag polls")
set_cache_from_env(APP_ANCHOR_RESP_DELAY_UUS "1200" STRING "Responder poll-to-response delay in UWB usec")
set_cache_from_env(APP_ANCHOR_RESPONDER_COOP_SLEEP_MS "0" STRING "Responder cooperative sleep (ms) to reduce CPU starvation under OTA/BLE load")
set_cache_from_env(APP_ANCHOR_RESPONDER_ADV_INT_MIN_MS "5000" STRING "Responder-role connectable BLE advertising minimum interval in ms")
set_cache_from_env(APP_ANCHOR_RESPONDER_ADV_INT_MAX_MS "10000" STRING "Responder-role connectable BLE advertising maximum interval in ms")
set_cache_from_env(APP_ANCHOR_RESPONDER_DIAG_PERIOD_MS "5000" STRING "Responder diagnostic print period in ms")
set_cache_from_env(APP_ANCHOR_VERBOSE_RESPONDER "0" STRING "Print responder success logs")
set_cache_from_env(APP_ANCHOR_VERBOSE_RESPONDER_ERRORS "0" STRING "Print responder RX/TX error logs")
set_cache_from_env(APP_ANCHOR_RESPONDER_PRINTK_ENABLE "0" STRING "Enable low-rate responder-path printk output; keep disabled outside debug builds")
set_cache_from_env(APP_ANCHOR_RESPONDER_PROFILE_ENABLE "0" STRING "Enable low-rate responder fast-path timing profile output")
set_cache_from_env(APP_ANCHOR_RESPONDER_BLUE_LED_ENABLE "0" STRING "Pulse DWM1001C blue LED while a responder TX is active")
set_cache_from_env(APP_ANCHOR_RESPONDER_BLUE_LED_PIN "31" STRING "GPIO pin for responder activity LED")
set_cache_from_env(APP_ANCHOR_RESPONDER_BLUE_LED_ACTIVE_LOW "1" STRING "Responder activity LED active-low polarity")
set_cache_from_env(APP_ANCHOR_DIAG_BLE_BEFORE_UWB "0" STRING "Diagnostic: start BLE/control before UWB bringup")
set_cache_from_env(APP_ANCHOR_DIAG_CONTINUE_ON_UWB_FAIL "0" STRING "Diagnostic: keep BLE/control alive if UWB bringup fails")
set_cache_from_env(APP_UWB_CHANNEL "5" STRING "DW1000 UWB channel number")
set_cache_from_env(APP_UWB_PAN_ID "0xDECA" STRING "DW1000 PAN ID")

target_include_directories(app PRIVATE ${APP_ROOT}/include)
target_include_directories(app PRIVATE ${APP_ROOT}/drivers/dw1000/include)
target_include_directories(app PRIVATE ${CMAKE_CURRENT_LIST_DIR}/src)
target_include_directories(app PRIVATE ${APP_ROOT}/src/anchors/unified)
target_compile_definitions(app PRIVATE
    APP_ANCHOR_ID=${APP_ANCHOR_ID}
    APP_ANCHOR_ROLE=${APP_ANCHOR_ROLE}
    APP_ANCHOR_FORCE_BOOT_ROLE=${APP_ANCHOR_FORCE_BOOT_ROLE}
    APP_ANCHOR_CONFIG_ADDR=${APP_ANCHOR_CONFIG_ADDR}
    APP_ANCHOR_CONFIG_PAGE_SIZE=${APP_ANCHOR_CONFIG_PAGE_SIZE}
    APP_ANCHOR_BLE_ID_ENABLE=${APP_ANCHOR_BLE_ID_ENABLE}
    APP_ANCHOR_SERIAL_CMD_ENABLE=${APP_ANCHOR_SERIAL_CMD_ENABLE}
    APP_ANCHOR_SERIAL_CMD_BOOT_WINDOW_MS=${APP_ANCHOR_SERIAL_CMD_BOOT_WINDOW_MS}
    APP_ANCHOR_FW_MARKER=\"${APP_ANCHOR_FW_MARKER}\"
    APP_ANCHOR_MASTER=${APP_ANCHOR_MASTER}
    APP_ANCHOR_PEER_COUNT=${APP_ANCHOR_PEER_COUNT}
    APP_ANCHOR_PEER_0_ID=${APP_ANCHOR_PEER_0_ID}
    APP_ANCHOR_PEER_1_ID=${APP_ANCHOR_PEER_1_ID}
    APP_ANCHOR_PEER_2_ID=${APP_ANCHOR_PEER_2_ID}
    APP_ANCHOR_USE_AUTO_SCHEDULE=${APP_ANCHOR_USE_AUTO_SCHEDULE}
    APP_ANCHOR_SCHEDULE_MODE=${APP_ANCHOR_SCHEDULE_MODE}
    APP_ANCHOR_ALLOW_TAG_POLLS=${APP_ANCHOR_ALLOW_TAG_POLLS}
    APP_ANCHOR_RESP_DELAY_UUS=${APP_ANCHOR_RESP_DELAY_UUS}
    APP_ANCHOR_RESPONDER_COOP_SLEEP_MS=${APP_ANCHOR_RESPONDER_COOP_SLEEP_MS}
    APP_ANCHOR_RESPONDER_ADV_INT_MIN_MS=${APP_ANCHOR_RESPONDER_ADV_INT_MIN_MS}
    APP_ANCHOR_RESPONDER_ADV_INT_MAX_MS=${APP_ANCHOR_RESPONDER_ADV_INT_MAX_MS}
    APP_ANCHOR_RESPONDER_DIAG_PERIOD_MS=${APP_ANCHOR_RESPONDER_DIAG_PERIOD_MS}
    APP_ANCHOR_VERBOSE_RESPONDER=${APP_ANCHOR_VERBOSE_RESPONDER}
    APP_ANCHOR_VERBOSE_RESPONDER_ERRORS=${APP_ANCHOR_VERBOSE_RESPONDER_ERRORS}
    APP_ANCHOR_RESPONDER_PRINTK_ENABLE=${APP_ANCHOR_RESPONDER_PRINTK_ENABLE}
    APP_ANCHOR_RESPONDER_PROFILE_ENABLE=${APP_ANCHOR_RESPONDER_PROFILE_ENABLE}
    APP_ANCHOR_RESPONDER_BLUE_LED_ENABLE=${APP_ANCHOR_RESPONDER_BLUE_LED_ENABLE}
    APP_ANCHOR_RESPONDER_BLUE_LED_PIN=${APP_ANCHOR_RESPONDER_BLUE_LED_PIN}
    APP_ANCHOR_RESPONDER_BLUE_LED_ACTIVE_LOW=${APP_ANCHOR_RESPONDER_BLUE_LED_ACTIVE_LOW}
    APP_ANCHOR_DIAG_BLE_BEFORE_UWB=${APP_ANCHOR_DIAG_BLE_BEFORE_UWB}
    APP_ANCHOR_DIAG_CONTINUE_ON_UWB_FAIL=${APP_ANCHOR_DIAG_CONTINUE_ON_UWB_FAIL}
    APP_UWB_CHANNEL=${APP_UWB_CHANNEL}
    APP_UWB_PAN_ID=${APP_UWB_PAN_ID}
)

target_sources(app PRIVATE
    src/main.c
    src/anchor_app.c
    ${APP_ROOT}/src/anchors/unified/anchor_config.c
    ${APP_ROOT}/src/anchors/unified/anchor_ble_id.c
    ${APP_ROOT}/src/anchors/unified/anchor_ble_ctrl.c
    ${APP_ROOT}/src/anchors/unified/anchor_runtime_control.c
    ${APP_ROOT}/src/anchors/unified/anchor_mcumgr_diag.c
    ${APP_ROOT}/src/anchors/unified/uart_role_switch.c
    ${APP_ROOT}/src/uwb_bringup.c
    ${APP_ROOT}/src/uwb_port.c
    ${APP_ROOT}/src/uwb_anchor_topology.c
    ${APP_ROOT}/src/uwb_anchor_matrix.c
    ${APP_ROOT}/src/uwb_ss_twr_shared.c
    ${APP_ROOT}/src/uwb_range_tracker.c
    ${APP_ROOT}/src/ss_twr_anchor_init.c
    ${APP_ROOT}/src/ss_twr_resp.c
    ${APP_ROOT}/drivers/dw1000/src/deca_device.c
    ${APP_ROOT}/drivers/dw1000/src/deca_params_init.c
    ${APP_ROOT}/drivers/dw1000/src/deca_range_tables.c
)
```

## prj.conf
```kconfig
CONFIG_GPIO=y
CONFIG_SPI=y
CONFIG_SERIAL=y
CONFIG_CONSOLE=y
CONFIG_UART_CONSOLE=y
CONFIG_RTT_CONSOLE=n
CONFIG_USE_SEGGER_RTT=n
CONFIG_PRINTK=y
CONFIG_MAIN_STACK_SIZE=2048
CONFIG_FLASH=y
CONFIG_THREAD_NAME=y
CONFIG_REBOOT=y

CONFIG_BT=y
CONFIG_BT_PERIPHERAL=y
CONFIG_BT_DEVICE_NAME="ANCHOR-U"
CONFIG_BT_MAX_CONN=2
CONFIG_BT_SETTINGS=n
```

## prj_ota.conf
```kconfig
CONFIG_BOOTLOADER_MCUBOOT=y
CONFIG_MCUBOOT_BOOTUTIL_LIB=y
CONFIG_MCUBOOT_SIGNATURE_KEY_FILE="bootloader/mcuboot/root-rsa-2048.pem"
CONFIG_MCUBOOT_IMGTOOL_SIGN_VERSION="0.0.1+1"

CONFIG_FLASH_PAGE_LAYOUT=y
CONFIG_FLASH_MAP=y
CONFIG_IMG_MANAGER=y
CONFIG_STREAM_FLASH=y
CONFIG_CRC=y
CONFIG_ZCBOR=y
CONFIG_NET_BUF=y

CONFIG_MCUMGR=y
CONFIG_MCUMGR_GRP_IMG=y
CONFIG_MCUMGR_GRP_IMG_VERBOSE_ERR=y
CONFIG_MCUMGR_GRP_IMG_STATUS_HOOKS=y
CONFIG_MCUMGR_GRP_IMG_ALLOW_ERASE_PENDING=y
CONFIG_MCUMGR_GRP_OS=y
CONFIG_MCUMGR_GRP_OS_BOOTLOADER_INFO=y
CONFIG_MCUMGR_MGMT_NOTIFICATION_HOOKS=y
CONFIG_MCUMGR_SMP_COMMAND_STATUS_HOOKS=y
CONFIG_MCUMGR_TRANSPORT_BT=y
CONFIG_MCUMGR_TRANSPORT_BT_PERM_RW=y
# Keep OTA transport stable with diverse centrals (52840 control build, host tools).
# Aggressive MCUmgr conn-param forcing caused intermittent link instability in strict trials.
CONFIG_MCUMGR_TRANSPORT_BT_CONN_PARAM_CONTROL=n
CONFIG_MCUMGR_TRANSPORT_BT_REASSEMBLY=y
CONFIG_MCUMGR_TRANSPORT_NETBUF_SIZE=768
CONFIG_MCUMGR_TRANSPORT_WORKQUEUE_STACK_SIZE=2048
CONFIG_MCUMGR_TRANSPORT_LOG_LEVEL_DBG=y
CONFIG_MCUMGR_GRP_IMG_LOG_LEVEL_DBG=y
CONFIG_MCUMGR_GRP_OS_LOG_LEVEL_DBG=y

CONFIG_BT_L2CAP_TX_MTU=247
CONFIG_BT_BUF_ACL_RX_SIZE=251
CONFIG_BT_BUF_ACL_TX_SIZE=251
CONFIG_BT_BUF_ACL_RX_COUNT=4
CONFIG_BT_BUF_ACL_TX_COUNT=6
CONFIG_BT_L2CAP_TX_BUF_COUNT=6
CONFIG_BT_BUF_CMD_TX_COUNT=3
CONFIG_BT_BUF_EVT_RX_SIZE=255
CONFIG_BT_BUF_EVT_RX_COUNT=4
CONFIG_BT_CTLR_PHY_2M=y
CONFIG_BT_CTLR_DATA_LENGTH_MAX=251

CONFIG_MAIN_STACK_SIZE=3072
CONFIG_SYSTEM_WORKQUEUE_STACK_SIZE=2048
CONFIG_ISR_STACK_SIZE=2048
CONFIG_BT_RX_STACK_SIZE=1400
CONFIG_HEAP_MEM_POOL_SIZE=4096
```

## src/anchor_app.c
```c
#include <zephyr/kernel.h>
#include <zephyr/sys/printk.h>
#include <errno.h>
#include <string.h>
#include <zephyr/dfu/mcuboot.h>

#include "anchor_config.h"
#include "anchor_ble_id.h"
#include "anchor_ble_ctrl.h"
#include "anchor_cir_output.h"
#include "anchor_mcumgr_diag.h"
#include "anchor_runtime_control.h"
#include "uart_role_switch.h"
#include "ss_twr_anchor_init.h"
#include "ss_twr_resp.h"
#include "uwb_anchor_topology.h"
#include "uwb_bringup.h"

#ifndef APP_ANCHOR_ID
#define APP_ANCHOR_ID 4U
#endif

#ifndef APP_ANCHOR_ROLE
#define APP_ANCHOR_ROLE 0U
#endif

#ifndef APP_ANCHOR_FORCE_BOOT_ROLE
#define APP_ANCHOR_FORCE_BOOT_ROLE 0U
#endif

#ifndef APP_ANCHOR_MASTER
#define APP_ANCHOR_MASTER 0U
#endif

#ifndef APP_ANCHOR_PEER_COUNT
#define APP_ANCHOR_PEER_COUNT 3U
#endif

#ifndef APP_ANCHOR_PEER_0_ID
#define APP_ANCHOR_PEER_0_ID 5U
#endif

#ifndef APP_ANCHOR_PEER_1_ID
#define APP_ANCHOR_PEER_1_ID 6U
#endif

#ifndef APP_ANCHOR_PEER_2_ID
#define APP_ANCHOR_PEER_2_ID 7U
#endif

#ifndef APP_ANCHOR_USE_AUTO_SCHEDULE
#define APP_ANCHOR_USE_AUTO_SCHEDULE 1U
#endif

#ifndef APP_ANCHOR_SCHEDULE_MODE
#define APP_ANCHOR_SCHEDULE_MODE 2U
#endif

#ifndef APP_ANCHOR_ALLOW_TAG_POLLS
#define APP_ANCHOR_ALLOW_TAG_POLLS 1U
#endif

#ifndef APP_ANCHOR_BLE_ID_ENABLE
#define APP_ANCHOR_BLE_ID_ENABLE 1U
#endif

#ifndef APP_ANCHOR_SERIAL_CMD_ENABLE
#define APP_ANCHOR_SERIAL_CMD_ENABLE 1U
#endif

#ifndef APP_ANCHOR_SERIAL_CMD_BOOT_WINDOW_MS
#define APP_ANCHOR_SERIAL_CMD_BOOT_WINDOW_MS 5000U
#endif

#ifndef APP_ANCHOR_FW_MARKER
#define APP_ANCHOR_FW_MARKER "anchor-unified"
#endif

#ifndef APP_ANCHOR_DIAG_BLE_BEFORE_UWB
#define APP_ANCHOR_DIAG_BLE_BEFORE_UWB 0U
#endif

#ifndef APP_ANCHOR_DIAG_CONTINUE_ON_UWB_FAIL
#define APP_ANCHOR_DIAG_CONTINUE_ON_UWB_FAIL 0U
#endif

static const char *anchor_role_name(uint8_t role)
{
    switch (role) {
    case ANCHOR_ROLE_MASTER:
        return "master";
    case ANCHOR_ROLE_MATRIX:
        return "matrix";
    case ANCHOR_ROLE_RESPONDER:
        return "responder";
    default:
        return "unset";
    }
}

static inline bool anchor_app_full_cir_quiet(void)
{
    return anchor_cir_output_get_mode() == ANCHOR_CIR_OUTPUT_FULL;
}

static uint8_t persistent_role_normalize(uint8_t role)
{
    if (role == ANCHOR_ROLE_MASTER) {
        return ANCHOR_ROLE_MATRIX;
    }
    return role;
}

static void anchor_normalize_persisted_role(anchor_config_t *cfg, bool *cfg_valid)
{
    anchor_config_t local;
    int rc;

    if (cfg == NULL || cfg_valid == NULL || !(*cfg_valid)) {
        return;
    }

    if (cfg->role != ANCHOR_ROLE_MASTER) {
        return;
    }

    local = *cfg;
    local.role = persistent_role_normalize(local.role);
    local.schema_version = ANCHOR_CONFIG_SCHEMA_VERSION;
    local.generation = cfg->generation + 1U;
    local.crc32 = anchor_config_crc32((const uint8_t *)&local,
                                      offsetof(anchor_config_t, crc32));

    if (!anchor_config_is_valid(&local)) {
        printk("Persisted role normalize failed validation; keeping runtime fallback matrix only\n");
        cfg->role = ANCHOR_ROLE_MATRIX;
        return;
    }

    rc = anchor_config_write(&local);
    if (rc != 0) {
        printk("Persisted role normalize write failed rc=%d; keeping runtime fallback matrix only\n", rc);
        cfg->role = ANCHOR_ROLE_MATRIX;
        return;
    }

    *cfg = local;
    printk("Persisted master role normalized to matrix on boot gen=%lu\n",
           (unsigned long)local.generation);
}

static void bytes_to_hex(const uint8_t *src, size_t len, char *dst, size_t dst_len)
{
    static const char hex[] = "0123456789ABCDEF";
    size_t i;

    if (dst_len < (len * 2U + 1U)) {
        if (dst_len > 0U) {
            dst[0] = '\0';
        }
        return;
    }

    for (i = 0; i < len; i++) {
        dst[(i * 2U)] = hex[(src[i] >> 4) & 0x0FU];
        dst[(i * 2U) + 1U] = hex[src[i] & 0x0FU];
    }
    dst[len * 2U] = '\0';
}

static int anchor_role_runtime_flags(uint8_t role, uint8_t *out_master,
                                     uint8_t *out_allow_tag_polls)
{
    if (out_master == NULL || out_allow_tag_polls == NULL) {
        return -EINVAL;
    }

    switch (role) {
    case ANCHOR_ROLE_MASTER:
        *out_master = 1U;
        *out_allow_tag_polls = 0U;
        return 0;
    case ANCHOR_ROLE_MATRIX:
        *out_master = 0U;
        *out_allow_tag_polls = 0U;
        return 0;
    case ANCHOR_ROLE_RESPONDER:
        *out_master = 0U;
        *out_allow_tag_polls = 1U;
        return 0;
    default:
        return -EINVAL;
    }
}

static int anchor_run_runtime_role(uint8_t anchor_id_runtime, uint8_t anchor_id_cfg,
                                   uint8_t role, bool cfg_valid,
                                   uint32_t master_sweep_limit)
{
    uint8_t anchor_peer_ids[UWB_MAX_ANCHORS];
    const uint8_t *anchor_peer_ids_ptr = NULL;
    size_t peer_count = 0U;
    uint8_t effective_master = 0U;
    uint8_t effective_allow_tag_polls = 0U;
    int ret;

    ret = anchor_role_runtime_flags(role, &effective_master, &effective_allow_tag_polls);
    if (ret != 0) {
        if (!anchor_app_full_cir_quiet()) {
            printk("Invalid runtime role=%u\n", (unsigned int)role);
        }
        return ret;
    }

    anchor_ble_ctrl_set_runtime_switch_pending(false);
    uart_role_switch_set_runtime(anchor_id_cfg, role, cfg_valid);
    anchor_ble_ctrl_set_runtime(anchor_id_cfg, role, cfg_valid);
    uart_role_switch_set_ranging_active(true);
    anchor_ble_ctrl_set_busy(true);
    anchor_runtime_clear_stop();

    if (effective_master != 0U) {
        if (APP_ANCHOR_USE_AUTO_SCHEDULE != 0U) {
            if (APP_ANCHOR_SCHEDULE_MODE == 2U) {
                peer_count = uwb_anchor_schedule_all_except_self(
                    anchor_id_runtime, anchor_peer_ids, sizeof(anchor_peer_ids));
            } else {
                peer_count = uwb_anchor_schedule_upper_triangle(
                    anchor_id_runtime, anchor_peer_ids, sizeof(anchor_peer_ids));
            }
            anchor_peer_ids_ptr = anchor_peer_ids;

            if (!anchor_app_full_cir_quiet()) {
                printk("Anchor master auto schedule %c mode=%u peer_count=%u\n",
                       uwb_anchor_label(anchor_id_runtime),
                       (unsigned int)APP_ANCHOR_SCHEDULE_MODE,
                       (unsigned int)peer_count);
            }
        }

        ret = ss_twr_anchor_init_start(anchor_id_runtime, anchor_peer_ids_ptr, peer_count,
                                       master_sweep_limit);
        uart_role_switch_set_ranging_active(false);
        anchor_ble_ctrl_set_busy(false);
        if (ret != 0) {
            if (!anchor_app_full_cir_quiet()) {
                printk("ss_twr_anchor_init_start failed: %d\n", ret);
            }
            return ret;
        }
        if (master_sweep_limit != 0U &&
            anchor_runtime_requested_role() == ANCHOR_ROLE_UNSET) {
            if (!anchor_app_full_cir_quiet()) {
                printk("Anchor master finite sweep auto-return to matrix after %lu sets\n",
                       (unsigned long)master_sweep_limit);
            }
            anchor_runtime_request_role_switch(ANCHOR_ROLE_MATRIX, 0U);
        }
        if (!anchor_app_full_cir_quiet()) {
            printk("Anchor master ranging stopped; control plane remains active\n");
        }
        return 0;
    }

    ret = ss_twr_resp_start(anchor_id_runtime, effective_allow_tag_polls);
    uart_role_switch_set_ranging_active(false);
    anchor_ble_ctrl_set_busy(false);
    if (ret != 0) {
        if (!anchor_app_full_cir_quiet()) {
            printk("ss_twr_resp_start failed: %d\n", ret);
        }
        return ret;
    }
    if (!anchor_app_full_cir_quiet()) {
        printk("Anchor responder ranging stopped; control plane remains active\n");
    }
    return 0;
}

int anchor_app_run(void)
{
    uint8_t effective_role = ANCHOR_ROLE_UNSET;
    bool unassigned_mode = false;
    uint8_t anchor_id_runtime = APP_ANCHOR_ID;
    uint8_t anchor_id_cfg = (uint8_t)(APP_ANCHOR_ID + 1U);
    uint8_t effective_master = APP_ANCHOR_MASTER;
    uint8_t effective_allow_tag_polls = APP_ANCHOR_ALLOW_TAG_POLLS;
    uint8_t mcu_uid[8];
    uint8_t device_uuid[16];
    anchor_config_t cfg = {0};
    bool cfg_valid = anchor_config_load(&cfg);
    struct anchor_ble_ctrl_boot_info ble_ctrl_info;
    struct uart_role_switch_runtime_info serial_info;
    char uuid_hex[33];
    char mcu_uid_hex[17];
    char bs_code[7];
    int ret;
    bool uwb_ready = false;
    uint32_t effective_master_sweep_limit = 0U;

#if defined(CONFIG_BOOTLOADER_MCUBOOT)
    /*
     * Confirm before UWB/BLE bring-up.  Recovery OTA may switch a device from
     * an older tag image to the anchor app; if any later hardware init path
     * stalls during the first boot, MCUboot would otherwise revert the image.
     */
    if (!boot_is_img_confirmed()) {
        ret = boot_write_img_confirmed();
        printk("MCUboot confirm rc=%d\n", ret);
        if (ret) {
            printk("MCUboot confirm failed, continuing: %d\n", ret);
        }
    }
#endif

#if APP_ANCHOR_DIAG_BLE_BEFORE_UWB == 0U
    printk("Anchor UWB bringup starting before control plane\n");
    ret = uwb_hw_bringup_and_init();
    if (ret) {
#if APP_ANCHOR_DIAG_CONTINUE_ON_UWB_FAIL != 0U
        printk("Anchor UWB bringup failed before control plane: %d; continuing BLE/control only\n",
               ret);
#else
        return ret;
#endif
    } else {
        uwb_ready = true;
    }
#else
    printk("Anchor diag: BLE/control starts before UWB bringup\n");
#endif

    anchor_normalize_persisted_role(&cfg, &cfg_valid);

    anchor_config_get_mcu_uid(mcu_uid);
    anchor_config_get_device_uuid(device_uuid, &cfg, cfg_valid);
    anchor_config_get_bs_code(device_uuid, bs_code);
    bytes_to_hex(device_uuid, sizeof(device_uuid), uuid_hex, sizeof(uuid_hex));
    bytes_to_hex(mcu_uid, sizeof(mcu_uid), mcu_uid_hex, sizeof(mcu_uid_hex));

    if (cfg_valid) {
        anchor_id_cfg = cfg.anchor_id;
        if (anchor_id_cfg >= 1U && anchor_id_cfg <= 8U) {
            anchor_id_runtime = (uint8_t)(anchor_id_cfg - 1U);
        } else {
            unassigned_mode = true;
        }
        if (cfg.role != ANCHOR_ROLE_MATRIX) {
            printk("Boot role %s ignored; defaulting to matrix autopos standby\n",
                   anchor_role_name(cfg.role));
        }
        cfg.role = ANCHOR_ROLE_MATRIX;
        effective_role = ANCHOR_ROLE_MATRIX;
    } else {
        effective_role = APP_ANCHOR_ROLE;
        anchor_id_cfg = (uint8_t)(APP_ANCHOR_ID + 1U);
        printk("anchor_config invalid/absent at 0x%08x, using build-time fallback\n",
               (unsigned int)APP_ANCHOR_CONFIG_ADDR);
    }

    if (effective_role == ANCHOR_ROLE_UNSET) {
        effective_master = (APP_ANCHOR_MASTER != 0U) ? 1U : 0U;
        effective_allow_tag_polls = (APP_ANCHOR_ALLOW_TAG_POLLS != 0U) ? 1U : 0U;
    } else {
        ret = anchor_role_runtime_flags(effective_role, &effective_master,
                                        &effective_allow_tag_polls);
        if (ret != 0) {
            printk("Invalid APP_ANCHOR_ROLE=%u\n", APP_ANCHOR_ROLE);
            return -1;
        }
    }

    if (APP_ANCHOR_FORCE_BOOT_ROLE != ANCHOR_ROLE_UNSET) {
        uint8_t forced_role = (uint8_t)APP_ANCHOR_FORCE_BOOT_ROLE;
        ret = anchor_role_runtime_flags(forced_role, &effective_master,
                                        &effective_allow_tag_polls);
        if (ret == 0) {
            printk("Anchor force boot role override: %s -> %s\n",
                   anchor_role_name(effective_role), anchor_role_name(forced_role));
            effective_role = forced_role;
        } else {
            printk("Invalid APP_ANCHOR_FORCE_BOOT_ROLE=%u ignored\n",
                   (unsigned int)forced_role);
        }
    }

    if (effective_role == ANCHOR_ROLE_UNSET || anchor_id_cfg == 0U) {
        unassigned_mode = true;
        effective_master = 0U;
        effective_allow_tag_polls = 0U;
    }

    printk("ANCHOR: unified; FW: %s; ANCHOR_ID: %c; ROLE: %s; BS_CODE: %s; DEVICE_UUID: %s; MCU_UID: %s\n",
           APP_ANCHOR_FW_MARKER,
           anchor_config_label_char(anchor_id_cfg), anchor_role_name(effective_role),
           bs_code, uuid_hex, mcu_uid_hex);
    printk("Anchor app ready anchor_id=%u role=%s master=%u allow_tag_polls=%u cfg_valid=%u\n",
           (unsigned int)anchor_id_runtime, anchor_role_name(effective_role),
           (unsigned int)effective_master, (unsigned int)effective_allow_tag_polls,
           (unsigned int)(cfg_valid ? 1U : 0U));

    if (APP_ANCHOR_BLE_ID_ENABLE != 0U) {
        ret = anchor_ble_id_start(anchor_id_cfg, effective_role, device_uuid, bs_code);
        if (ret) {
            printk("anchor_ble_id_start failed: %d\n", ret);
        }
    }

    memset(&ble_ctrl_info, 0, sizeof(ble_ctrl_info));
    ble_ctrl_info.active_cfg = cfg;
    if (ble_ctrl_info.active_cfg.schema_version == 0U) {
        ble_ctrl_info.active_cfg.schema_version = ANCHOR_CONFIG_SCHEMA_VERSION;
    }
    ble_ctrl_info.active_cfg_valid = cfg_valid;
    ble_ctrl_info.runtime_anchor_id_cfg = anchor_id_cfg;
    ble_ctrl_info.runtime_role = effective_role;
    memcpy(ble_ctrl_info.device_uuid, device_uuid, sizeof(device_uuid));
    memcpy(ble_ctrl_info.mcu_uid, mcu_uid, sizeof(mcu_uid));
    memcpy(ble_ctrl_info.bs_code, bs_code, sizeof(ble_ctrl_info.bs_code));
    (void)snprintk(ble_ctrl_info.fw_marker, sizeof(ble_ctrl_info.fw_marker), "%s",
                   APP_ANCHOR_FW_MARKER);
    ret = anchor_ble_ctrl_init(&ble_ctrl_info);
    if (ret != 0) {
        printk("anchor_ble_ctrl_init failed: %d\n", ret);
    }

    ret = anchor_mcumgr_diag_init();
    if (ret != 0 && ret != -ENOTSUP) {
        printk("anchor_mcumgr_diag_init failed: %d\n", ret);
    }

    serial_info.active_anchor_id_cfg = anchor_id_cfg;
    serial_info.active_role = effective_role;
    memcpy(serial_info.device_uuid, device_uuid, sizeof(device_uuid));
    memcpy(serial_info.mcu_uid, mcu_uid, sizeof(mcu_uid));
    memcpy(serial_info.bs_code, bs_code, sizeof(serial_info.bs_code));
    serial_info.cfg_valid_on_boot = cfg_valid;

    if (APP_ANCHOR_SERIAL_CMD_ENABLE != 0U) {
        ret = uart_role_switch_init(&serial_info, &cfg, cfg_valid);
        if (ret != 0) {
            printk("uart_role_switch_init failed: %d\n", ret);
        } else if (APP_ANCHOR_SERIAL_CMD_BOOT_WINDOW_MS > 0U) {
            printk("serial config boot window: %u ms\n",
                   (unsigned int)APP_ANCHOR_SERIAL_CMD_BOOT_WINDOW_MS);
            k_msleep(APP_ANCHOR_SERIAL_CMD_BOOT_WINDOW_MS);
        }
    }

    uart_role_switch_set_ranging_active(false);
    anchor_ble_ctrl_set_busy(false);
    anchor_ble_ctrl_set_runtime(anchor_id_cfg, effective_role, cfg_valid);
    anchor_ble_ctrl_set_runtime_switch_pending(false);
    uart_role_switch_set_runtime(anchor_id_cfg, effective_role, cfg_valid);
    ret = anchor_ble_id_update_role(effective_role);
    if (ret != 0 && ret != -EAGAIN) {
        printk("anchor_ble_id_update_role failed: %d\n", ret);
    }

#if APP_ANCHOR_DIAG_BLE_BEFORE_UWB != 0U
    printk("Anchor UWB bringup starting after control plane\n");
    ret = uwb_hw_bringup_and_init();
    if (ret) {
        printk("Anchor UWB bringup failed after control plane: %d\n", ret);
#if APP_ANCHOR_DIAG_CONTINUE_ON_UWB_FAIL != 0U
        while (1) {
            printk("Anchor diag BLE/control alive despite UWB bringup failure rc=%d anchor=%c\n",
                   ret, anchor_config_label_char(anchor_id_cfg));
            k_sleep(K_SECONDS(5));
        }
#else
        return ret;
#endif
    }
    uwb_ready = true;
#endif

    if (!uwb_ready) {
        printk("Anchor UWB unavailable; control plane active, ranging not started\n");
        while (1) {
            k_sleep(K_SECONDS(5));
        }
    }

    if (unassigned_mode) {
        printk("Anchor in unassigned/unset mode: control plane active, ranging not started\n");
        return 0;
    }

    while (1) {
        uint8_t next_role;

        ret = anchor_run_runtime_role(anchor_id_runtime, anchor_id_cfg, effective_role,
                                      cfg_valid, effective_master_sweep_limit);
        if (ret != 0) {
            return ret;
        }

        next_role = anchor_runtime_requested_role();
        if (next_role == ANCHOR_ROLE_UNSET) {
            if (!anchor_app_full_cir_quiet()) {
                printk("Anchor runtime role %s stopped without new role; restarting same role\n",
                       anchor_role_name(effective_role));
            }
            k_msleep(50);
            continue;
        }

        effective_master_sweep_limit = anchor_runtime_requested_master_sweeps();
        anchor_runtime_clear_role_switch();
        effective_role = next_role;
        ret = anchor_role_runtime_flags(effective_role, &effective_master,
                                        &effective_allow_tag_polls);
        if (ret != 0) {
            if (!anchor_app_full_cir_quiet()) {
                printk("Runtime role switch invalid role=%u\n", (unsigned int)effective_role);
            }
            return ret;
        }
        if (!anchor_app_full_cir_quiet()) {
            printk("Anchor runtime role switch applied: anchor=%c role=%s\n",
                   anchor_config_label_char(anchor_id_cfg), anchor_role_name(effective_role));
        }
        ret = anchor_ble_id_update_role(effective_role);
        if (ret != 0 && ret != -EAGAIN) {
            if (!anchor_app_full_cir_quiet()) {
                printk("anchor_ble_id_update_role failed after runtime switch: %d\n", ret);
            }
        }
    }
}
```
